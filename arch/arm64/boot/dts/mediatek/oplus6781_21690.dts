/*
 * Copyright (C) 2015 MediaTek Inc.
 *
 * This program is free software: you can redistribute it and/or modify
 * it under the terms of the GNU General Public License version 2 as
 * published by the Free Software Foundation.
 *
 * This program is distributed in the hope that it will be useful,
 * but WITHOUT ANY WARRANTY; without even the implied warranty of
 * MERCHANTABILITY or FITNESS FOR A PARTICULAR PURPOSE. See the
 * GNU General Public License for more details.
 */
/dts-v1/;
/plugin/;
#include <dt-bindings/interrupt-controller/irq.h>
#include <dt-bindings/interrupt-controller/arm-gic.h>
#include <dt-bindings/pinctrl/mt6781-pinfunc.h>

#include "mediatek/oplus6781/common/oplus6781_common.dtsi"
#include "mediatek/oplus6781/21690/oplus6781_21690.dtsi"

#include <oplus6781_21690/cust.dtsi>
/*End of this file, DO NOT ADD ANYTHING HERE*/
