/**********************************************************************************
* Copyright (c)  2008-2020  Guangdong oplus Mobile Comm Corp., Ltd
*
***********************************************************************************/
&odm {
    nfc_chipset:nfc_chipset {
        compatible = "oplus-nfc-chipset";
        chipset-21851 = "PN557";
        chipset-21876 = "PN557";
	};
};

&i2c8 {
       status = "okay";
       nfc_nxp@28 {
               compatible = "nxp,pn544";
               reg = <0x28>;
               nxp,pn544-irq = <&pio 11 0x0>;
               nxp,pn544-ven = <&pio 13 0x0>;
               nxp,pn544-fw-dwnld = <&pio 7 0x0>;
               interrupt-parent = <&pio>;
       };
};