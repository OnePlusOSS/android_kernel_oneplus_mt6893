// SPDX-License-Identifier: GPL-2.0+
/*
 * Copyright (c) 2019 MediaTek Inc.
 *
 */

&mtk_gauge {
	/*	Charging termination current.*/
	DIFFERENCE_FULLOCV_ITH = <(200)>;
	/*	If ui_soc shows 1% more than X minites, system will shutdown.*/
	SHUTDOWN_1_TIME = <(5)>;
/*	The ui_soc will keep 100% until SOC drop X percents after unplugged.*/
	KEEP_100_PERCENT = <(1)>;
	R_FG_VALUE = <(10)>;	/*	R_sense resistance.*/
	/*	Configures whether using embedded battery or not.*/
	EMBEDDED_SEL = <(1)>;
	PMIC_SHUTDOWN_CURRENT = <(20)>;	/*	System shutdown current.*/
	FG_METER_RESISTANCE = <(75)>;	/*	The resistance of PCB*/
	/*	Tune value for current measurement.*/
	CAR_TUNE_VALUE = <(100)>;
	PMIC_MIN_VOL = <(33500)>;
	/*	vboot voltage for gauge 0%.*/
	POWERON_SYSTEM_IBOOT = <(500)>;
	/*	power on system iboot*/
	SHUTDOWN_GAUGE0_VOLTAGE = <(34000)>;
	/*	shutdown gauge 0% voltage*/
	TEMPERATURE_T0 = <(50)>;	/*	Battery temperature T0*/
	TEMPERATURE_T1 = <(25)>;	/*	Battery temperature T1*/
	TEMPERATURE_T2 = <(10)>;	/*	Battery temperature T2*/
	TEMPERATURE_T3 = <(0)>;	/*	Battery temperature T3*/
	TEMPERATURE_T4 = <(-10)>;	/*	Battery temperature T4*/
	g_FG_PSEUDO100_T0 = <(98)>;	/*	Pseudo 100% percentage at T0.*/
	g_FG_PSEUDO100_T1 = <(98)>;	/*	Pseudo 100% percentage at T1.*/
	g_FG_PSEUDO100_T2 = <(94)>;	/*	Pseudo 100% percentage at T2.*/
	g_FG_PSEUDO100_T3 = <(87)>;	/*	Pseudo 100% percentage at T3.*/
	g_FG_PSEUDO100_T4 = <(87)>;	/*	Pseudo 100% percentage at T4.*/
	/*	System shut down voltage.*/
	Q_MAX_SYS_VOLTAGE_BAT0 = <(3350)>;
	/*	System shut down voltage.*/
	Q_MAX_SYS_VOLTAGE_BAT1 = <(3350)>;
	/*	System shut down voltage.*/
	Q_MAX_SYS_VOLTAGE_BAT2 = <(3350)>;
	/*	System shut down voltage.*/
	Q_MAX_SYS_VOLTAGE_BAT3 = <(3350)>;

	COM_FG_METER_RESISTANCE = <(75)>;
	/* compensate The resistance of PCB */
	COM_R_FG_VALUE = <(10)>;
	/* compensate R_sense resistance */
	enable_tmp_intr_suspend = <(0)>;
	/* Enable update temp when suspend */
	ACTIVE_TABLE = <(0)>;
	/* Table numbers per battery */
	MULTI_TEMP_GAUGE0 = <(1)>;
	/* Multi gauge0 enable */
	RBAT_PULL_UP_R = <(16000)>;
	RBAT_PULL_UP_VOLT = <(1800)>;
#include "mt6765_battery_table_ext.dtsi"
#include "mt6765_battery_table_ext_atl_5000_parkera.dtsi"
#include "mt6765_battery_table_ext_cosmx_5000_parkera.dtsi"
#include "mt6765_battery_table_ext_nvt_5000_parkera.dtsi"
};
