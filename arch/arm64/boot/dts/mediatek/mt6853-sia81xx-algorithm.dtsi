
/* Copyright (c) 2018, The Linux Foundation. All rights reserved.
 *
 * This program is free software; you can redistribute it and/or modify
 * it under the terms of the GNU General Public License version 2 and
 * only version 2 as published by the Free Software Foundation.
 *
 * This program is distributed in the hope that it will be useful,
 * but WITHOUT ANY WARRANTY; without even the implied warranty of
 * MERCHANTABILITY or FITNESS FOR A PARTICULAR PURPOSE.  See the
 * GNU General Public License for more details.
 */

&pio {
	//#ifdef OPLUS_ARCH_EXTENDS
	sia81xx_gpio_L: sia81xx_gpio_L {
		pins_cmd_dat {
			pinmux = <PINMUX_GPIO139__FUNC_GPIO139>;
//			slew-rate = <1>;
//			bias-disable;
		};
	};
	//endif
};

&sound {
//#ifdef OPLUS_ARCH_EXTENDS
		si,sia81xx-max-num = <1>;
		si,sia81xx-aux-devs = <&sia81xx_L>;
		si,sia81xx-aux-devs-prefix = "SpkrLeft";
//#endif
};


