// SPDX-License-Identifier: GPL-2.0+
/*
 * Copyright (c) 2019 MediaTek Inc.
 *
 */

&spi2 {
    #address-cells = <1>;
    #size-cells = <0>;
    status = "ok";

    touch_ts@0 {
                compatible = "ilitek,ili7807s","novatek,nf_nt36672c";
                reg = <0>;
                chip-name = "OPLUS_TP_NOFLASH";
                status = "ok";

                spi-max-frequency = <10000000>;    //4800000,9600000,15000000,19200000
                reset-gpio = <&pio 34 0x00>;
                interrupt-parent = <&pio>;
                interrupts = <1 0x0>;
                irq-gpio = <&pio 1 0x2002>;

                novatek,reset-gpio = <&pio 34 0x00>;
                novatek,irq-gpio = <&pio 1 0x2002>;

                touchpanel,max-num-support = <10>;
                touchpanel,tx-rx-num = <16 36>;
                touchpanel,panel-coords = <4320 9600>;
                touchpanel,display-coords = <1080 2400>;
                touchpanel,touchmajor-limit = <0 54>;
                touchpanel,button-type = <4>;
                touchpanel.button-TRx = <0 0>;
                platform_support_project = <0x226AD 0x226AE 0x226AF 0x226B0>;
                platform_support_project_dir = <0x226AF 0x226AF 0x226AF 0x226AF>;
                platform_support_project_commandline = "default_commandline","default_commandline","default_commandline","default_commandline";


                touchpanel,smooth-level = <255 5 4 3 2 1>;
                touchpanel,sensitive-level = <255 1 2 3 4 5>;
                touchpanel,single-optimized-time = <8>;

                incell_screen;
                fw_edge_limit_support;
                black_gesture_support;
                charger_pump_support;
                headset_pump_support;
                esd_handle_support;
                black_gesture_test_support;
                noflash_support;
                smart_gesture_support;
                fw_update_app_support;
                game_switch_support;
                pressure_report_support;
                new_set_irq_wake_support;
                lcd_trigger_load_tp_fw_support;
                fw_update_in_probe_with_headfile;
                health_monitor_v2_support;
    };
};
/* TOUCH end */
