/*
 * Mediatek's mt6885 SoC device tree source
/*
 * Mediatek's mt6893 SoC device tree source
 *
 * Copyright (C) 2016 MediaTek Inc.
 *
 * This program is free software; you can redistribute it and/or modify
 * it under the terms of the GNU General Public License version 2 as
 * published by the Free Software Foundation.
 *
 * This program is distributed in the hope that it will be useful,
 * but WITHOUT ANY WARRANTY; without even the implied warranty of
 * MERCHANTABILITY or FITNESS FOR A PARTICULAR PURPOSE.
 * See http://www.gnu.org/licenses/gpl-2.0.html for more details.
 */
/dts-v1/;
/plugin/;
#include "oplus6893_20827.dts"
#include "mediatek/oplus6893_20827_EVT_cust.dtsi"

/delete-node/ &oplus_boardid;

&odm {
		oplus_boardid:oplus_boardid {
			compatible = "oplus,oplus_boardid";
			oplus_boardid,dtsino="20827";//only one u32
			oplus_boardid,pcbmask="0x0310";//all mask 0xffff
		};
};
