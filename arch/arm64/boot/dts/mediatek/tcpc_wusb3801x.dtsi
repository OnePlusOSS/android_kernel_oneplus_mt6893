// SPDX-License-Identifier: GPL-2.0+
/*
 * Copyright (c) 2019 MediaTek Inc.
 *
 */

&i2c5 {
	wusb3801x_typec: usb_type_c_wusb3801x@60 {
		compatible = "mediatek,usb_type_c_wusb3801"; //
		reg = <0x60>;
		mt-dual,supported_modes = <0>; /* 0: dfp/ufp, 1: dfp, 2: ufp */
		wusb3801-tcpc,name = "type_c_port0"; /* tcpc_device's name */ //
		/* 0: SNK Only, 1: SRC Only, 2: DRP, 3: Try.SRC, 4: Try.SNK */
//#ifndef OPLUS_FEATURE_CHG_BASIC
//Modify for OTG switch
		//wusb3801-tcpc,role_def = <0>;
//else
		wusb3801-tcpc,role_def = <1>;
//#endif

		wusb3801,rp_level = <0>; /* 0: Default, 1: 1.5, 2: 3.0 */
		/* 0: Never, 1: Always, 2: EMarkOnly, 3: StartOnly */
		// sgm7220-tcpc,vconn_supply  = <1>; //
		wusb3801,drp-toggle-time = <0>;
		/* the number of notifier supply */
		wusb3801-tcpc,notifier_supply_num = <3>; //

		wusb3801,irq-gpio = <&pio 17 0x0>; //
		wusb3801,irq-gpio_num = <17>; //

		// mt6360pd,pcb_gpio = <&pio 5 0x0>;
		// mt6360pd,pcb_gpio_num = <5>;
		// interrupt-parent = <&subpmic_mtk>;
		// interrupts = <64 0>;
		// interrupt-names = "usbid_evt";
		// bootmode = <&chosen>;
        status = "okay";
	};
};

