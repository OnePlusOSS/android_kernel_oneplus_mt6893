/*
 * Mediatek's mt6873 SoC device tree source
 *
 * Copyright (C) 2016 MediaTek Inc.
 *
 * This program is free software; you can redistribute it and/or modify
 * it under the terms of the GNU General Public License version 2 as
 * published by the Free Software Foundation.
 *
 * This program is distributed in the hope that it will be useful,
 * but WITHOUT ANY WARRANTY; without even the implied warranty of
 * MERCHANTABILITY or FITNESS FOR A PARTICULAR PURPOSE.
 * See http://www.gnu.org/licenses/gpl-2.0.html for more details.
 */
/dts-v1/;
/plugin/;
#include <dt-bindings/interrupt-controller/irq.h>
#include <dt-bindings/interrupt-controller/arm-gic.h>
#include <dt-bindings/pinctrl/mt6785-pinfunc.h>
#include "mediatek/oplus6785/common/oplus6785_20730.dtsi"
#include "mediatek/oplus6785/20730/oplus6785_20730_charger.dtsi"
#include "mediatek/cust_mt6785_camera_20730.dtsi"
#include "mediatek/oplus6785_20730_audio_extend.dtsi"
//#include "mediatek/cust_mt6785_camera_20730.dtsi"
#include <oplus6785_20730/cust.dtsi>
/*End of this file, DO NOT ADD ANYTHING HERE*/
