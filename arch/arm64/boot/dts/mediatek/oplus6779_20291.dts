// SPDX-License-Identifier: GPL-2.0+
/*
 * Copyright (c) 2019 MediaTek Inc.
 * Author: Mars.C <mars.cheng@mediatek.com>
 *
 */

/dts-v1/;
/plugin/;
#include <dt-bindings/interrupt-controller/irq.h>
#include <dt-bindings/interrupt-controller/arm-gic.h>
#include <dt-bindings/pinctrl/mt6779-pinfunc.h>

&chosen {

	atag,videolfb-fb_base_l = <0x5e605000>;
	atag,videolfb-fb_base_h = <0x0>;
	atag,videolfb-islcmfound = <1>;
	atag,videolfb-islcm_inited = <0>;
	atag,videolfb-fps= <6000>;
	atag,videolfb-vramSize= <0x017bb000>;
	atag,videolfb-lcmname=
		"nt35595_fhd_dsi_cmd_truly_nt50358_drv";
};

&mrdump_ext_rst {
	interrupt-parent = <&pio>;
	interrupts = <0 IRQ_TYPE_LEVEL_LOW 0 0>;
	deb-gpios = <&pio 0 0>;
	debounce = <512000>;
};

&odm {
	led0:led@0 {
		compatible = "mediatek,red";
		led_mode = <0>;
		data = <1>;
		pwm_config = <0 0 0 0 0>;
	};
	led1:led@1 {
		compatible = "mediatek,green";
		led_mode = <0>;
		data = <1>;
		pwm_config = <0 0 0 0 0>;
	};
	led2:led@2 {
		compatible = "mediatek,blue";
		led_mode = <0>;
		data = <1>;
		pwm_config = <0 0 0 0 0>;
	};
	led3:led@3 {
		compatible = "mediatek,jogball-backlight";
		led_mode = <0>;
		data = <1>;
		pwm_config = <0 0 0 0 0>;
	};
	led4:led@4 {
		compatible = "mediatek,keyboard-backlight";
		led_mode = <0>;
		data = <1>;
		pwm_config = <0 0 0 0 0>;
	};
	led5:led@5 {
		compatible = "mediatek,button-backlight";
		led_mode = <0>;
		data = <1>;
		pwm_config = <0 0 0 0 0>;
	};
	led6:led@6 {
		compatible = "mediatek,lcd-backlight";
		led_mode = <4>;
		data = <1>;
		pwm_config = <0 1 0 0 0>;
	};
	vibrator0:vibrator@0 {
		compatible = "mediatek,vibrator";
		vib_timer = <25>;
		vib_limit = <9>;
		vib_vol= <9>;
	};

/* sensor start */
	sensor_fb: sensor_fb {
		compatible = "oplus,sensor-feedback";
	};
	/*
	enum {
		LIS3DH,
		LSM6DS3,
		BMI160,
		LIS2HH12,
		LSM6DSM,
		BMI2XY,
		LSM6DSO,
	};
	*/
	gsensor_1: gsensor_1 {
		status = "okay";
		sensor_name = <2>;//BMI160
		device_name = "bmi160";
		i2c_num = <2>;
		i2c_addr = <0>;
		direction = <0>;
		eint_num = <10>;
		step_count_7_en = <1>;
		config_miso = <1>;
		correct_y_bias = <1>;
		gyro_cali_version= <1>;
		acc_cali_range= <250 250 250>;
		cali_nv_adapt_q_flag = <0>;
	};

	gsensor_2: gsensor_2 {
		status = "okay";
		sensor_name = <6>;//LSM6DSO
		device_name = "lsm6dso";
		i2c_num = <2>;
		i2c_addr = <0>;
		direction = <1>;
		eint_num = <10>;
		gyro_cali_version= <2>; //should be always v2 for lsm6dso
		acc_cali_range= <200 200 200>;
		cali_nv_adapt_q_flag = <0>;
	};

	gsensor_3: gsensor_3 {
		status = "okay";
		sensor_name = <7>;//ICM4X6XX
		device_name = "icm4x6xx";
		i2c_num = <2>;
		i2c_addr = <0>;
		direction = <1>;
		eint_num = <10>;
		gyro_cali_version= <1>;
		acc_cali_range= <200 200 200>;
		cali_nv_adapt_q_flag = <0>;
	};

	/*
	enum {
		AKM09911,
		MMC3530,
		MMC5603,
		MXG4300,
	};
	*/
	msensor_1: msensor_1 {
		status = "okay";
		sensor_name = <3>;//MXG4300
		i2c_num = <0>;
		i2c_addr = <12>;
		direction = <0>;
		eint_num = <0>;
		libname = "mxg";
		soft-mag-parameter = <10326 0 340 0 166 0 202 0 10663 0 435 1 75 1 131 1 10956 0>;
	};
	msensor_2: msensor_2 {
		status = "okay";
		sensor_name = <2>;//MMC5603
		i2c_num = <0>;
		i2c_addr = <48>;
		direction = <0>;
		eint_num = <0>;
		libname = "mmc";
		para_num = <2>;
		mag_para_1 {
			match_projects = "20291_20292_20293_20294";
			soft-mag-parameter = <9995 0 257 0 48 0 7 0 10502 0 3 0 174 0 389 1 11004 0>;
		};
		mag_para_2 {
			match_projects = "20295";
			soft-mag-parameter = <9939 0 1098 0 25 0 1604 0 7917 0 168 0 2162 0 4298 1 8118 0>;
		};
	};
	/*
	enum {
		TMD2725,
		APSD9922,
		STK3335,
		STK3331,
		STK2232,
		TCS3701,
		STK32600,
	};
	*/
	proximity_1: proximity_1 {
		status = "okay";
		sensor_name = <6>;//STK32600
		i2c_num = <0>;
		i2c_addr = <72>;
		direction = <4>;
		eint_num = <11>;
		low_step = <300>;
		high_step = <400>;
		low_limit = <400>;
		high_limit = <600>;
		dirty_low_step = <100>;
		dirty_high_step = <150>;
		ps_dirty_limit = <1800>;
		ps_ir_limit = <2000>;
		ps_adjust_min = <0>;
		ps_adjust_max = <600>;
		sampling_count = <5>;
		step_max = <400>;
		step_min = <100>;
		step_div = <1500>;
		anti_shake_delta = <70>;
		dynamic_cali_max = <1023>;
		raw2offset_radio = <1000>;
		offset_max = <60000>;
		offset_range_min = <0>;
		offset_range_max = <65534>;
		force_cali_limit = <2000>;
		cali_jitter_limit = <20>;
		cal_offset_margin = <3000>;
	};
	proximity_2: proximity_2 {
		status = "okay";
		sensor_name = <5>;//TCS3701
		i2c_num = <0>;
		i2c_addr = <57>;
		direction = <4>;
		eint_num = <11>;
		low_step = <300>;
		high_step = <400>;
		low_limit = <400>;
		high_limit = <600>;
		dirty_low_step = <100>;
		dirty_high_step = <150>;
		ps_dirty_limit = <1022>;
		ps_ir_limit = <500>;
		ps_adjust_min = <0>;
		ps_adjust_max = <600>;
		sampling_count = <5>;
		step_max = <400>;
		step_min = <100>;
		step_div = <1500>;
		anti_shake_delta = <80>;
		dynamic_cali_max = <1023>;
		raw2offset_radio = <31200>;
		offset_max = <250>;
		offset_range_min = <255>;
		offset_range_max = <255>;
		force_cali_limit = <2000>;
		cali_jitter_limit = <30>;
		cal_offset_margin = <120>;
	};
	light_1: light_1 {
		status = "okay";
		sensor_name = <6>;//STK32600
		i2c_num = <0>;
		i2c_addr = <72>;
		direction = <4>;
		eint_num = <11>;
		als_ratio = <113>;
		als_buffer_length =<8>;
		als_type = <2>;//<1-normal;2-under screen;3-normal needed compensation>
		device_name = "stk32600";
		als_spectral_coefficient = <1000>;
	};
	light_2: light_2 {
		status = "okay";
		sensor_name = <5>;//TCS3701
		i2c_num = <0>;
		i2c_addr = <57>;
		direction = <4>;
		eint_num = <11>;
		als_ratio = <110>;
		als_buffer_length = <10>;
		als_type = <2>;
		device_name = "tcs3701";
	};
	pick_up: pick_up {
		status = "okay";
		use-proximity = <1>;
	};
	lux_aod: lux_aod {
		status = "okay";
		use-proximity = <1>;
	};
	alsps_arch: alsps_arch {
		status = "okay";
		new-arch-supported = <1>;
	};
	cali_nv_adapt_q: cali_nv_adapt_q {
		status = "okay";
		cali_nv_adapt_q = <0>;
	};
/* sensor end */
/* keypad start*/
	kpd_volume_down:kpd_volume_down {
		compatible = "mediatek, VOLUME_DOWN-eint";
		interrupt-parent = <&pio>;
		interrupts = <60 IRQ_TYPE_EDGE_FALLING 60 0>;
		debounce = <32000>;
		status = "okay";
	};
/* keypad end*/
	pmic_history_count:pmic_history_count {
	};
	pmic_history0:pmic_history0 {
	};
	pmic_history1:pmic_history1 {
	};
	pmic_history2:pmic_history2 {
	};
	pmic_history3:pmic_history3 {
	};

/*OPLUS_BUG_STABILITY oplus project start */
	oplus_boardid:oplus_boardid {
		compatible = "oplus,oplus_boardid";
		oplus_boardid,dtsino="20291";//only one u32
		oplus_boardid,pcbmask="0xffff";//all mask 0xffff
	};
    oplus_project:oplus_project {
        compatible = "oplus,oplus_project";
    };
    oplus_devinfo:oplus_devinfo {
        compatible = "oplus-devinfo";
        pinctrl-names = "default", "aboard_gpio0_sleep", "aboard_gpio0_active";
        pinctrl-0 = <&hw_pins_default>;
        pinctrl-1 = <&aboard_pin_gpio0_sleep>;
        pinctrl-2 = <&aboard_pin_gpio0_active>;
        main-sub {
            compatible = "hw-match, main-sub";
            aboard-gpio0 = <&pio 23 0x00>;
            aboard-patterns = <1 1 0 0 0>;
            /*main board*/
            match-projects = <20291 20292 20293 20294 20295>;
        };
    };
/*endif*/
    

//#ifdef OPLUS_FEATURE_NFC_CONSOFT
    nfc_chipset:nfc_chipset {
        compatible = "oplus-nfc-chipset";
        chipset-20295 = "ST21H";
    };

    nfc:nfc {
        compatible = "mediatek,nfc-gpio-v2";
        gpio-rst = <24>;
        gpio-rst-std = <&pio 24 0x0>;
        gpio-irq = <2>;
        gpio-irq-std = <&pio 2 0x0>;
    };
//#endif /* OPLUS_FEATURE_NFC_CONSOFT */
	oplus,track-charge {
		compatible = "oplus,track-charge";
		track,fast_chg_break_t_thd = <1000>;
		track,general_chg_break_t_thd = <200>;
		track,voocphy_type = <4>;
		track,wired_max_power = <30000>;
		track,wired_fast_chg_scheme = <4>;
	};
};

/* OPLUS_BUG_STABILITY add pinctrl state for a-board match*/
&pio {
    hw_pins_default:default@hw_sub_id {
    };

    aboard_pin_gpio0_sleep:sleep@id0 {
            pins_cmd_dat {
                pinmux = <PINMUX_GPIO23__FUNC_GPIO23>;
                bias-pull-down;
                input-enable;
            };
    };
    aboard_pin_gpio0_active:active@id0 {
        pins_cmd_dat {
            pinmux = <PINMUX_GPIO23__FUNC_GPIO23>;
            bias-pull-up;
            input-enable;
        };
    };
};
/*#endif OPLUS_BUG_STABILITY*/

&uart0 {
	status = "okay";
};

//#ifdef OPLUS_FEATURE_TP_BASIC
/*OPLUS_FEATURE_TP_BASIC*/
&keypad {
	mediatek,key-debounce-ms = <1024>;
	/*HW Keycode [0~71] -> Linux Keycode*/
	mediatek,hw-map-num = <72>;
	mediatek,hw-init-map = <114 0 0 0 0 0 0 0 0 0 0 0 0 0 0 0 0 0 0 0 0 0 0
		0 0 0 0 0 0 0 0 0 0 0 0 0 0 0 0 0 0 0 0 0 0 0 0 0 0 0 0 0 0 0 0
		0 0 0 0 0 0 0 0 0 0 0 0 0 0 0 0 0 >;
	status = "okay";
	keypad,volume-down = <&pio 60 0x00>;
	pinctrl-names = "default", "volume_down_as_int";
	pinctrl-0 = <&kpd_gpios_def_cfg>;
	pinctrl-1 = <&volume_down_gpio_eint>;
};
//endif OPLUS_FEATURE_TP_BASIC

//#ifdef OPLUS_FEATURE_SENSOR
&oplus_sensorhub{
	vio28-supply = <&mt_pmic_vio28_ldo_reg>;
	status = "okay";
};
//#endif //OPLUS_FEATURE_SENSOR

&pio {
	kpd_gpios_def_cfg: kpdgpiodefault {
		pins_cmd_dat {
			pinmux = <PINMUX_GPIO59__FUNC_KPCOL0>,
				<PINMUX_GPIO60__FUNC_KPCOL1>;
			mediatek,pull-up-adv = <MTK_PUPD_SET_R1R0_01>;
			pull-up;
			input-enable;
		};
	};

	//#ifdef OPLUS_FEATURE_TP_BASIC
	volume_down_gpio_eint:volume_down {
		pins_cmd_dat {
			pinmux = <PINMUX_GPIO60__FUNC_GPIO60>;
			input-enable;
			bias-disable;
		};
	};
	//#endif  OPLUS_FEATURE_TP_BASIC

	/* set audio pinctrl status */
	aud_clk_mosi_off: aud_clk_mosi_off {
		pins_cmd0_dat {
			pinmux = <PINMUX_GPIO189__FUNC_GPIO189>,
				 <PINMUX_GPIO190__FUNC_GPIO190>;
		};
	};
	aud_clk_mosi_on: aud_clk_mosi_on {
		pins_cmd0_dat {
			pinmux = <PINMUX_GPIO189__FUNC_AUD_CLK_MOSI>,
				 <PINMUX_GPIO190__FUNC_AUD_SYNC_MOSI>;
		};
	};
	aud_dat_mosi_off: aud_dat_mosi_off {
		pins_cmd1_dat {
			pinmux = <PINMUX_GPIO191__FUNC_GPIO191>;
			input-enable;
			bias-disable;
		};
		pins_cmd2_dat {
			pinmux = <PINMUX_GPIO192__FUNC_GPIO192>;
			input-enable;
			bias-disable;
		};
	};
	aud_dat_mosi_on: aud_dat_mosi_on {
		pins_cmd1_dat {
			pinmux = <PINMUX_GPIO191__FUNC_AUD_DAT_MOSI0>,
				 <PINMUX_GPIO192__FUNC_AUD_DAT_MOSI1>;
		};
	};
	aud_dat_mosi_ch34_off: aud_dat_mosi_ch34_off {
		pins_cmd1_dat {
			pinmux = <PINMUX_GPIO143__FUNC_GPIO143>;
			input-enable;
			bias-disable;
		};
	};
	aud_dat_mosi_ch34_on: aud_dat_mosi_ch34_on {
		pins_cmd1_dat {
			pinmux = <PINMUX_GPIO143__FUNC_AUD_DAT_MOSI2>;
		};
	};
	aud_dat_miso_off: aud_dat_miso_off {
		pins_cmd1_dat {
			pinmux = <PINMUX_GPIO193__FUNC_GPIO193>;
			input-enable;
			bias-disable;
		};
		pins_cmd2_dat {
			pinmux = <PINMUX_GPIO194__FUNC_GPIO194>;
			input-enable;
			bias-disable;
		};
	};
	aud_dat_miso_on: aud_dat_miso_on {
		pins_cmd1_dat {
			pinmux = <PINMUX_GPIO193__FUNC_AUD_DAT_MISO0>;
			input-schmitt-enable;
		};
		pins_cmd2_dat {
			pinmux = <PINMUX_GPIO194__FUNC_AUD_DAT_MISO1>;
			input-schmitt-enable;
		};
	};
	aud_dat_miso_ch34_off: aud_dat_miso_ch34_off {
		pins_cmd1_dat {
			pinmux = <PINMUX_GPIO146__FUNC_GPIO146>;
			input-enable;
			bias-disable;
		};
	};
	aud_dat_miso_ch34_on: aud_dat_miso_ch34_on {
		pins_cmd1_dat {
			pinmux = <PINMUX_GPIO146__FUNC_AUD_DAT_MISO2>;
			input-schmitt-enable;
		};
	};
	vow_dat_miso_off: vow_dat_miso_off {
		pins_cmd1_dat {
			pinmux = <PINMUX_GPIO193__FUNC_GPIO193>;
		};
	};
	vow_dat_miso_on: vow_dat_miso_on {
		pins_cmd1_dat {
			pinmux = <PINMUX_GPIO193__FUNC_VOW_DAT_MISO>;
		};
	};
	vow_clk_miso_off: vow_clk_miso_off {
		pins_cmd3_dat {
			pinmux = <PINMUX_GPIO194__FUNC_GPIO194>;
			input-schmitt-enable;
		};
	};
	vow_clk_miso_on: vow_clk_miso_on {
		pins_cmd3_dat {
			pinmux = <PINMUX_GPIO194__FUNC_VOW_CLK_MISO>;
			input-schmitt-enable;
		};
	};
	aud_nle_mosi_off: aud_nle_mosi_off {
		pins_cmd3_dat {
			pinmux = <PINMUX_GPIO144__FUNC_GPIO144>,
				 <PINMUX_GPIO145__FUNC_GPIO145>;
		};
	};
	aud_nle_mosi_on: aud_nle_mosi_on {
		pins_cmd3_dat {
			pinmux = <PINMUX_GPIO144__FUNC_AUD_NLE_MOSI1>,
				 <PINMUX_GPIO145__FUNC_AUD_NLE_MOSI0>;
		};
	};
	aud_dat_miso2_off: aud_dat_miso2_off {
		pins_cmd3_dat {
			pinmux = <PINMUX_GPIO146__FUNC_GPIO146>;
		};
	};
	aud_dat_miso2_on: aud_dat_miso2_on {
		pins_cmd3_dat {
			pinmux = <PINMUX_GPIO146__FUNC_AUD_DAT_MISO2>;
		};
	};
	aud_gpio_i2s0_off: aud_gpio_i2s0_off {
		pins_cmd_dat {
			pinmux = <PINMUX_GPIO70__FUNC_GPIO70>;
		};
	};
	aud_gpio_i2s0_on: aud_gpio_i2s0_on {
		pins_cmd_dat {
			pinmux = <PINMUX_GPIO70__FUNC_I2S0_DI>;
		};
	};
	aud_gpio_i2s1_off: aud_gpio_i2s1_off {
	};
	aud_gpio_i2s1_on: aud_gpio_i2s1_on {
	};
	aud_gpio_i2s2_off: aud_gpio_i2s2_off {
	};
	aud_gpio_i2s2_on: aud_gpio_i2s2_on {
	};
	aud_gpio_i2s3_off: aud_gpio_i2s3_off {
		pins_cmd_dat {
			pinmux = <PINMUX_GPIO67__FUNC_GPIO67>,
				 <PINMUX_GPIO68__FUNC_GPIO68>,
				 <PINMUX_GPIO71__FUNC_GPIO71>;
		};
	};
	aud_gpio_i2s3_on: aud_gpio_i2s3_on {
		pins_cmd_dat {
			pinmux = <PINMUX_GPIO67__FUNC_I2S3_LRCK>,
				 <PINMUX_GPIO68__FUNC_I2S3_DO>,
				 <PINMUX_GPIO71__FUNC_I2S3_BCK>;
		};
	};
	aud_gpio_i2s5_off: aud_gpio_i2s5_off {
	};
	aud_gpio_i2s5_on: aud_gpio_i2s5_on {
	};
};

/* AUDIO GPIO standardization */
&afe {
	pinctrl-names = "aud_clk_mosi_off", "aud_clk_mosi_on",
			"aud_dat_mosi_off", "aud_dat_mosi_on",
			"aud_dat_miso_off", "aud_dat_miso_on",
			"vow_dat_miso_off", "vow_dat_miso_on",
			"vow_clk_miso_off", "vow_clk_miso_on",
			"aud_nle_mosi_off", "aud_nle_mosi_on",
			"aud_dat_miso2_off", "aud_dat_miso2_on",
			"aud_gpio_i2s0_off", "aud_gpio_i2s0_on",
			"aud_gpio_i2s1_off", "aud_gpio_i2s1_on",
			"aud_gpio_i2s2_off", "aud_gpio_i2s2_on",
			"aud_gpio_i2s3_off", "aud_gpio_i2s3_on",
			"aud_gpio_i2s5_off", "aud_gpio_i2s5_on",
			"aud_dat_mosi_ch34_off", "aud_dat_mosi_ch34_on",
			"aud_dat_miso_ch34_off", "aud_dat_miso_ch34_on";
	pinctrl-0 = <&aud_clk_mosi_off>;
	pinctrl-1 = <&aud_clk_mosi_on>;
	pinctrl-2 = <&aud_dat_mosi_off>;
	pinctrl-3 = <&aud_dat_mosi_on>;
	pinctrl-4 = <&aud_dat_miso_off>;
	pinctrl-5 = <&aud_dat_miso_on>;
	pinctrl-6 = <&vow_dat_miso_off>;
	pinctrl-7 = <&vow_dat_miso_on>;
	pinctrl-8 = <&vow_clk_miso_off>;
	pinctrl-9 = <&vow_clk_miso_on>;
	pinctrl-10 = <&aud_nle_mosi_off>;
	pinctrl-11 = <&aud_nle_mosi_on>;
	pinctrl-12 = <&aud_dat_miso2_off>;
	pinctrl-13 = <&aud_dat_miso2_on>;
	pinctrl-14 = <&aud_gpio_i2s0_off>;
	pinctrl-15 = <&aud_gpio_i2s0_on>;
	pinctrl-16 = <&aud_gpio_i2s1_off>;
	pinctrl-17 = <&aud_gpio_i2s1_on>;
	pinctrl-18 = <&aud_gpio_i2s2_off>;
	pinctrl-19 = <&aud_gpio_i2s2_on>;
	pinctrl-20 = <&aud_gpio_i2s3_off>;
	pinctrl-21 = <&aud_gpio_i2s3_on>;
	pinctrl-22 = <&aud_gpio_i2s5_off>;
	pinctrl-23 = <&aud_gpio_i2s5_on>;
	pinctrl-24 = <&aud_dat_mosi_ch34_off>;
	pinctrl-25 = <&aud_dat_mosi_ch34_on>;
	pinctrl-26 = <&aud_dat_miso_ch34_off>;
	pinctrl-27 = <&aud_dat_miso_ch34_on>;
	status = "okay";
};
/* AUDIO GPIO standardization end */

&smart_pa {
	interrupt-parent = <&pio>;
	interrupts = <69 IRQ_TYPE_LEVEL_LOW 69 0>;
	status = "okay";
};

/* accdet start */
&accdet {
	/* accdet micbias voltage: 0x09:2.85v 0x08:2.8v 0x07,
	 * 2.7v;0x05,2.5v;0x02,1.9v
	 */
	accdet-mic-vol = <8>;
	/* accdet pwm_width, pwm_thresh, fall_delay, rise_delay
	 * debounce0, debounce1, debounce3, debounce4
	 * eint pwm_width, eint pwm_thresh
	 * eint deb(debounce0, debounce1, debounce2, debounce3), inv_debounce
	 */
	//#ifdef OPLUS_BUG_COMPATIBILITY
	headset-mode-setting = <0x500 0x500 1 0x1f0
	                      0x2000 0x800 0x2000 0x44
	                      0x0 0x7
	                      0x5 0x9 0x9 0xd 0xe>;
	//#else
	/*headset-mode-setting = <0x500 0x500 1 0x1f0
	*                      0x800 0x800 0x20 0x44
	*                      0x4 0x1
	*                      0x5 0x3 0x3 0x5 0xe>;
	*/
	//#endif /* OPLUS_BUG_COMPATIBILITY */

	accdet-plugout-debounce = <1>;
	/*1:ACC mode, 2:low cost without in bias, 6:low cost with in bias*/
	accdet-mic-mode = <2>;
	/*0--MD_MAX--UP_MAX--DW_MAX*/
	//#ifdef OPLUS_ARCH_EXTENDS
	headset-three-key-threshold = <0 82 170 306>;
	//#else /* OPLUS_ARCH_EXTENDS */
	//headset-three-key-threshold = <0 80 220 400>;
	//#endif /* OPLUS_ARCH_EXTENDS */
	headset-three-key-threshold-CDD = <0 121 192 600>;
	/*0--MD_MAX--VOICE_MAX--UP_MAX--DW_MAX*/
	headset-four-key-threshold = <0 58 121 192 400>;

//#ifdef OPLUS_ARCH_EXTENDS
	/* moisture HW mode config start. Enable moisture detection or not
	 * default use HW mode for moisture detection
	 */
	moisture_detect_enable = <1>;
//#endif /* OPLUS_ARCH_EXTENDS */
	/* select VTH to 2v and 500k, use internal resitance */
	eint_use_ext_res = <0>;

//#ifdef OPLUS_ARCH_EXTENDS
	/* enable eint detection mode, if moisture detection enable
	 * eint_detect_mode = moisture_detect_mode;otherwise, select
	 * eint_detect_mode = 4 as DEFAULT
	 */
	eint_detect_mode = <5>;
	/* enable moisture detection mode, if moisture detection enable
	 * eint_detect_mode = moisture_detect_mode
	 */
	moisture_detect_mode = <5>;
	/* select 0: 2.8V; 1: 2.4V; 2: 2V; 3: VTH=MVTH(VTH2) */
	moisture_comp_vth = <2>;
	/* vref2 voltage for different water impedance */
//#ifdef OPLUS_ARCH_EXTENDS
	moisture_comp_vref2 = <2>;
//
	/* vref2 voltage for different water impedance */
//	moisture_comp_vref2 = <0>;
//#endif
	/* moisture HW mode config end */

	/* moisture SW mode config start, use external resister or not.
	 * DEFAULT NOT NEED
	 */
	moisture_use_ext_res = <0>;
	/* moisture external resister ohm, SW mode by auxadc */
	moisture-external-r = <2000000>;
	/* moisture internal resister ohm, SW mode by auxadc */
	moisture-internal-r = <47000>;
	/* moisture of water resister ohm, SW mode by auxadc*/
	moisture-water-r = <10000>;
	/* moisture SW mode config end */
//#endif /* OPLUS_ARCH_EXTENDS */
	status = "okay";
};
/* accdet end */

/* DISPSYS GPIO standardization */
&pio {
	mtkfb_pins_lcd_bias_enp1: lcd_bias_enp1_gpio {
		pins_cmd_dat {
			pinmux = <PINMUX_GPIO23__FUNC_GPIO23>;
			output-high;
		};
	};

	mtkfb_pins_lcd_bias_enp0: lcd_bias_enp0_gpio {
		pins_cmd_dat {
			pinmux = <PINMUX_GPIO23__FUNC_GPIO23>;
			output-low;
		};
	};

	mtkfb_pins_lcd_bias_enn1: lcd_bias_enn1_gpio {
		pins_cmd_dat {
			pinmux = <PINMUX_GPIO202__FUNC_GPIO202>;
			output-high;
		};
	};

	mtkfb_pins_lcd_bias_enn0: lcd_bias_enn0_gpio {
		pins_cmd_dat {
			pinmux = <PINMUX_GPIO202__FUNC_GPIO202>;
			output-low;
		};
	};

	mtkfb_pins_lcm_rst_out1_gpio: lcm_rst_out1_gpio {
		pins_cmd_dat {
			pinmux = <PINMUX_GPIO44__FUNC_GPIO44>;
			output-high;
		};
	};

	mtkfb_pins_lcm_rst_out0_gpio: lcm_rst_out0_gpio {
		pins_cmd_dat {
			pinmux = <PINMUX_GPIO44__FUNC_GPIO44>;
			output-low;
		};
	};

	mtkfb_pins_lcm_dsi_te: lcm_dsi_te {
		pins_cmd_dat {
			pinmux = <PINMUX_GPIO43__FUNC_DSI_TE>;
			input-enable;
		};
	};

	mtkfb_pins_lcm_mipi0_sdata: lcm_mipi0_sdata {
		pins_cmd_dat {
			pinmux = <PINMUX_GPIO95__FUNC_MIPI0_SDATA>;
			output-low;
		};
	};

	mtkfb_pins_lcm_mipi0_sclk: lcm_mipi0_sclk {
		pins_cmd_dat {
			pinmux = <PINMUX_GPIO96__FUNC_MIPI0_SCLK>;
			output-low;
		};
	};

	mtkfb_pins_lcm_mipi1_sdata: lcm_mipi1_sdata {
		pins_cmd_dat {
			pinmux = <PINMUX_GPIO97__FUNC_MIPI1_SDATA>;
			output-low;
		};
	};

	mtkfb_pins_lcm_mipi1_sclk: lcm_mipi1_sclk {
		pins_cmd_dat {
			pinmux = <PINMUX_GPIO98__FUNC_MIPI1_SCLK>;
			output-low;
		};
	};

	mtkfb_pins_lcm_mipi2_sdata: lcm_mipi2_sdata {
		pins_cmd_dat {
			pinmux = <PINMUX_GPIO100__FUNC_MIPI2_SDATA>;
			output-low;
		};
	};

	mtkfb_pins_lcm_mipi2_sclk: lcm_mipi2_sclk {
		pins_cmd_dat {
			pinmux = <PINMUX_GPIO99__FUNC_MIPI2_SCLK>;
			output-low;
		};
	};

	mtkfb_pins_lcm_mipi3_sdata: lcm_mipi3_sdata {
		pins_cmd_dat {
			pinmux = <PINMUX_GPIO102__FUNC_MIPI3_SDATA>;
			output-low;
		};
	};

	mtkfb_pins_lcm_mipi3_sclk: lcm_mipi3_sclk {
		pins_cmd_dat {
			pinmux = <PINMUX_GPIO101__FUNC_MIPI3_SCLK>;
			output-low;
		};
	};

	mtkfb_pins_lcm_mipi4_sdata: lcm_mipi4_sdata {
		pins_cmd_dat {
			pinmux = <PINMUX_GPIO104__FUNC_MIPI4_SDATA>;
			output-low;
		};
	};

	mtkfb_pins_lcm_mipi4_sclk: lcm_mipi4_sclk {
		pins_cmd_dat {
			pinmux = <PINMUX_GPIO103__FUNC_MIPI4_SCLK>;
			output-low;
		};
	};
	/* #ifdef OPLUS_ARCH_EXTENDS */
	mtkfb_pins_lcd_vci_en0: lcd_vci_en0_gpio {
		pins_cmd_dat {
			pinmux = <PINMUX_GPIO5__FUNC_GPIO5>;
			slew-rate = <1>;
			output-low;
		};
	};

	mtkfb_pins_lcd_vci_en1: lcd_vci_en1_gpio {
		pins_cmd_dat {
			pinmux = <PINMUX_GPIO5__FUNC_GPIO5>;
			slew-rate = <1>;
			output-high;
		};
	};

	mtkfb_pins_lcd_mipi_err_en0: lcd_mipi_err_en0_gpio {
		pins_cmd_dat {
			pinmux = <PINMUX_GPIO7__FUNC_GPIO7>;
			slew-rate = <1>;
			output-low;
		};
	};

	mtkfb_pins_lcd_mipi_err_en1: lcd_mipi_err_en1_gpio {
		pins_cmd_dat {
			pinmux = <PINMUX_GPIO7__FUNC_GPIO7>;
			slew-rate = <1>;
			output-high;
		};
	};
	/* #endif */ /* OPLUS_ARCH_EXTENDS */

};

&mtkfb {
	pinctrl-names = "lcd_bias_enp1_gpio", "lcd_bias_enp0_gpio",
		"lcd_bias_enn1_gpio", "lcd_bias_enn0_gpio",
		"lcm_rst_out1_gpio", "lcm_rst_out0_gpio", "lcm_dsi_te",
		"lcm_mipi0_sdata", "lcm_mipi0_sclk",
		"lcm_mipi1_sdata", "lcm_mipi1_sclk",
		"lcm_mipi2_sdata", "lcm_mipi2_sclk",
		"lcm_mipi3_sdata", "lcm_mipi3_sclk",
		"lcm_mipi4_sdata", "lcm_mipi4_sclk",
		/* #ifdef OPLUS_ARCH_EXTENDS */
		"lcd_vci_en0_gpio", "lcd_vci_en1_gpio",
		"lcd_mipi_err_en0_gpio", "lcd_mipi_err_en1_gpio";
		/* #endif */ /* OPLUS_ARCH_EXTENDS */
	pinctrl-0 = <&mtkfb_pins_lcd_bias_enp1>;
	pinctrl-1 = <&mtkfb_pins_lcd_bias_enp0>;
	pinctrl-2 = <&mtkfb_pins_lcd_bias_enn1>;
	pinctrl-3 = <&mtkfb_pins_lcd_bias_enn0>;
	pinctrl-4 = <&mtkfb_pins_lcm_rst_out1_gpio>;
	pinctrl-5 = <&mtkfb_pins_lcm_rst_out0_gpio>;
	pinctrl-6 = <&mtkfb_pins_lcm_dsi_te>;
	pinctrl-7 = <&mtkfb_pins_lcm_mipi0_sdata>;
	pinctrl-8 = <&mtkfb_pins_lcm_mipi0_sclk>;
	pinctrl-9 = <&mtkfb_pins_lcm_mipi1_sdata>;
	pinctrl-10 = <&mtkfb_pins_lcm_mipi1_sclk>;
	pinctrl-11 = <&mtkfb_pins_lcm_mipi2_sdata>;
	pinctrl-12 = <&mtkfb_pins_lcm_mipi2_sclk>;
	pinctrl-13 = <&mtkfb_pins_lcm_mipi3_sdata>;
	pinctrl-14 = <&mtkfb_pins_lcm_mipi3_sclk>;
	pinctrl-15 = <&mtkfb_pins_lcm_mipi4_sdata>;
	pinctrl-16 = <&mtkfb_pins_lcm_mipi4_sclk>;
	/* #ifdef OPLUS_ARCH_EXTENDS */
	pinctrl-17 = <&mtkfb_pins_lcd_vci_en0>;
	pinctrl-18=  <&mtkfb_pins_lcd_vci_en1>;
	pinctrl-19=  <&mtkfb_pins_lcd_mipi_err_en0>;
	pinctrl-20=  <&mtkfb_pins_lcd_mipi_err_en1>;
	/* #endif */ /* OPLUS_ARCH_EXTENDS */
	status = "okay";
	/* #ifdef OPLUS_ARCH_EXTENDS */
	oplus_display_panelnum_support;
	oplus_display_hbm_support;
	oplus_display_fppress_support;
	oplus_display_aod_ramless_support;
	oplus_display_twelvebits_support;
	oplus_display_normal_max_brightness = <2047>;
	/* #endif */ /* OPLUS_ARCH_EXTENDS */
};

&dsi_te {
	interrupt-parent = <&pio>;
	interrupts = <43 IRQ_TYPE_EDGE_RISING 43 1>;
	status = "okay";
};
/* DISPSYS GPIO standardization end */

&i2c0 {
	clock-frequency = <400000>;
	status = "okay";
	Focaltech@38 {
		compatible = "focaltech,fts";
		reg = <0x38>;
		chip-name = "FT3518";

		/* Interrupt && Irq-gpio */
		interrupt-parent = <&pio>;
		interrupts = <1 IRQ_TYPE_EDGE_FALLING 1 0>;

		enable2v8_gpio = <&pio 4 0x1>;

		/* Other HW Resource */
		irq-gpio = <&pio 1 0x2002>;
		reset-gpio = <&pio 58 0>;
		pinctrl-names = "default";

		vid_len = <2>;
		/*TP_OFILM[0]  TP_BIEL[1]  TP_TRULY[2]  TP_BOE[3]  TP_G2Y[4]  TP_TPK[5]  TP_JDI[6]  TP_TIANMA[7]
		 *TP_SAMSUNG[8]  TP_DSJM[9]  TP_BOE_B8[10]  TP_INNOLUX[11]  TP_HIMAX_DPT[12]  TP_HIMAX_DPT[13]  TP_DEPUTE[14]
		 *TP_HUAXING[15]  TP_HLT[16]  TP_DJN[17]  TP_UNKNOWN[18]
		 */
		tp_type = <8>;
		platform_support_project = <20291 20292 20293 20294 20295>;
		platform_support_project_dir = <20291 20291 20291 20291 20291>;
		platform_support_project_commandline = "oplus20291_samsung_ams643xy01_1080p_dsi_vdo","oplus20291_samsung_ams643xy01_1080p_dsi_vdo","oplus20291_samsung_ams643xy01_1080p_dsi_vdo","oplus20291_samsung_ams643xy01_1080p_dsi_vdo","oplus20291_samsung_ams643xy01_1080p_dsi_vdo";


		touchpanel,max-num-support = <10>;
		touchpanel,tx-rx-num = <16 34>;
		touchpanel,panel-coords = <4320 9600>;
		touchpanel,display-coords = <1080 2400>;
		touchpanel,touchmajor-limit = <0 216>;
		touchpanel,smooth-level = <255 2 15 25 45 60>;
		touchpanel,sensitive-level = <255 20 14 10 6 0>;

		/* SW Support Feature Control */
		black_gesture_support;
		fw_edge_limit_support;
		pressure_report_support;
		charger_pump_support;
		game_switch_support;
		smart_gesture_support;
		fw_update_app_support;
		fingerprint_underscreen_support;
		headset_pump_support;
		esd_handle_support;
		high_resolution_support;
		health_monitor_v2_support;
		/*
		 *Virtual Key Config:
		 *1:touchpanel,button-type: <virtualkey_type  supportted_button-map>
		 *virtualkey_type:
		 *Type 1: using board_properties
		 *Type 2: using same IC (button zone&& touch zone are seprate)
		 *Type 3: using diffrent IC (button zone&& touch zone are seprate)
		 *Type 4: No need of virtual key process
		 *supportted_button-map:select|menu|home|back
		 *
		 *2:touchpanel,button-map
		 *type (X1,Y1)(X2,Y2)(X3,Y3)(Width_X,Hight_Y)--Only when button-type is 0
		 */
		touchpanel,button-type = <4>;
		touchpanel.button-TRx = <0 0>;
		tp_exit_suspend_support;
		irq_need_dev_resume_ok;
		touchpanel,msecs-to-jiffies-time = <500>;
	};
};
/*#endif OPLUS_FEATURE_TP_BASIC*/

&i2c6 {
	status = "okay";
	#address-cells = <1>;
	#size-cells = <0>;

	mt6660: mt6660@34 {
		compatible = "mediatek,mt6660";
		status = "ok";
		reg = <0x34>;
	};
};

&gpio{
	gpio_init_default = <0 0 0 0 1 1 1>,
		<1 0 0 0 1 1 1>,
		<2 0 1 0 0 0 1>,
		<3 0 0 0 1 1 1>,
		<4 0 0 0 1 0 1>,
		<5 0 0 0 0 0 1>,
		<6 0 0 0 1 0 1>,
		<7 0 0 0 1 1 1>,
		<8 0 0 0 1 1 1>,
		<9 0 0 0 1 1 1>,
		<10 0 0 0 1 0 1>,
		<11 0 0 0 1 1 1>,
		<12 0 1 0 0 0 0>,
		<13 0 1 0 0 0 0>,
		<14 0 1 0 0 0 0>,
		<15 0 1 0 0 0 0>,
		<16 7 0 0 1 0 0>,
		<17 7 1 0 0 0 0>,
		<18 7 0 0 1 0 0>,
		<19 7 0 0 1 0 0>,
		<20 7 0 0 1 0 0>,
		<21 3 1 0 0 0 0>,
		<22 0 1 1 0 0 0>,
		<23 0 1 0 0 0 0>,
		<24 0 1 0 0 0 0>,
		<25 4 0 0 1 0 0>,
		<26 0 1 0 0 0 0>,
		<28 1 0 0 1 1 1>,
		<29 1 0 0 1 1 1>,
		<30 0 1 0 0 0 0>,
		<31 0 1 0 0 0 0>,
		<32 0 1 0 0 0 0>,
		<33 0 0 0 1 0 0>,
		<34 0 1 0 0 0 0>,
		<35 0 0 0 1 0 0>,
		<36 0 1 1 0 0 0>,
		<37 6 0 0 1 0 0>,
		<38 6 1 0 0 0 0>,
		<39 6 0 0 1 0 0>,
		<40 6 0 0 1 0 0>,
		<41 6 0 0 1 0 0>,
		<42 1 1 0 0 0 0>,
		<43 1 0 0 1 0 0>,
		<44 0 1 0 0 0 0>,
		<45 1 0 0 1 1 1>,
		<46 1 0 0 1 1 1>,
		<47 1 0 0 1 0 0>,
		<48 1 1 0 0 0 0>,
		<49 1 1 0 0 0 0>,
		<50 1 1 0 0 0 0>,
		<51 1 0 0 1 1 1>,
		<52 1 0 0 1 1 1>,
		<53 1 0 0 1 1 0>,
		<54 1 1 0 0 0 0>,
		<55 1 0 0 1 1 1>,
		<56 1 0 0 1 1 1>,
		<57 0 0 0 1 0 0>,
		<58 0 0 0 1 0 0>,
		<59 1 0 0 1 1 0>,
		<60 1 0 0 1 1 0>,
		<61 2 0 0 1 1 1>,
		<62 2 0 0 1 1 1>,
		<63 2 0 0 1 0 0>,
		<64 2 1 0 0 0 0>,
		<65 2 1 0 0 0 0>,
		<66 2 1 0 0 0 0>,
		<67 1 1 0 0 0 1>,
		<68 1 1 0 0 0 1>,
		<69 0 0 0 1 1 1>,
		<70 1 0 0 1 0 0>,
		<71 1 1 0 0 0 1>,
		<72 1 0 0 1 0 0>,
		<73 3 0 0 1 0 0>,
		<74 3 0 0 1 0 0>,
		<75 1 0 0 1 0 0>,
		<76 1 0 0 1 0 0>,
		<77 1 0 0 1 0 0>,
		<78 1 0 0 1 0 0>,
		<79 1 0 0 1 0 0>,
		<80 1 0 0 1 0 0>,
		<81 1 0 0 1 0 0>,
		<82 1 0 0 1 0 0>,
		<83 1 0 0 1 0 0>,
		<84 1 0 0 1 0 0>,
		<85 1 0 0 1 0 0>,
		<86 1 0 0 1 0 0>,
		<87 1 0 0 1 0 0>,
		<88 1 0 0 1 0 0>,
		<89 1 0 0 1 0 0>,
		<90 1 0 0 1 0 0>,
		<91 1 0 0 1 0 0>,
		<92 1 0 0 1 0 0>,
		<93 1 0 0 1 0 0>,
		<94 1 0 0 1 0 0>,
		<95 1 0 0 1 0 0>,
		<96 1 0 0 1 0 0>,
		<97 1 0 0 1 0 0>,
		<98 1 0 0 1 0 0>,
		<99 1 0 0 1 0 0>,
		<100 1 0 0 1 0 0>,
		<101 1 0 0 1 0 0>,
		<102 1 0 0 1 0 0>,
		<103 1 0 0 1 0 0>,
		<104 1 0 0 1 0 0>,
		<105 1 0 0 1 0 0>,
		<106 1 0 0 1 0 0>,
		<107 1 0 0 1 0 0>,
		<108 1 0 0 1 0 0>,
		<109 1 0 0 1 0 0>,
		<110 1 0 0 1 1 1>,
		<111 1 0 0 1 1 1>,
		<112 1 0 0 1 1 1>,
		<113 1 0 0 1 1 1>,
		<114 0 1 0 0 0 0>,
		<115 0 1 0 0 0 0>,
		<116 1 1 0 0 0 0>,
		<117 1 1 0 0 0 0>,
		<118 0 1 0 0 0 0>,
		<119 0 1 0 0 0 0>,
		<120 1 1 0 0 0 0>,
		<121 1 1 0 0 0 0>,
		<122 0 1 0 0 0 0>,
		<123 0 1 0 0 0 0>,
		<124 0 1 0 0 0 0>,
		<125 0 1 0 0 0 0>,
		<126 0 1 0 0 0 0>,
		<127 1 0 0 1 0 0>,
		<128 1 0 0 1 1 1>,
		<129 1 1 0 0 0 1>,
		<130 1 1 0 0 0 1>,
		<131 1 1 0 0 0 1>,
		<132 1 1 0 0 0 1>,
		<133 1 0 0 1 1 1>,
		<134 1 1 0 0 0 1>,
		<135 1 0 0 1 1 1>,
		<136 1 0 0 1 1 1>,
		<137 1 0 0 1 1 1>,
		<138 1 0 0 1 1 1>,
		<139 1 0 0 1 1 1>,
		<140 1 0 0 1 1 1>,
		<141 1 0 0 1 1 1>,
		<142 1 1 0 0 0 0>,
		<143 1 1 0 0 0 1>,
		<144 1 1 0 0 0 1>,
		<145 1 1 0 0 0 1>,
		<146 1 0 0 1 0 1>,
		<147 0 1 0 0 0 0>,
		<148 0 0 0 1 0 0>,
		<149 0 0 0 1 0 0>,
		<150 1 1 0 0 0 0>,
		<151 1 1 0 0 0 0>,
		<152 0 0 0 1 0 0>,
		<153 0 0 0 1 0 0>,
		<154 0 0 0 1 0 0>,
		<155 0 0 0 1 0 0>,
		<156 1 1 0 0 0 0>,
		<157 1 1 0 0 0 0>,
		<158 1 1 0 0 0 0>,
		<159 1 1 0 0 0 0>,
		<160 1 1 0 0 0 0>,
		<161 1 1 0 0 0 0>,
		<162 1 1 0 0 0 0>,
		<163 1 1 0 0 0 0>,
		<164 1 1 0 0 0 0>,
		<165 1 1 0 0 0 0>,
		<166 1 1 0 0 0 0>,
		<179 1 0 0 1 0 0>,
		<180 1 0 0 1 0 0>,
		<181 1 1 0 0 0 0>,
		<182 1 1 0 0 0 0>,
		<183 1 1 0 0 0 0>,
		<184 1 0 0 1 0 0>,
		<185 1 1 0 0 0 0>,
		<186 1 0 0 1 0 0>,
		<187 1 1 0 0 0 0>,
		<188 1 0 0 1 0 1>,
		<189 1 1 0 0 0 1>,
		<190 1 1 0 0 0 1>,
		<191 1 1 0 0 0 1>,
		<192 1 1 0 0 0 1>,
		<193 1 0 0 1 0 1>,
		<194 1 0 0 1 0 1>,
		<195 0 1 0 0 0 0>,
		<196 1 1 0 0 0 0>,
		<197 0 1 0 0 0 0>,
		<198 1 0 0 1 1 1>,
		<199 1 0 0 1 1 1>,
		<200 1 0 0 1 1 0>,
		<201 1 1 0 0 0 0>,
		<202 0 1 0 0 0 0>,
		<203 0 0 0 1 0 0>,
		<204 0 0 0 1 0 0>,
		<205 0 0 0 1 0 0>,
		<206 0 0 0 1 0 0>,
		<207 0 0 0 1 0 0>,
		<208 0 0 0 1 0 0>,
		<209 0 0 0 1 0 0>;
};

/* CONSYS GPIO standardization */
&pio {
	consys_pins_default: consys_default {
	};
	gpslna_pins_init: gpslna@0 {
		pins_cmd_dat {
			pinmux = <PINMUX_GPIO147__FUNC_GPIO147>;
			slew-rate = <0>;
			bias-disable;
			output-low;
		};
	};
	gpslna_pins_oh: gpslna@1 {
		pins_cmd_dat {
			pinmux = <PINMUX_GPIO147__FUNC_GPIO147>;
			slew-rate = <1>;
			output-high;
		};
	};
	gpslna_pins_ol: gpslna@2 {
		pins_cmd_dat {
			pinmux = <PINMUX_GPIO147__FUNC_GPIO147>;
			slew-rate = <1>;
			output-low;
		};
	};
};
&consys {
	pinctrl-names = "default",
			"gps_lna_state_init",
			"gps_lna_state_oh",
			"gps_lna_state_ol";
	pinctrl-0 = <&consys_pins_default>;
	pinctrl-1 = <&gpslna_pins_init>;
	pinctrl-2 = <&gpslna_pins_oh>;
	pinctrl-3 = <&gpslna_pins_ol>;
	status = "okay";
};
/* CONSYS end */

&bat_gm30 {
	extcon = <&mt6360_chg>;
	charger = <&mt6360_chg>;
};

/* MD SIM GPIO */
&gpio_usage_mapping {
	compatible = "mediatek,gpio_usage_mapping";
	GPIO_FDD_BAND_SUPPORT_DETECT_1ST_PIN = <&pio 5 0>;
	GPIO_SIM1_SIO = <&pio 128 0>;
	GPIO_SIM1_SRST = <&pio 129 0>;
	GPIO_SIM1_SCLK = <&pio 130 0>;
	GPIO_SIM2_SCLK = <&pio 131 0>;
	GPIO_SIM2_SRST = <&pio 132 0>;
	GPIO_SIM2_SIO = <&pio 133 0>;
	GPIO_SIM1_HOT_PLUG = <&pio 140 0>;
	GPIO_SIM2_HOT_PLUG = <&pio 141 0>;
};

&md1_sim1_hot_plug_eint {
	compatible = "mediatek,md1_sim1_hot_plug_eint-eint";
	interrupts = <0 4>;
	debounce = <0 50000>;
	dedicated = <0 0>;
	src_pin = <0 1>;
	sockettype = <0 0>;
	status = "okay";
};

&md1_sim2_hot_plug_eint {
	compatible = "mediatek,md1_sim2_hot_plug_eint-eint";
	interrupts = <1 4>;
	debounce = <1 50000>;
	dedicated = <1 0>;
	src_pin = <1 2>;
	sockettype = <1 0>;
	status = "okay";
};

&mt6360_typec {
	mt6360pd,intr_gpio_num = <9>; /* direct defined GPIO num */
	mt6360pd,intr_gpio = <&pio 9 0x0>;
};

&mtk_gauge {
	FUELGAGUE_APPLY = <(1)>;
	Enable_Battery_Temp_Compensation = <(1)>;
        Enable_Is_Force_Full = <1>;
	R_FG_VALUE_EXT = <(5)>;
	FG_METER_RESISTANCE_EXT = <(60)>;
	COM_FG_METER_RESISTANCE_EXT = <(60)>;
	CAR_TUNE_VALUE_EXT = <(98)>;
	TEMPERATURE_T4_EXT = <(-10)>;
	g_FG_PSEUDO100_T0_EXT = <(98)>;
	g_FG_PSEUDO100_T1_EXT = <(98)>;
	g_FG_PSEUDO100_T2_EXT = <(98)>;
	g_FG_PSEUDO100_T3_EXT = <(94)>;
	g_FG_PSEUDO100_T4_EXT = <(92)>;
	//ACTIVE_TABLE_EXT = <(0)>;
	g_PMIC_MIN_VOL_EXT =
	<
	33500  33500  33500  33500
	33500  33500  33500  33500
	33000  33000  33000  33000
	32500  32500  32500  32500
	31500  31000  31000  31000
	31000  31000  31000  31000
	31000  31000  31000  31000
	31000  31000  31000  31000
	31000  31000  31000  31000
	31000  31000  31000  31200
	>;
	g_QMAX_SYS_VOL_EXT =
	<
	33500  33500  33500  33500
	32300  32300  32300  32300
	32800  32800  32800  32800
	33000  33000  33000  33000
	33500  33500  33500  33500
	32500  32500  32500  32500
	32800  32800  32800  32800
	32800  32800  32800  32800
	32800  32800  32800  32800
	32800  32800  32800  32800
	>;
	g_FG_PSEUDO100_EXT =
	<
	98   98   98   98
	98   98   98   98
	98   98   98   98
	94   94   94   94
	92   92   92   92
	100  100  100  100
	100  100  100  100
	100  100  100  100
	100  100  100  100
	100  100  100  100
	>;
#include "mediatek/bat_setting/mt6779_battery_prop_dim2_ext.dtsi"
};

&odm {
	vooc_ap_data:vooc_ap_data {
		compatible = "mediatek, VOOC_AP_DATA-eint";
		interrupts = <14 IRQ_TYPE_EDGE_FALLING 14 0>;
	};
	vooc_ap_data_new_function:vooc_ap_data_new_function {
		compatible = "mediatek, VOOC_EINT_NEW_FUNCTION";
	};
};

/*#ifdef OPLUS_FEATURE_CHG_BASIC*/
&lk_charger{
	support_tuv_authentication;
};
/*#endif*/

//#ifdef OPLUS_FEATURE_CHG_BASIC
&mediatek_phy_tuning {
	phy_tuning {
		compatible = "mediatek,phy_tuning";
		eye-vrt = <7>;
		eye-term = <7>;
		eye-rev6 = <2>;
		eye-disc = <0x1c>;
		host-eye-vrt = <6>;
		host-eye-term = <6>;
		host-eye-rev6 = <2>;
		host-eye-disc = <0x1c>;
	};
};
//#endif
&charger {
	io-channels = <&auxadc 2>,<&auxadc 4>,
		<&auxadc 5>;
	io-channel-names = "auxadc2-usb_temp_v_l","auxadc4-chg_temp",
		"auxadc5-usb_temp_v_r";
	pinctrl-names = "default", "charger_gpio_as_output_low", "charger_gpio_as_output_high",
									"ship_sleep", "ship_active", "dischg_enable", "dischg_disable";
	pinctrl-0 = <&charger_pins_default>;
	pinctrl-1 = <&charger_pins_eint_output0>;
	pinctrl-2 = <&charger_pins_eint_output1>;
	pinctrl-3 = <&ship_sleep_gpio>;
	pinctrl-4 = <&ship_active_gpio>;
	pinctrl-5 = <&dischg_enable>;
	pinctrl-6 = <&dischg_disable>;
	//pinctrl-5 = <&shortc_active_gpio>;

	//for oplus chg framework:
	qcom,pd_input_current_charger_ma = <3000>;
	qcom,input_current_charger_ma = <2000>;
	qcom,input_current_usb_ma = <500>;

	qcom,input_current_led_ma = <1200>;
	qcom,input_current_led_ma_high = <1200>;
	qcom,input_current_led_ma_warm = <1500>;
	qcom,input_current_led_ma_normal = <2000>;
	qcom,led_warm_bat_decidegc = <350>;
	qcom,led_high_bat_decidegc = <370>;
	qcom,input_current_led_ma_forcmcc = <500>;

	qcom,input_current_camera_ma = <1200>;
	qcom,input_current_calling_ma = <1500>;
	qcom,input_current_cdp_ma = <1500>;
	qcom,overtemp_bat_decidegc = <350>;
	qcom,iterm_disabled = <0>;
	sw_full_count = <25>;
	qcom,iterm_ma = <225>;
	qcom,recharge-mv = <100>;

	qcom,batt_capacity_mah = <4310>; /*typical capacity*/
	//qcom,batt_capacity_mah = <4220>; /*rated capacity*/

	qcom,usb_high_than_bat_decidegc = <168>;

	qcom,removed_bat_decidegc = <190>;  /* < -19C */

	qcom,cold_bat_decidegc = <20>;  /* -2C ~ 0C */
	qcom,temp_cold_vfloat_mv = <3980>;
	qcom,temp_cold_fastchg_current_ma = <314>;

	qcom,little_cold_bat_decidegc = <0>;	/* 0C ~ 5C */
	qcom,temp_little_cold_vfloat_mv = <4435>;
	qcom,temp_little_cold_fastchg_current_ma_high = <1850>;
	qcom,temp_little_cold_fastchg_current_ma_low = <1100>;
	qcom,pd_temp_little_cold_fastchg_current_ma_high = <1850>;
	qcom,pd_temp_little_cold_fastchg_current_ma_low = <1100>;
	qcom,temp_little_cold_fastchg_current_ma = <1100>;

	qcom,cool_bat_decidegc = <50>;	/* 5C ~ 12C */
	qcom,temp_cool_vfloat_mv = <4435>;
	qcom,temp_cool_fastchg_current_ma_high = <2200>;
	qcom,temp_cool_fastchg_current_ma_low = <1850>;
	qcom,pd_temp_cool_fastchg_current_ma_high = <2600>;
	qcom,pd_temp_cool_fastchg_current_ma_low = <1850>;

	qcom,little_cool_bat_decidegc = <120>;	/* 12C ~ 16C */
	qcom,temp_little_cool_vfloat_mv = <4435>;
	qcom,temp_little_cool_fastchg_current_ma = <2200>;
	qcom,pd_temp_little_cool_fastchg_current_ma = <3000>;

	qcom,normal_bat_decidegc = <160>;	/* 16C ~ 45C */
	qcom,temp_normal_fastchg_current_ma = <2200>;
	qcom,temp_normal_vfloat_mv = <4435>;
	qcom,pd_temp_normal_fastchg_current_ma = <3000>;

	qcom,warm_bat_decidegc = <450>;		/* 45C ~ 53C */ /*8pin Bat Vooc project need add 3 degree C*/
	qcom,temp_warm_vfloat_mv = <4130>;
	qcom,temp_warm_fastchg_current_ma = <1100>;
	qcom,pd_temp_warm_fastchg_current_ma = <1100>;
	qcom,temp_warm_fastchg_current_ma_led_on = <500>;

	qcom,hot_bat_decidegc = <530>;  /* > 53C */

	qcom,non_standard_vfloat_mv = <3980>;
	qcom,non_standard_fastchg_current_ma = <512>;

	qcom,short_c_bat_cv_mv = <4330>;
	qcom,short_c_bat_vfloat_mv = <3800>;
	qcom,short_c_bat_fastchg_current_ma = <512>;
	qcom,short_c_bat_vfloat_sw_limit = <3750>;

	qcom,cold_vfloat_sw_limit = <3930>;
	qcom,little_cold_vfloat_sw_limit = <4385>;
	qcom,cool_vfloat_sw_limit = <4385>;
	qcom,little_cool_vfloat_sw_limit = <4385>;
	qcom,normal_vfloat_sw_limit = <4385>;
	qcom,warm_vfloat_sw_limit = <4080>;
	qcom,non_standard_vfloat_sw_limit = <3930>;

	qcom,max_chg_time_sec = <36000>;
	qcom,charger_hv_thr = <5800>;
	qcom,charger_lv_thr = <3400>;
	qcom,vbatt_full_thr = <4450>;
	qcom,vbatt_hv_thr = <4550>;

	qcom,vfloat_step_mv = <8>;
	qcom,non_standard_vfloat_over_sw_limit = <3990>;
	qcom,cold_vfloat_over_sw_limit = <3990>;
	qcom,little_cold_vfloat_over_sw_limit = <4445>;
	qcom,cool_vfloat_over_sw_limit = <4445>;
	qcom,little_cool_vfloat_over_sw_limit = <4445>;
	qcom,normal_vfloat_over_sw_limit = <4445>;
	qcom,warm_vfloat_over_sw_limit = <4140>;

	qcom,vbatt_power_off = <3300>;
	qcom,vbatt_soc_1 = <3410>;
	qcom,vooc_project = <1>;
	qcom,vbatt_num = <1>;
	qcom,internal_gauge_with_asic = <1>;
	qcom,smart_charging_screenoff;
	qcom,smart_charge_version = <1>;

	qcom,normal_vterm_hw_inc = <18>;
	qcom,non_normal_vterm_hw_inc = <18>;
	qcom,usbtemp_batttemp_gap = <18>;

	qcom,vooc_show_ui_soc_decimal;
	qcom,ui_soc_decimal_speedmin = <20>;//2A

	qcom,ff1_normal_fastchg_ma = <1400>;
	qcom,ff1_warm_fastchg_ma = <1500>;	/* 35C ~ 40c */
	qcom,ff1_exit_step_ma = <150>;
	qcom,ff1_warm_exit_step_ma = <150>;
	qcom,ffc2_normal_fastchg_ma = <1400>;/*12C~35c*/
	qcom,ffc2_warm_fastchg_ma = <1500>;	/* 35C ~ 40c */
	qcom,ffc2_temp_warm_decidegc = <350>;
	qcom,ffc2_temp_high_decidegc = <400>;
	qcom,ffc2_temp_low_decidegc = <160>;
	qcom,ffc2_exit_step_ma = <150>;
	qcom,ffc2_warm_exit_step_ma = <150>;

	qcom,ffc_normal_vfloat_sw_limit = <4485>;
	qcom,ffc2_normal_vfloat_sw_limit = <4485>;
	qcom,ffc_temp_normal_vfloat_mv = <4550>;
	qcom,ffc_normal_vfloat_over_sw_limit = <4550>;

	qcom,default_iterm_ma = <225>;
	qcom,default_temp_normal_fastchg_current_ma = <2200>;
	qcom,default_normal_vfloat_sw_limit = <4385>;
	qcom,default_temp_normal_vfloat_mv = <4435>;
	qcom,default_normal_vfloat_over_sw_limit = <4445>;

	qcom,default_temp_little_cool_fastchg_current_ma = <2200>;
	qcom,default_little_cool_vfloat_sw_limit = <4385>;
	qcom,default_temp_little_cool_vfloat_mv = <4435>;
	qcom,default_little_cool_vfloat_over_sw_limit = <4445>;

	//for control:
	//qcom,suspend_after_full;
	qcom,check_batt_full_by_sw;
	qcom,external_gauge;
	qcom,chg_ctrl_by_lcd;
	qcom,chg_ctrl_by_camera;
	qcom,sw_vfloat_over_protect_enable;
	qcom,ffc_support;
	qcom,chargerid_vol_disable;
	qcom,support_ntc_01c_precision;

	//GPIO config:
	qcom,chargerid_switch-gpio = <&pio 38 0x00>;
	qcom,ship-gpio = <&pio 69 0x00>;
	qcom,dischg-gpio = <&pio 35 0x00>;
	//qcom,shortc-gpio = <&pio 121 0x00>;
};

&i2c7 {
	clock-frequency = <100000>;
	
	rt5125-fastcg@0e{
		status = "okay";
		compatible = "oplus,rt5125-fastcg";
		reg = <0x0e>;
		qcom,vooc_reply_mcu_bits = <7>;
		qcom,vooc-low-temp = <0>;
		qcom,oplus_batt_4400mv;
		qcom,vooc_fw_update_newmethod;
		qcom,vooc-fw-type = <7>;
		qcom,vooc_is_platform_gauge;
                
		qcom,vooc-high-temp = <430>;
		qcom,vooc-low-soc = <1>;
		qcom,vooc-high-soc = <90>;

		qcom,vooc_cool_bat_volt = <3650>;
		qcom,vooc_little_cool_bat_volt = <3550>;
		qcom,vooc_normal_bat_volt = <3450>;
		qcom,vooc_warm_bat_volt = <3350>;

		qcom,vooc_cool_bat_suspend_volt = <3650>;
		qcom,vooc_little_cool_bat_suspend_volt = <3550>;
		qcom,vooc_normal_bat_suspend_volt = <3450>;
		qcom,vooc_warm_bat_suspend_volt = <3350>;

		qcom,vooc_multistep_adjust_current_support;
		qcom,vooc_multistep_initial_batt_temp = <1000>;
		qcom,vooc_strategy_normal_current = <0x0b>;

		qcom,vooc_strategy1_batt_high_temp0 = <410>;
		qcom,vooc_strategy1_batt_high_temp1 = <425>;
		qcom,vooc_strategy1_batt_high_temp2 = <435>;
		qcom,vooc_strategy1_batt_low_temp2 = <430>;
		qcom,vooc_strategy1_batt_low_temp1 = <410>;
		qcom,vooc_strategy1_batt_low_temp0 = <390>;

		qcom,vooc_strategy1_high_current0 = <0x07>;//4A
		qcom,vooc_strategy1_high_current1 = <0x05>;//3A
		qcom,vooc_strategy1_high_current2 = <0x04>;//2A
		qcom,vooc_strategy1_low_current2 = <0x05>;//3A
		qcom,vooc_strategy1_low_current1 = <0x09>;//5A
		qcom,vooc_strategy1_low_current0 = <0x0b>;//6A

/*
		qcom,vooc_strategy2_batt_up_temp1 = <370>;
		qcom,vooc_strategy2_batt_up_down_temp2 = <380>;
		qcom,vooc_strategy2_batt_up_temp3 = <390>;
		qcom,vooc_strategy2_batt_up_down_temp4 = <395>;
		qcom,vooc_strategy2_batt_up_temp5 = <400>;
		qcom,vooc_strategy2_batt_up_temp6 = <415>;
		qcom,vooc_strategy2_high0_current = <0x06>;
		qcom,vooc_strategy2_high1_current = <0x06>;
		qcom,vooc_strategy2_high2_current = <0x06>;
		qcom,vooc_strategy2_high3_current = <0x06>;
*/
		
		qcom,vooc_current_lvl = <1000
								1500
								2000
								2500
								3000
								3500
								4000
								4500
								5000
								5500
								6000
								6500
								7000
								7500
								8000
								8500
								9000
								9500
								10000
								10500
								11000
								11500
								12000
								12500>;

		pinctrl-names = "switch1_act_switch2_act", "switch1_sleep_switch2_sleep",
						"switch1_act_switch3_act", "switch1_sleep_switch3_sleep",
						"switch1_act_switch2_sleep", "switch1_sleep_switch2_act",
						"clock_active","clock_sleep",
						"data_active","data_sleep",
						"reset_active","reset_sleep",
						"charging_switch1_ctr1_active","charging_switch1_ctr1_sleep",
						"vooc_asic_id_active","vooc_asic_id_sleep";
		pinctrl-0 = <&charging_switch1_active>;
		pinctrl-1 = <&charging_switch1_sleep>;
		pinctrl-2 = <&charging_switch1_active>;
		pinctrl-3 = <&charging_switch1_sleep>;
		pinctrl-4 = <&charging_switch1_active>;
		pinctrl-5 = <&charging_switch1_sleep>;
		pinctrl-6 = <&charging_clock_active>;
		pinctrl-7 = <&charging_clock_sleep>;
		pinctrl-8 = <&charging_data_active>;
		pinctrl-9 = <&charging_data_sleep>;
		pinctrl-10 = <&charging_reset_active>;
		pinctrl-11 = <&charging_reset_sleep>;
		pinctrl-12 = <&charging_switch1_ctr1_active>;
		pinctrl-13 = <&charging_switch1_ctr1_sleep>;
		pinctrl-14 = <&vooc_asic_id_active>;
		pinctrl-15 = <&vooc_asic_id_sleep>;

		qcom,charging_switch1-gpio 		= <&pio 74 0x00>;
		qcom,charging_switch1_ctr1-gpio 	= <&pio 148 0x00>;
		//qcom,charging_switch2-gpio 		= <&tlmm 113 0x00>;
		//qcom,charging_switch3-gpio 		= <&tlmm 38 0x00>;

		qcom,charging_reset-gpio 		= <&pio 21 0x00>;
		qcom,charging_clock-gpio 		= <&pio 15 0x00>;
		qcom,charging_data-gpio 		= <&pio 14 0x00>;
		qcom,vooc_asic_id-gpio			= <&pio 73 0x00>;
	};

	rk826_fastcg@0a{
		status = "okay";
		compatible = "oplus,rk826-fastcg";
		reg = <0x0a 0>;
		qcom,vooc_reply_mcu_bits = <7>;
		qcom,vooc-low-temp = <0>;
		qcom,oplus_batt_4400mv;
		qcom,vooc_fw_update_newmethod;
		qcom,vooc-fw-type = <7>;
		qcom,vooc_is_platform_gauge;
		
		qcom,vooc-high-temp = <430>;
		qcom,vooc-low-soc = <1>;
		qcom,vooc-high-soc = <90>;

		qcom,vooc_cool_bat_volt = <3650>;
		qcom,vooc_little_cool_bat_volt = <3550>;
		qcom,vooc_normal_bat_volt = <3450>;
		qcom,vooc_warm_bat_volt = <3350>;

		qcom,vooc_cool_bat_suspend_volt = <3650>;
		qcom,vooc_little_cool_bat_suspend_volt = <3550>;
		qcom,vooc_normal_bat_suspend_volt = <3450>;
		qcom,vooc_warm_bat_suspend_volt = <3350>;

		qcom,vooc_multistep_adjust_current_support;
		qcom,vooc_multistep_initial_batt_temp = <1000>;
		qcom,vooc_strategy_normal_current = <0x0b>;

		qcom,vooc_strategy1_batt_high_temp0 = <410>;
		qcom,vooc_strategy1_batt_high_temp1 = <425>;
		qcom,vooc_strategy1_batt_high_temp2 = <435>;
		qcom,vooc_strategy1_batt_low_temp2 = <430>;
		qcom,vooc_strategy1_batt_low_temp1 = <410>;
		qcom,vooc_strategy1_batt_low_temp0 = <390>;

		qcom,vooc_strategy1_high_current0 = <0x07>;//4A
		qcom,vooc_strategy1_high_current1 = <0x05>;//3A
		qcom,vooc_strategy1_high_current2 = <0x04>;//2A
		qcom,vooc_strategy1_low_current2 = <0x05>;//3A
		qcom,vooc_strategy1_low_current1 = <0x09>;//5A
		qcom,vooc_strategy1_low_current0 = <0x0b>;//6A

/*
		qcom,vooc_strategy2_batt_up_temp1 = <370>;
		qcom,vooc_strategy2_batt_up_down_temp2 = <380>;
		qcom,vooc_strategy2_batt_up_temp3 = <390>;
		qcom,vooc_strategy2_batt_up_down_temp4 = <395>;
		qcom,vooc_strategy2_batt_up_temp5 = <400>;
		qcom,vooc_strategy2_batt_up_temp6 = <415>;
		qcom,vooc_strategy2_high0_current = <0x06>;
		qcom,vooc_strategy2_high1_current = <0x06>;
		qcom,vooc_strategy2_high2_current = <0x06>;
		qcom,vooc_strategy2_high3_current = <0x06>;
*/

		qcom,vooc_current_lvl = <1000
								1500
								2000
								2500
								3000
								3500
								4000
								4500
								5000
								5500
								6000
								6500
								7000
								7500
								8000
								8500
								9000
								9500
								10000
								10500
								11000
								11500
								12000
								12500>;

		pinctrl-names = "switch1_act_switch2_act", "switch1_sleep_switch2_sleep",
						"switch1_act_switch3_act", "switch1_sleep_switch3_sleep",
						"switch1_act_switch2_sleep", "switch1_sleep_switch2_act",
						"clock_active","clock_sleep",
						"data_active","data_sleep",
						"reset_active","reset_sleep",
						"charging_switch1_ctr1_active","charging_switch1_ctr1_sleep",
						"vooc_asic_id_active","vooc_asic_id_sleep";
		pinctrl-0 = <&charging_switch1_active>;
		pinctrl-1 = <&charging_switch1_sleep>;
		pinctrl-2 = <&charging_switch1_active>;
		pinctrl-3 = <&charging_switch1_sleep>;
		pinctrl-4 = <&charging_switch1_active>;
		pinctrl-5 = <&charging_switch1_sleep>;
		pinctrl-6 = <&charging_clock_active>;
		pinctrl-7 = <&charging_clock_sleep>;
		pinctrl-8 = <&charging_data_active>;
		pinctrl-9 = <&charging_data_sleep>;
		pinctrl-10 = <&charging_reset_active>;
		pinctrl-11 = <&charging_reset_sleep>;
		pinctrl-12 = <&charging_switch1_ctr1_active>;
		pinctrl-13 = <&charging_switch1_ctr1_sleep>;
		pinctrl-14 = <&vooc_asic_id_active>;
		pinctrl-15 = <&vooc_asic_id_sleep>;

		qcom,charging_switch1-gpio 		= <&pio 74 0x00>;
		qcom,charging_switch1_ctr1-gpio 	= <&pio 148 0x00>;
		//qcom,charging_switch2-gpio 		= <&tlmm 113 0x00>;
		//qcom,charging_switch3-gpio 		= <&tlmm 38 0x00>;

		qcom,charging_reset-gpio 		= <&pio 21 0x00>;
		qcom,charging_clock-gpio 		= <&pio 15 0x00>;
		qcom,charging_data-gpio 		= <&pio 14 0x00>;
		qcom,vooc_asic_id-gpio			= <&pio 73 0x00>;
	};

	op10_fastcg@06{
		status = "okay";
		compatible = "oplus,op10-fastcg";
		reg = <0x06 0>;
		qcom,vooc-low-temp = <50>;
		qcom,oplus_batt_4400mv;
		qcom,vooc_fw_update_newmethod;
		qcom,vooc-fw-type = <3>;
		
		qcom,vooc-high-temp = <430>;
		qcom,vooc-low-soc = <1>;
		qcom,vooc-high-soc = <85>;

		qcom,vooc_multistep_adjust_current_support;
		qcom,vooc_multistep_initial_batt_temp = <1000>;
		qcom,vooc_strategy_normal_current = <0x06>;

		qcom,vooc-normal-to-little-cool-current = <0x04>;
		qcom,vooc_strategy1_batt_high_temp0 = <410>;
		qcom,vooc_strategy1_batt_high_temp1 = <425>;
		qcom,vooc_strategy1_batt_high_temp2 = <435>;
		qcom,vooc_strategy1_batt_low_temp2 = <430>;
		qcom,vooc_strategy1_batt_low_temp1 = <410>;
		qcom,vooc_strategy1_batt_low_temp0 = <390>;

		qcom,vooc_strategy1_high_current0 = <0x04>;//4A
		qcom,vooc_strategy1_high_current1 = <0x03>;//3A
		qcom,vooc_strategy1_high_current2 = <0x02>;//2A
		qcom,vooc_strategy1_low_current2 = <0x03>;//3A
		qcom,vooc_strategy1_low_current1 = <0x05>;//5A
		qcom,vooc_strategy1_low_current0 = <0x06>;//6A

		qcom,vooc_strategy2_batt_up_temp1 = <370>;
		qcom,vooc_strategy2_batt_up_down_temp2 = <380>;
		qcom,vooc_strategy2_batt_up_temp3 = <390>;
		qcom,vooc_strategy2_batt_up_down_temp4 = <395>;
		qcom,vooc_strategy2_batt_up_temp5 = <400>;
		qcom,vooc_strategy2_batt_up_temp6 = <415>;
		qcom,vooc_strategy2_high0_current = <0x06>;
		qcom,vooc_strategy2_high1_current = <0x06>;
		qcom,vooc_strategy2_high2_current = <0x06>;
		qcom,vooc_strategy2_high3_current = <0x06>;

		pinctrl-names = "switch1_act_switch2_act", "switch1_sleep_switch2_sleep",
						"switch1_act_switch3_act", "switch1_sleep_switch3_sleep",
						"switch1_act_switch2_sleep", "switch1_sleep_switch2_act",
						"clock_active","clock_sleep",
						"data_active","data_sleep",
						"reset_active","reset_sleep",
						"charging_switch1_ctr1_active","charging_switch1_ctr1_sleep",
						"vooc_asic_id_active","vooc_asic_id_sleep";
		pinctrl-0 = <&charging_switch1_active>;
		pinctrl-1 = <&charging_switch1_sleep>;
		pinctrl-2 = <&charging_switch1_active>;
		pinctrl-3 = <&charging_switch1_sleep>;
		pinctrl-4 = <&charging_switch1_active>;
		pinctrl-5 = <&charging_switch1_sleep>;
		pinctrl-6 = <&charging_clock_active>;
		pinctrl-7 = <&charging_clock_sleep>;
		pinctrl-8 = <&charging_data_active>;
		pinctrl-9 = <&charging_data_sleep>;
		pinctrl-10 = <&charging_reset_active>;
		pinctrl-11 = <&charging_reset_sleep>;
		pinctrl-12 = <&charging_switch1_ctr1_active>;
		pinctrl-13 = <&charging_switch1_ctr1_sleep>;
		pinctrl-14 = <&vooc_asic_id_active>;
		pinctrl-15 = <&vooc_asic_id_sleep>;

		qcom,charging_switch1-gpio 		= <&pio 74 0x00>;
		qcom,charging_switch1_ctr1-gpio 	= <&pio 148 0x00>;
		//qcom,charging_switch2-gpio 		= <&tlmm 113 0x00>;
		//qcom,charging_switch3-gpio 		= <&tlmm 38 0x00>;

		qcom,charging_reset-gpio 			= <&pio 21 0x00>;
		qcom,charging_clock-gpio 			= <&pio 15 0x00>;
		qcom,charging_data-gpio 			= <&pio 14 0x00>;
		qcom,vooc_asic_id-gpio				= <&pio 73 0x00>;
	};

	n76e_fastcg@52{
		status = "okay";
		compatible = "oplus,n76e-fastcg";
		reg = <0x52 0>;
		qcom,vooc-low-temp = <120>;
		qcom,oplus_batt_4400mv;
		//qcom,vooc_fw_update_newmethod;
		qcom,vooc-fw-type = <2>;

		pinctrl-names = "switch1_act_switch2_act", "switch1_sleep_switch2_sleep",
						"switch1_act_switch3_act", "switch1_sleep_switch3_sleep",
						"switch1_act_switch2_sleep", "switch1_sleep_switch2_act",
						"clock_active","clock_sleep",
						"data_active","data_sleep",
						"reset_active","reset_sleep";
						//"vooc_mcu_id_default";
		pinctrl-0 = <&charging_switch1_active>;
		pinctrl-1 = <&charging_switch1_sleep>;
		pinctrl-2 = <&charging_switch1_active>;
		pinctrl-3 = <&charging_switch1_sleep>;
		pinctrl-4 = <&charging_switch1_active>;
		pinctrl-5 = <&charging_switch1_sleep>;
		pinctrl-6 = <&charging_clock_active>;
		pinctrl-7 = <&charging_clock_sleep>;
		pinctrl-8 = <&charging_data_active>;
		pinctrl-9 = <&charging_data_sleep>;
		pinctrl-10 = <&charging_reset_active>;
		pinctrl-11 = <&charging_reset_sleep>;
		//pinctrl-12 = <&vooc_mcu_id_default>;

		qcom,charging_switch1-gpio 		= <&pio 148 0x00>;
		//qcom,charging_switch2-gpio 		= <&tlmm 113 0x00>;
		//qcom,charging_switch3-gpio 		= <&tlmm 38 0x00>;

		qcom,charging_reset-gpio 			= <&pio 21 0x00>;
		qcom,charging_clock-gpio 			= <&pio 15 0x00>;
		qcom,charging_data-gpio 			= <&pio 14 0x00>;
		//qcom,vooc_mcu_id-gpio				= <&pio 196 0x00>;
	};

	stm8s_fastcg@26{
		status = "okay";
		compatible = "oplus,stm8s-fastcg";
		reg = <0x26 0>;
		qcom,vooc-low-temp = <120>;
		qcom,oplus_batt_4400mv;
		qcom,vooc_fw_update_newmethod;
		qcom,vooc-fw-type = <15>;

		qcom,vooc_multistep_adjust_current_support;
		qcom,vooc_multistep_initial_batt_temp = <1000>;
		qcom,vooc_strategy_normal_current = <0x06>;

		qcom,vooc_strategy1_batt_high_temp0 = <410>;
		qcom,vooc_strategy1_batt_high_temp1 = <425>;
		qcom,vooc_strategy1_batt_high_temp2 = <435>;
		qcom,vooc_strategy1_batt_low_temp2 = <430>;
		qcom,vooc_strategy1_batt_low_temp1 = <410>;
		qcom,vooc_strategy1_batt_low_temp0 = <390>;

		qcom,vooc_strategy1_high_current0 = <0x04>;//4A
		qcom,vooc_strategy1_high_current1 = <0x03>;//3A
		qcom,vooc_strategy1_high_current2 = <0x02>;//2A
		qcom,vooc_strategy1_low_current2 = <0x03>;//3A
		qcom,vooc_strategy1_low_current1 = <0x05>;//5A
		qcom,vooc_strategy1_low_current0 = <0x06>;//6A

		qcom,vooc_strategy2_batt_up_temp1 = <370>;
		qcom,vooc_strategy2_batt_up_down_temp2 = <380>;
		qcom,vooc_strategy2_batt_up_temp3 = <390>;
		qcom,vooc_strategy2_batt_up_down_temp4 = <395>;
		qcom,vooc_strategy2_batt_up_temp5 = <400>;
		qcom,vooc_strategy2_batt_up_temp6 = <415>;
		qcom,vooc_strategy2_high0_current = <0x06>;
		qcom,vooc_strategy2_high1_current = <0x06>;
		qcom,vooc_strategy2_high2_current = <0x06>;
		qcom,vooc_strategy2_high3_current = <0x06>;

		pinctrl-names = "switch1_act_switch2_act", "switch1_sleep_switch2_sleep",
						"switch1_act_switch3_act", "switch1_sleep_switch3_sleep",
						"switch1_act_switch2_sleep", "switch1_sleep_switch2_act",
						"clock_active","clock_sleep",
						"data_active","data_sleep",
						"reset_active","reset_sleep";
						//"vooc_mcu_id_default";
		pinctrl-0 = <&charging_switch1_active>;
		pinctrl-1 = <&charging_switch1_sleep>;
		pinctrl-2 = <&charging_switch1_active>;
		pinctrl-3 = <&charging_switch1_sleep>;
		pinctrl-4 = <&charging_switch1_active>;
		pinctrl-5 = <&charging_switch1_sleep>;
		pinctrl-6 = <&charging_clock_active>;
		pinctrl-7 = <&charging_clock_sleep>;
		pinctrl-8 = <&charging_data_active>;
		pinctrl-9 = <&charging_data_sleep>;
		pinctrl-10 = <&charging_reset_active>;
		pinctrl-11 = <&charging_reset_sleep>;
		//pinctrl-12 = <&vooc_mcu_id_default>;

		qcom,charging_switch1-gpio 		= <&pio 148 0x00>;
		//qcom,charging_switch2-gpio 		= <&tlmm 113 0x00>;
		//qcom,charging_switch3-gpio 		= <&tlmm 38 0x00>;

		qcom,charging_reset-gpio 			= <&pio 21 0x00>;
		qcom,charging_clock-gpio 			= <&pio 15 0x00>;
		qcom,charging_data-gpio 			= <&pio 14 0x00>;
		//qcom,vooc_mcu_id-gpio				= <&pio 196 0x00>;
	};
};

&pio {
	charger_pins_default: eint0default {
	};
	charger_pins_eint_output0: charger_gpio_as_output_low {
		pins_cmd_dat {
			pinmux = <PINMUX_GPIO38__FUNC_GPIO38>;
			slew-rate = <1>;
			output-low;
		};
	};
	charger_pins_eint_output1: charger_gpio_as_output_high {
		pins_cmd_dat {
			pinmux = <PINMUX_GPIO38__FUNC_GPIO38>;
			slew-rate = <1>;
			output-high;
		};
	};

	ship_sleep_gpio: ship_sleep {
		pins_cmd_dat {
			pinmux = <PINMUX_GPIO69__FUNC_GPIO69>;
			slew-rate = <1>;
			output-low;
		};
	};
	ship_active_gpio: ship_active {
		pins_cmd_dat {
			pinmux = <PINMUX_GPIO69__FUNC_GPIO69>;
			slew-rate = <1>;
			output-high;
		};
	};

	dischg_enable: dischg_enable {
		pins_cmd_dat {
			pinmux = <PINMUX_GPIO35__FUNC_GPIO35>;
			slew-rate = <1>;//0:input direction 1:output direction
			bias-pull-up;
			output-high;
		};
	};

	dischg_disable: dischg_disable {
		pins_cmd_dat {
			pinmux = <PINMUX_GPIO35__FUNC_GPIO35>;
			slew-rate = <1>;
			bias-pull-down;
			output-low;
		};
	};
/*
	shortc_active_gpio: shortc_active {
		pins_cmd_dat {
			pinmux = <PINMUX_GPIO121__FUNC_GPIO121>;
			input-enable;
			slew-rate = <0>;
			bias-pull-up;
		};
	};
*/
};

&pio {
	charging_switch1_ctr1_active: charging_switch1_ctr1_active {
		pins_cmd_dat {
			pinmux = <PINMUX_GPIO148__FUNC_GPIO148>;
			slew-rate = <1>;
			output-high;
		};
	};
	charging_switch1_ctr1_sleep: charging_switch1_ctr1_sleep {
		pins_cmd_dat {
			pinmux = <PINMUX_GPIO148__FUNC_GPIO148>;
			slew-rate = <1>;
			output-low;
		};
	};
	charging_switch1_active: charging_switch1_active {
		pins_cmd_dat {
			pinmux = <PINMUX_GPIO74__FUNC_GPIO74>;
			slew-rate = <1>;
			output-high;
		};
	};
	charging_switch1_sleep: charging_switch1_sleep {
		pins_cmd_dat {
			pinmux = <PINMUX_GPIO74__FUNC_GPIO74>;
			slew-rate = <1>;
			output-low;
		};
	};
	charging_clock_active: charging_clock_active {
		pins_cmd_dat {
			pinmux = <PINMUX_GPIO15__FUNC_GPIO15>;
			slew-rate = <0>;
			bias-pull-up;
		};
	};
	charging_clock_sleep: charging_clock_sleep {
		pins_cmd_dat {
			pinmux = <PINMUX_GPIO15__FUNC_GPIO15>;
			slew-rate = <0>;
			bias-pull-down;
		};
	};
	charging_data_active: charging_data_active {
		pins_cmd_dat {
			pinmux = <PINMUX_GPIO14__FUNC_GPIO14>;
			slew-rate = <0>;
			bias-pull-down;
		};
	};
	charging_data_sleep: charging_data_sleep {
		pins_cmd_dat {
			pinmux = <PINMUX_GPIO14__FUNC_GPIO14>;
			slew-rate = <0>;
			bias-pull-down;
		};
	};
	charging_reset_active: charging_reset_active {
		pins_cmd_dat {
			pinmux = <PINMUX_GPIO21__FUNC_GPIO21>;
			slew-rate = <1>;
			output-high;
		};
	};
	charging_reset_sleep: charging_reset_sleep {
		pins_cmd_dat {
			pinmux = <PINMUX_GPIO21__FUNC_GPIO21>;
			slew-rate = <1>;
			output-low;
		};
	};
	vooc_asic_id_active: vooc_asic_id_active {
		pins_cmd_dat {
			pinmux = <PINMUX_GPIO73__FUNC_GPIO73>;
			input-enable;
			slew-rate = <0>;
			bias-pull-up;
		};
	};
	vooc_asic_id_sleep: vooc_asic_id_sleep {
		pins_cmd_dat {
			pinmux = <PINMUX_GPIO73__FUNC_GPIO73>;
			input-enable;
			slew-rate = <0>;
			bias-pull-down;
		};
	};
};

&uart0 {
	pinctrl-names = "uart0_rx_gpio",
			"uart0_tx_gpio";
	pinctrl-0 = <&uart0_rx_gpio_input>;
	pinctrl-1 = <&uart0_tx_gpio_input>;
	status = "okay";
};

&pio {
	uart0_rx_gpio_input:uart0_rx_gpio@gpio53 {
		pins_cmd_dat {
			pinmux = <PINMUX_GPIO53__FUNC_GPIO53>;
			input-enable;
			slew-rate = <0>;
			bias-disable;
		};
	};
	uart0_tx_gpio_input:uart0_tx_gpio@gpio54 {
		pins_cmd_dat {
			pinmux = <PINMUX_GPIO54__FUNC_GPIO54>;
			input-enable;
			slew-rate = <0>;
			bias-disable;
		};
	};
};
//#endif /* OPLUS_FEATURE_CHG_BASIC */

//#ifdef OPLUS_FEATURE_CHG_BASIC
&i2c7 {
	pinctrl-names = "i2c-state", "output-low-state";
	pinctrl-0 = <&fg_i2c_state>;
	pinctrl-1 = <&fg_i2c_output_low_state>;
};

&pio {
	fg_i2c_state: fg_i2c_sda_state {
		pins_cmd_dat {
			pinmux = <PINMUX_GPIO199__FUNC_SDA7>;
			slew-rate = <0>;
			bias-disable;
		};
	};
	fg_i2c_output_low_state: fg_i2c_sda_output_low_state {
		pins_cmd_dat {
			pinmux = <PINMUX_GPIO199__FUNC_GPIO199>;
			slew-rate = <1>;
			output-low;
		};
	};
};
//#endif

&pio{
	gpio_goodix_reset_default: gpio_goodix_reset_default {
		pins_cmd_dat {
			pinmux = <PINMUX_GPIO107__FUNC_GPIO107>;
			output-low;
		};
	};
	gpio_goodix_irq_default: gpio_goodix_irq_default {
		pins_cmd_dat {
			pinmux = <PINMUX_GPIO39__FUNC_GPIO39>;
			input;
			bias-pull-down;
		};
	};

	gpio_goodix_clk_6mA: gpio_goodix_clk_6mA {
		pins_cmd_dat {
			pinmux = <PINMUX_GPIO20__FUNC_SPI0_A_CLK>;
			drive-strength = <2>;
		};
	};
	gpio_goodix_mosi_6mA: gpio_goodix_mosi_6mA {
		pins_cmd_dat {
			pinmux = <PINMUX_GPIO18__FUNC_SPI0_A_MO>;
			drive-strength = <2>;
		};
	};
	gpio_goodix_miso_6mA: gpio_goodix_miso_6mA {
		pins_cmd_dat {
			pinmux = <PINMUX_GPIO17__FUNC_SPI0_A_MI>;
			drive-strength = <3>;
		};
	};
	gpio_goodix_cs_6mA: gpio_goodix_cs_6mA {
		pins_cmd_dat {
			pinmux = <PINMUX_GPIO19__FUNC_SPI0_A_CSB>;
			drive-strength = <2>;
		};
	};

	gpio_goodix_cs_func: gpio_goodix_cs_func {
		pins_cmd_dat {
			pinmux = <PINMUX_GPIO19__FUNC_SPI0_A_CSB>;
			drive-strength = <2>;
		};
	};
	/*gpio_goodix_pwr_default: gpio_goodix_pwr_default {
		pins_cmd_dat {
			pinmux = <PINMUX_GPIO200__FUNC_GPIO200>;
			slew-rate = <1>;
			drive-strength = <2>;
			output-low;
		};
	};*/
};

&spi0 {
	#address-cells = <1>;
	#size-cells = <0>;
	status = "okay";
	oplus_fp: fingerprint@0 {
		compatible = "oplus,oplus_fp";
		reg = <0>;
		spi-max-frequency = <8000000>;
		spi-id = <0>;
		spi-irq = <39>;
		spi-reg = <11010000>;
		status = "okay";
	};
};


&pio{
	gpio_id0_default: gpio_id0_default {
		pins_cmd_dat {
			pinmux = <PINMUX_GPIO201__FUNC_GPIO201>;
			input;
			bias-pull-up;
			input-enable;
		};
	};
};

&goodix_fp {
	goodix,gpio_irq = <&pio 39 0x00>;
	goodix,gpio_reset = <&pio 107 0x00>;
	goodix,pw_en = <&pio 200 0x00>;
	goodix,gpio_cs = <&pio 19 0x00>;
	pinctrl-names = "default", "gf_spi_drive_6mA", "gf_cs_func";
	pinctrl-0 = <&gpio_goodix_irq_default>, <&gpio_goodix_reset_default>;
	pinctrl-1 = <&gpio_goodix_clk_6mA>, <&gpio_goodix_mosi_6mA>, <&gpio_goodix_miso_6mA>, <&gpio_goodix_cs_6mA>;
	pinctrl-2 = <&gpio_goodix_cs_func>;
	status = "ok";
};

&oplus_fp_common { //Slave driver and CS ID
	compatible = "oplus,fp_common"; //Manufacture, and Model
	oplus,fp_gpio_num = <1>;
	oplus,fp_gpio_0 = <&pio 201 0x00>;
	pinctrl-names = "default";
	pinctrl-0 = <&gpio_id0_default>;
	goodix_optical {
		oplus,fp-id = <1>; /* fp id mapping table */
		vendor-chip = <11>; /* please refer to the struct fp_vendor_t in oplus_fp_commmon.n */
		eng-menu = "-1,-1"; /* represents SNR, inclination test item in engineer menu, and 0/1 means off/on */
		chip-name = "G_OPTICAL_G3S";  /* /proc/fp_id, will be displayed in engineer menu  */
	};
};
#include <oplus6779_20291/cust.dtsi>
#include "mediatek/oplus6779_20291_camera.dtsi"
#include "mediatek/cust_mt6779_touch_1080x2160.dtsi"

//#ifdef OPLUS_ARCH_EXTENDS
#include "mediatek/mt6779-sia81xx-i2c.dtsi"
//#endif

