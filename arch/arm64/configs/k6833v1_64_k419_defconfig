## arch/arm64/configs/k6833v1_64_k419_defconfig
```kconfig
# CONFIG_LOCALVERSION_AUTO is not set
CONFIG_OPLUS_ION_BOOSTPOOL=y
CONFIG_PREEMPT=y
CONFIG_IKHEADERS=m
#ifdef OPLUS_BUG_STABILITY
CONFIG_LOG_BUF_SHIFT=21
#endif /*OPLUS_BUG_STABILITY*/
CONFIG_UCLAMP_TASK=y
CONFIG_BLK_CGROUP=y
CONFIG_UCLAMP_TASK_GROUP=y
CONFIG_CPUSETS=y
CONFIG_SCHED_TUNE=y
# CONFIG_RD_BZIP2 is not set
# CONFIG_RD_LZMA is not set
# CONFIG_RD_XZ is not set
# CONFIG_RD_LZO is not set
# CONFIG_RD_LZ4 is not set
CONFIG_SYSCTL_SYSCALL=y
# CONFIG_FHANDLE is not set
CONFIG_KALLSYMS_ALL=y
# CONFIG_KALLSYMS_BASE_RELATIVE is not set
CONFIG_MTK_SCHED_EXTENSION=y
CONFIG_MTK_IDLE_BALANCE_ENHANCEMENT=y
CONFIG_MTK_SCHED_INTEROP=y
CONFIG_MTK_SCHED_LB_ENHANCEMENT=y
CONFIG_MTK_SCHED_TRACERS=y
CONFIG_MTK_SCHED_CPU_PREFER=y
CONFIG_MTK_SCHED_BIG_TASK_MIGRATE=y
# CONFIG_SLUB_DEBUG is not set
CONFIG_ARCH_MEDIATEK=y
CONFIG_MACH_MT6833=y
CONFIG_SCHED_MC=y
CONFIG_MTK_ROUND_CORNER_SUPPORT=y
CONFIG_NR_CPUS=8
CONFIG_ARM64_DMA_USE_IOMMU=y
CONFIG_RANDOMIZE_BASE=y
CONFIG_CMDLINE="console=tty0 console=ttyMT3,921600n1 root=/dev/ram vmalloc=496M slub_max_order=0 slub_debug=O "
# CONFIG_EFI is not set
CONFIG_BUILD_ARM64_APPENDED_DTB_IMAGE=y
CONFIG_BUILD_ARM64_DTB_OVERLAY_IMAGE=y
CONFIG_BUILD_ARM64_APPENDED_DTB_IMAGE_NAMES="mediatek/mt6833"
CONFIG_BUILD_ARM64_DTB_OVERLAY_IMAGE_NAMES="mediatek/oplus6833_20015 mediatek/oplus6833_21101 mediatek/oplus6833_21102 mediatek/oplus6833_21235 mediatek/oplus6833_21236 mediatek/oplus6833_210A0 mediatek/oplus6833_21831 mediatek/oplus6833_22604 mediatek/oplus6833_22669 mediatek/oplus6833_21639 mediatek/oplus6833_2266A mediatek/oplus6833_216CE mediatek/oplus6833_22609 mediatek/oplus6833_2266B mediatek/oplus6833_2266C mediatek/oplus6833_2260A mediatek/oplus6833_2260B mediatek/oplus6833_2163B mediatek/oplus6833_22083 mediatek/oplus6833_22084 mediatek/oplus6833_22291 mediatek/oplus6833_22292 mediatek/oplus6833_20609 mediatek/oplus6833_20796 mediatek/oplus6833_20609_DVT mediatek/oplus6833_20796_DVT mediatek/oplus6833_21625 mediatek/oplus6833_21747 mediatek/oplus6833_22631 mediatek/oplus6833_22610 mediatek/oplus6833_22705 mediatek/oplus6833_22706 mediatek/oplus6833_22740 mediatek/oplus6833_22741 mediatek/oplus6833_23602 mediatek/oplus6833_22087 mediatek/oplus6833_22088 mediatek/oplus6833_22331 mediatek/oplus6833_22332 mediatek/oplus6833_22333 mediatek/oplus6833_22334 mediatek/oplus6833_23053 mediatek/oplus6833_23054 mediatek/oplus6833_23055 mediatek/oplus6833_23253 mediatek/oplus6833_22869"
CONFIG_PM_DEBUG=y
CONFIG_WQ_POWER_EFFICIENT_DEFAULT=y
CONFIG_ENERGY_MODEL=y
CONFIG_CPU_FREQ=y
CONFIG_CPU_FREQ_STAT=y
CONFIG_CPU_FREQ_DEFAULT_GOV_SCHEDUTIL=y
CONFIG_CPU_FREQ_GOV_POWERSAVE=y
CONFIG_CPU_FREQ_GOV_USERSPACE=y
CONFIG_CPU_FREQ_GOV_ONDEMAND=y
CONFIG_KPROBES=y
CONFIG_LTO_CLANG=y
CONFIG_CFI_CLANG=y
CONFIG_MODULE_SRCVERSION_ALL=y
# CONFIG_BLK_DEV_BSG is not set
CONFIG_BLK_INLINE_ENCRYPTION=y
CONFIG_BLK_INLINE_ENCRYPTION_FALLBACK=y
CONFIG_CFQ_GROUP_IOSCHED=y
# CONFIG_CORE_DUMP_DEFAULT_ELF_HEADERS is not set
CONFIG_ZSMALLOC=y
CONFIG_XFRM_MIGRATE=y
CONFIG_SYN_COOKIES=y
CONFIG_VLAN_8021Q=y
CONFIG_CLS_U32_PERF=y
CONFIG_CLS_U32_MARK=y
CONFIG_CFG80211=y
CONFIG_NL80211_TESTMODE=y
CONFIG_CFG80211_DEVELOPER_WARNINGS=y
# CONFIG_CFG80211_DEFAULT_PS is not set
# CONFIG_UEVENT_HELPER is not set
CONFIG_EXTRA_FIRMWARE="valhall-1691526.wa"
CONFIG_EXTRA_FIRMWARE_DIR="firmware"
# CONFIG_FW_CACHE is not set
CONFIG_ZRAM=y
CONFIG_BLK_DEV_LOOP_MIN_COUNT=16
CONFIG_ANDROID_DEFAULT_SETTING=y
CONFIG_MTK_ANDROID_DEFAULT_SETTING=y
CONFIG_USB_MTK_HDRC=y
CONFIG_MTK_MUSB_QMU_SUPPORT=y
CONFIG_MTK_MUSB_QMU_PURE_ZLP_SUPPORT=y
CONFIG_MTK_MUSB_DRV_36BIT=y
CONFIG_USB_MTK_OTG=y
CONFIG_MTK_MUSB_DUAL_ROLE=y
CONFIG_MTK_PLATFORM="mt6853"
CONFIG_ARCH_MTK_PROJECT="k6833v1_64"
CONFIG_NONLINEAR_FREQ_CTL=y
CONFIG_MTK_PTPOD=y
CONFIG_MTK_STATIC_POWER=y
CONFIG_MTK_UNIFY_POWER=y
CONFIG_MTK_CPU_FREQ=y
CONFIG_MTK_PTPOD_GPU=y
CONFIG_MTK_PBM=y
CONFIG_MTK_PMIC_NEW_ARCH=y
CONFIG_MTK_PMIC_COMMON=y
CONFIG_MTK_PMIC_CHIP_MT6359P=y
CONFIG_MTK_EXTERNAL_CHARGER_TYPE_DETECT=y
CONFIG_MFD_MT6360_PMU=y
CONFIG_MT6360_PMU_CHARGER=y
CONFIG_MT6360_PMU_FLED=y
CONFIG_MT6360_PMIC=y
CONFIG_MT6360_LDO=y
CONFIG_OPLUS_PMIC_COMMON=y
CONFIG_CUSTOM_KERNEL_IMGSENSOR="imx355_mipi_raw s5kgm1st_mipi_raw s5k3l6_mipi_raw s5k3p9sp_mipi_raw gc02m1b_mipi_mono s5kjn103_mipi_raw ov13b10_mipi_raw_carr s5k3l6_mipi_raw_carr imx355_mipi_raw_carr gc02m1b_mipi_mono_carr gc02m1_mipi_raw_carr ov02b10_mipi_raw_carr s5kgm1st_mipi_raw_odina imx355_mipi_raw_odina gc02m1b_mipi_mono_odina ov02b10_mipi_raw_odina s5k3l6_mipi_raw_alicert imx355_mipi_raw_alicert gc02m1b_mipi_mono_alicert s5kjn103_mipi_raw_alicer imx355_mipi_raw_alicer gc02m1b_mipi_mono_alicer s5kgm1st_mipi_raw_alicer s5kgm1st_mipi_raw_apollof s5k3p9sp_mipi_raw_apollof ov02b1b_mipi_mono_apollof ov02b10_mipi_raw_apollof ov64b_mipi_raw_apollof s5kgm1st_mipi_raw_apollob imx355_mipi_raw_apollob gc02m1b_mipi_mono_apollob ov02b10_mipi_raw_apollob s5k3p9sp_mipi_raw_apollob ov13b10_mipi_raw_apollob gc02m1_mipi_raw_apollot s5k3p9sp_mipi_raw_apollow ov64b_mipi_raw_apollow ov02b1b_mipi_mono_apollow ov02b10_mipi_raw_apollow hi556_mipi_raw_blade hi1336_mipi_raw_blade bf20a1_mipi_raw_blade hi5021sqt_mipi_raw_blade sc800cs_mipi_raw_blade sc201cs_mipi_mono_blade gc030a_mipi_raw_blade c2599_mipi_mono_blade sc201cs_mipi_raw_blade s5kjn103_mipi_raw_blade s5k3l6_mipi_raw_lijing sc800cs_mipi_raw_lijing hi846_mipi_raw_lijing sc201cs_mipi_raw_lijing c2519_mipi_raw_lijing s5kjn103_mipi_raw_lijing ov64b40_mipi_raw_hawaii ov08d10_mipi_raw_hawaii ov16a1q_mipi_raw_hawaii ov02b1b_mipi_mono_hawaii  ov08d10_mipi_raw_fanli ov02b1b_mipi_mono_fanli gc02m1_mipi_raw_fanli s5kjn103_mipi_raw_fanli s5k3l6_mipi_raw_fanli s5k3l6_mipi_raw_lijinga hi556_mipi_raw_lijinga hi846_mipi_raw_lijinga sc201cs_mipi_raw_lijinga sc520cs_mipi_raw_lijinga"
CONFIG_CUSTOM_KERNEL_CAM_CAL_DRV="BRCB032GWZ_3 GT24c32a cat24c16"
#CONFIG_CUSTOM_KERNEL_LCM="nt35695B_fhd_dsi_cmd_auo_rt5081 td4330_fhdp_dsi_cmd_auo_rt5081 ft8756_fhdp_dsi_vdo_auo_rt4801 oplus22087_boe_ili7807s_1080p_dsi_vdo,lcm"
CONFIG_MTK_SYNC=y
CONFIG_MTK_LCM_PHYSICAL_ROTATION="0"
CONFIG_LCM_HEIGHT="1600"
CONFIG_LCM_WIDTH="720"
CONFIG_MTK_AAL_SUPPORT=y
CONFIG_MTK_PSEUDO_M4U=y
CONFIG_MTK_FLASHLIGHT=y
CONFIG_MTK_FLASHLIGHT_MT6360=y
CONFIG_MTK_FLASHLIGHT_PT=y
CONFIG_MTK_FLASHLIGHT_PT_STRICT=y
CONFIG_MTK_FLASHLIGHT_DLPT=y
CONFIG_MTK_IMGSENSOR=y
CONFIG_MTK_LENS=y
CONFIG_MTK_CAM_CAL=y
CONFIG_MTK_CMDQ=y
CONFIG_MTK_CMDQ_MBOX_EXT=y
CONFIG_MTK_SMI_EXT=y
CONFIG_MTK_CCU=y
CONFIG_MTK_SENSOR_SUPPORT=y
CONFIG_MTK_SENSOR_ARCHITECTURE="2.0"
CONFIG_OPLUS_FEATURE_ACTIVITY_RECOGNITION=y
CONFIG_OPLUS_FEATURE_ELEVATOR_DETECT=y
CONFIG_CUSTOM_KERNEL_ACCELEROMETER=y
CONFIG_CUSTOM_KERNEL_ALSPS=y
CONFIG_CUSTOM_KERNEL_GYROSCOPE=y
CONFIG_CUSTOM_KERNEL_MAGNETOMETER=y
CONFIG_CUSTOM_KERNEL_BAROMETER=y
CONFIG_CUSTOM_KERNEL_STEP_COUNTER=y
CONFIG_CUSTOM_KERNEL_SENSORHUB=y
CONFIG_NANOHUB=y
CONFIG_NANOHUB_MTK_IPI=y
CONFIG_CUSTOM_KERNEL_GRV_SENSOR=y
CONFIG_CUSTOM_KERNEL_GMRV_SENSOR=y
CONFIG_CUSTOM_KERNEL_RV_SENSOR=y
CONFIG_CUSTOM_KERNEL_LINEARACCEL_SENSOR=y
CONFIG_CUSTOM_KERNEL_GRAVITY_SENSOR=y
CONFIG_CUSTOM_KERNEL_UNCALI_ACC_SENSOR=y
CONFIG_CUSTOM_KERNEL_UNCALI_GYRO_SENSOR=y
CONFIG_CUSTOM_KERNEL_UNCALI_MAG_SENSOR=y
CONFIG_OPLUS_FEATURE_PICKUP_DETECT=y
CONFIG_OPLUS_FEATURE_FP_DISPLAY=y
CONFIG_OPLUS_FEATURE_LUX_AOD=y
CONFIG_OPLUS_FEATURE_PEDO_MINUTE=y
CONFIG_OPLUS_SENSOR_FB_MTK=y
CONFIG_OPLUS_FEATURE_SENSOR_MONITOR=y
CONFIG_MTK_CCCI_DEVICES=y
CONFIG_MTK_MD1_SUPPORT=25
CONFIG_MTK_ECCCI_DRIVER=y
CONFIG_MTK_ECCCI_C2K=y
CONFIG_MTK_BTIF=y
CONFIG_OPLUS_SENSOR_FB_MTK=y
CONFIG_MTK_COMBO=y
CONFIG_MTK_COMBO_CHIP_CONSYS_6833=y
CONFIG_MTK_COMBO_GPS=y
CONFIG_MTK_COMBO_WIFI=y
CONFIG_MTK_DHCPV6C_WIFI=y
CONFIG_MTK_GPS_SUPPORT=y
CONFIG_MTK_GPS_EMI=y
CONFIG_MTK_FMRADIO=y
CONFIG_MTK_FM_CHIP="MT6631_FM"
CONFIG_MTK_CONNSYS_DEDICATED_LOG_PATH=y
CONFIG_MTK_MDDP_SUPPORT=y
CONFIG_HAVE_MTK_ENABLE_GENIEZONE=y
CONFIG_MTK_ENABLE_GENIEZONE=y
CONFIG_MTK_GZ_MAIN=y
CONFIG_MTK_GZ_LOG=y
CONFIG_MTK_GZ_VIRTIO=y
CONFIG_MTK_GZ_VIRTIO_IPC=y
CONFIG_MTK_GZ_IRQ=y
CONFIG_HAVE_MTK_GZ_LOG=y
CONFIG_EXTCON_MTK_USB=y
CONFIG_MTK_USB_TYPEC_U3_MUX=y
CONFIG_TCPC_CLASS=y
CONFIG_TCPC_MT6360=y
CONFIG_USB_POWER_DELIVERY=y
CONFIG_MT6360_PMU_CHARGER_TYPE_DETECT=y
CONFIG_MTK_LEDS=y
#CONFIG_LEDS_MTK_PWM=y
CONFIG_LEDS_MTK_DISP=y
CONFIG_MTK_PWM=y
CONFIG_MTK_ACCDET=y
CONFIG_ACCDET_EINT_IRQ=y
CONFIG_ACCDET_SUPPORT_EINT0=y
CONFIG_MTK_RTC=y
CONFIG_MTK_PERF_COMMON=y
CONFIG_MTK_PERF_TRACKER=y
CONFIG_MTK_LOAD_TRACKER=y
CONFIG_MTK_CPU_CTRL_CFP=y
CONFIG_MTK_PERF_OBSERVER=y
CONFIG_MTK_RESYM=y
CONFIG_MTK_FPSGO_V3=y
CONFIG_MTK_GBE=y
CONFIG_MTK_TASK_TURBO=y
CONFIG_MTK_TINYSYS_SCP_SUPPORT=y
CONFIG_MTK_TINYSYS_SSPM_SUPPORT=y
CONFIG_MTK_TINYSYS_SSPM_V2=y

CONFIG_MTK_MET_PLF=m
CONFIG_MTPROF=y
CONFIG_MTK_AEE_HANGDET=y
CONFIG_MTK_CM_MGR_LEGACY=y
CONFIG_MTK_VIBRATOR=y
CONFIG_MTK_LEGACY_THERMAL=y
CONFIG_MTK_THERMAL_PA_VIA_ATCMD=y
CONFIG_MTK_CAMERA_ISP_RSC_SUPPORT=y
CONFIG_MTK_CAMERA_ISP_DPE_SUPPORT=y
CONFIG_MTK_CAMERA_ISP_MFB_SUPPORT=y
CONFIG_MTK_CAMERA_ISP_FD_SUPPORT=y
CONFIG_MTK_TINYSYS_MCUPM_SUPPORT=y
CONFIG_MTK_DRAM_LOG_STORE=y
CONFIG_MTK_DRAM_LOG_STORE_ADDR=0x0011DF00
CONFIG_MTK_DRAM_LOG_STORE_SIZE=0x100
CONFIG_MTK_VOW_SUPPORT=y
CONFIG_MTK_VOW_DUAL_MIC_SUPPORT=y
CONFIG_MTK_VOW_AMAZON_SUPPORT=n
CONFIG_MTK_VOW_GVA_SUPPORT=y
CONFIG_MTK_VOW_MAX_PDK_NUMBER=1
CONFIG_MTK_VOW_DSP_VERSION="ver02"
CONFIG_MTK_FREQ_HOPPING=y
CONFIG_SCSI=y
CONFIG_BLK_DEV_SD=y
CONFIG_SCSI_SCAN_ASYNC=y
CONFIG_SCSI_UFSHCD=y
CONFIG_SCSI_UFSHCD_PLATFORM=y
CONFIG_SCSI_UFS_MEDIATEK=y
CONFIG_SCSI_UFS_FEATURE=y
# CONFIG_SCSI_UFS_HPB is not set
CONFIG_SCSI_UFS_TW=y
# CONFIG_SCSI_SKHPB is not set
CONFIG_SCSI_UFS_CRYPTO=y
CONFIG_SCSI_UFS_TW_IGNORE_GUARANTEE_BIT=y
CONFIG_DM_CRYPT=y
CONFIG_DM_DEFAULT_KEY=y
CONFIG_DM_UEVENT=y
CONFIG_DM_VERITY_FEC=y
CONFIG_IFB=y
# CONFIG_ETHERNET is not set
CONFIG_PPP_FILTER=y
CONFIG_PPP_MULTILINK=y
CONFIG_PPPOE=y
CONFIG_PPP_ASYNC=y
CONFIG_PPP_SYNC_TTY=y
CONFIG_USB_RTL8152=y
CONFIG_USB_USBNET=y
CONFIG_KEYBOARD_MTK=y
CONFIG_TWOKEY_REBOOT_NORMAL_MODE=y
CONFIG_TWOKEY_REBOOT_OTHER_MODE=y
CONFIG_KPD_PWRKEY_USE_PMIC=y
# CONFIG_INPUT_MOUSE is not set
CONFIG_INPUT_TOUCHSCREEN=y
#CONFIG_TOUCHSCREEN_MTK_TOUCH="GT9886 GT9896S"
CONFIG_INPUT_MISC=y
CONFIG_INPUT_UINPUT=y
OPLUS_FEATURE_TP_BASIC=y
OPLUS_FEATURE_TP_BSPFWUPDATE=y
CONFIG_OPLUS_FW_UPDATE=y
CONFIG_FW_LOADER_USER_HELPER=y
CONFIG_FW_LOADER_USER_HELPER_FALLBACK=y
CONFIG_TOUCHPANEL_OPLUS=y
CONFIG_TOUCHPANEL_NOVA=y
CONFIG_TOUCHPANEL_ILITEK=y
CONFIG_TOUCHPANEL_NT_DIGITALNOISE_TEST=y
CONFIG_TOUCHPANEL_NOVA_NT36525B_NOFLASH=y
CONFIG_TOUCHPANEL_NOVA_NT36672C_NOFLASH=y
CONFIG_TOUCHPANEL_MTK_PLATFORM=y
CONFIG_TOUCHPANEL_MULTI_NOFLASH=y
CONFIG_TOUCHPANEL_LATE_INIT=y
CONFIG_TOUCHPANEL_ILITEK_ILITEK7807S=y
CONFIG_TOUCHPANEL_HIMAX=y
CONFIG_TOUCHPANEL_HIMAX_HX83102D_NOFLASH=y
CONFIG_TOUCHPANEL_HIMAX_HX83112F_NOFLASH=y
CONFIG_TOUCHPANEL_FOCAL=y
CONFIG_TOUCHPANEL_FOCAL_FT3518=y
CONFIG_TOUCHPANEL_FOCAL_FT8006S_AA=y
CONFIG_TOUCHPANEL_SYNAPTICS=y
CONFIG_TOUCHPANEL_SYNAPTICS_TD4160=y
CONFIG_TOUCHPANEL_CHIPONE=y
CONFIG_TOUCHPANEL_CHIPONE_ICNL9911C=y
# CONFIG_VT is not set
CONFIG_LEGACY_PTY_COUNT=16
# CONFIG_DEVMEM is not set
CONFIG_SERIAL_8250=y
CONFIG_SERIAL_8250_CONSOLE=y
CONFIG_SERIAL_8250_NR_UARTS=2
CONFIG_SERIAL_8250_RUNTIME_UARTS=2
CONFIG_SERIAL_8250_MT6577=y
CONFIG_I2C_MTK=y
CONFIG_SPI=y
CONFIG_SPI_MT65XX=y
CONFIG_SPMI=y
CONFIG_MTK_PMIF=y
CONFIG_MTK_CHARGER=y
CONFIG_MTK_KERNEL_POWER_OFF_CHARGING=y
CONFIG_MTK_GAUGE_VERSION=30
# CONFIG_HWMON is not set

CONFIG_DYNAMIC_TUNNING_SWAPPINESS=y

#ifdef OPLUS_FEATURE_LOWMEM_DBG
CONFIG_OPLUS_FEATURE_LOWMEM_DBG=y
#endif /* OPLUS_FEATURE_LOWMEM_DBG */

CONFIG_THERMAL=y
CONFIG_THERMAL_DEFAULT_GOV_BACKWARD_COMPATIBLE=y
CONFIG_WATCHDOG=y
CONFIG_MEDIATEK_WATCHDOG=y
CONFIG_MFD_MT6358=y
CONFIG_MT6358_MISC=y
CONFIG_MTK_MFD_SPMI_PMIC=y
CONFIG_REGULATOR_MT6315=y
CONFIG_REGULATOR_MT6359P=y
CONFIG_REGULATOR_FIXED_VOLTAGE=y
CONFIG_MEDIA_SUPPORT=y
CONFIG_MEDIA_CAMERA_SUPPORT=y
CONFIG_VIDEO_V4L2_SUBDEV_API=y
CONFIG_V4L2_FLASH_LED_CLASS=y
CONFIG_V4L_PLATFORM_DRIVERS=y
CONFIG_V4L_MEM2MEM_DRIVERS=y
CONFIG_VIDEO_MEDIATEK_JPEG=y
CONFIG_VIDEO_MEDIATEK_VCODEC=y
CONFIG_DRM=y
CONFIG_DRM_PANEL_OPLUS20625_BOE_NT35625B_DPHY_VDO=y
CONFIG_DRM_PANEL_OPLUS20015_BOE_ILI9882N_DPHY_VDO=y
CONFIG_DRM_PANEL_OPLUS20015_INNOLUX_ILI9882N_DPHY_VDO=y
CONFIG_DRM_PANEL_OPLUS20015_TRULY_HX83102_DPHY_VDO=y
CONFIG_DRM_PANEL_OPLUS210A0_TIANMA_ILI7807S_CPHY_VDO=y
CONFIG_DRM_PANEL_OPLUS21101_BOE_ILI9883A_DPHY_VDO=y
CONFIG_DRM_PANEL_OPLUS21101_INX_TD4160_DPHY_VDO=y
CONFIG_DRM_PANEL_OPLUS21101_BOE_BI_ILI9883A_DPHY_VDO=y
CONFIG_DRM_PANEL_OPLUS20609_TIANMA_ILI7807S_CPHY_VDO=y
CONFIG_DRM_PANEL_OPLUS20609_TIANMA_NT36672C_CPHY_VDO=y
CONFIG_DRM_PANEL_OPLUS21101_JDI_ILI7807S_CPHY_VDO=y
CONFIG_DRM_PANEL_OPLUS21101_NT36672C_TM_CPHY_DSI_VDO=y
CONFIG_DRM_PANEL_OPLUS22604_TXD_ICNL9911C_DPHY_VDO=y
CONFIG_DRM_PANEL_OPLUS22609_TXD_HX83112F_CPHY_VDO=y
CONFIG_DRM_PANEL_OPLUS22604_BOE_HX83102D_DPHY_VDO=y
CONFIG_DRM_PANEL_OPLUS21639_NT36672C_TM_CPHY_DSI_VDO=y
CONFIG_DRM_PANEL_OPLUS22083_HLT_ILI9883C_DPHY_VDO=y
CONFIG_DRM_PANEL_OPLUS22083_TRULY_TD4160_DPHY_VDO=y
CONFIG_DRM_PANEL_OPLUS22083_BOE_ILI9883C_DPHY_VDO=y
CONFIG_DRM_PANEL_OPLUS23053_BOE_ILI9883C_DPHY_VDO=y
CONFIG_DRM_PANEL_OPLUS23053_TRULY_TD4160_DPHY_VDO=y
CONFIG_DRM_PANEL_OPLUS21639_NT36672C_TM_CPHY_DSI_VDO=y
CONFIG_DRM_PANEL_OPLUS22291_HLT_ILI9883C_DPHY_VDO=y
CONFIG_DRM_PANEL_OPLUS22291_TRULY_TD4160_DPHY_VDO=y
CONFIG_DRM_PANEL_OPLUS22291_BOE_ILI9883C_DPHY_VDO=y
CONFIG_DRM_PANEL_OPLUS22631_BOE_ICNL9911C_DPHY_VDO=y
CONFIG_DRM_PANEL_OPLUS22610_SAMSUNG_AMS643AG01_1080P_DSI_CMD=y
CONFIG_DRM_PANEL_AC102_P_7_A0007_DSC_VEDIO_MODE_PANEL=y
CONFIG_DRM_PANEL_AC102_P_3_A0010_FHDP_DSI_VDO=y
CONFIG_REGULATOR_SM5109_TPS65132=y
CONFIG_OPLUS_OFP_V2=y
CONFIG_DRM_MEDIATEK=y
CONFIG_MTK_GPU_SUPPORT=y
CONFIG_MTK_GPU_VERSION="mali valhall r32p1"
CONFIG_MTK_GPU_COMMON_DVFS_SUPPORT=y
CONFIG_FB_MODE_HELPERS=y
CONFIG_FB_TILEBLITTING=y
CONFIG_BACKLIGHT_LCD_SUPPORT=y
CONFIG_BACKLIGHT_CLASS_DEVICE=y
CONFIG_LOGO=y
CONFIG_SND_HRTIMER=y
CONFIG_SND_DYNAMIC_MINORS=y
CONFIG_SND_VERBOSE_PRINTK=y
CONFIG_SND_DEBUG=y
CONFIG_SND_DEBUG_VERBOSE=y
CONFIG_SND_PCM_XRUN_DEBUG=y
CONFIG_SND_SEQUENCER=y
CONFIG_SND_SEQ_DUMMY=y
CONFIG_SND_USB_AUDIO=y
CONFIG_SND_SOC=y
CONFIG_SND_SOC_MT6833_MT6359=y
CONFIG_SND_SOC_MTK_BTCVSD=y
CONFIG_MTK_VOW_BARGE_IN_SUPPORT=y
#CONFIG_SND_SOC_RT5509=y
CONFIG_SND_SOC_AW87XXX=y
CONFIG_SND_SOC_OPLUS_PA_MANAGER=y
CONFIG_SND_SOC_AW87XXX_2_X_0=y
#ifdef OPLUS_FEATURE_MM_FEEDBACK
CONFIG_OPLUS_FEATURE_MM_FEEDBACK=y
#endif
CONFIG_HIDRAW=y
CONFIG_HID_A4TECH=y
CONFIG_HID_APPLE=y
CONFIG_HID_BELKIN=y
CONFIG_HID_CHERRY=y
CONFIG_HID_CHICONY=y
CONFIG_HID_CYPRESS=y
CONFIG_HID_DRAGONRISE=y
CONFIG_HID_EZKEY=y
CONFIG_HID_KYE=y
CONFIG_HID_GYRATION=y
CONFIG_HID_TWINHAN=y
CONFIG_HID_KENSINGTON=y
CONFIG_HID_LOGITECH=y
CONFIG_HID_MAGICMOUSE=y
CONFIG_HID_MICROSOFT=y
CONFIG_HID_MONTEREY=y
CONFIG_HID_PANTHERLORD=y
CONFIG_HID_PETALYNX=y
CONFIG_HID_SAMSUNG=y
CONFIG_HID_SUNPLUS=y
CONFIG_HID_GREENASIA=y
CONFIG_HID_SMARTJOYPLUS=y
CONFIG_HID_TOPSEED=y
CONFIG_HID_THRUSTMASTER=y
CONFIG_HID_ZEROPLUS=y
CONFIG_USB_STORAGE=y
CONFIG_USB_STORAGE_DATAFAB=y
CONFIG_USB_STORAGE_FREECOM=y
CONFIG_USB_STORAGE_ISD200=y
CONFIG_USB_STORAGE_USBAT=y
CONFIG_USB_STORAGE_SDDR09=y
CONFIG_USB_STORAGE_SDDR55=y
CONFIG_USB_STORAGE_JUMPSHOT=y
CONFIG_USB_STORAGE_ALAUDA=y
CONFIG_USB_STORAGE_ONETOUCH=y
CONFIG_USB_STORAGE_KARMA=y
CONFIG_USB_STORAGE_CYPRESS_ATACB=y
CONFIG_USB_TRANCEVIBRATOR=y
CONFIG_NOP_USB_XCEIV=y
CONFIG_USB_GADGET_VBUS_DRAW=500
CONFIG_USB_CONFIGFS_SERIAL=y
CONFIG_USB_CONFIGFS_ACM=y
CONFIG_USB_CONFIGFS_RNDIS=y
CONFIG_USB_CONFIGFS_MASS_STORAGE=y
CONFIG_USB_CONFIGFS_MTK_FASTMETA=y
CONFIG_USB_CONFIGFS_F_HID=y
CONFIG_USB_ANNOUNCE_NEW_DEVICES=y
CONFIG_MMC=y
CONFIG_MMC_BLOCK_MINORS=32
#CONFIG_MMC_CRYPTO is not set
CONFIG_MTK_EMMC_SUPPORT_OTP=y
CONFIG_MMC_CQHCI=y
CONFIG_MMC_MTK=y
CONFIG_NEW_LEDS=y
CONFIG_LEDS_CLASS=y
CONFIG_LEDS_CLASS_FLASH=y
CONFIG_LEDS_TRIGGERS=y
CONFIG_LEDS_TRIGGER_TIMER=y
# CONFIG_RTC_SYSTOHC is not set
CONFIG_RTC_DRV_MT6358=y
CONFIG_DMADEVICES=y
CONFIG_MTK_UART_APDMA=y
CONFIG_ANDROID_INTF_ALARM_DEV=y
CONFIG_ION=y
CONFIG_MTK_ION=y
CONFIG_MTK_IOMMU_V2=y
CONFIG_MTK_IOMMU_PGTABLE_EXT=34
CONFIG_RPMSG_MTK=y
CONFIG_MTK_PMIC_WRAP=y
CONFIG_MTK_IPI=y
CONFIG_MTK_MBOX=y
CONFIG_IIO=y
CONFIG_IIO_BUFFER=y
CONFIG_IIO_KFIFO_BUF=y
CONFIG_MEDIATEK_MT6577_AUXADC=y
CONFIG_MT635X_AUXADC=y
CONFIG_PWM=y
CONFIG_PWM_MTK_DISP=y
CONFIG_PHY_MTK_TPHY=y
CONFIG_MTK_DEVINFO=y
CONFIG_FS_ENCRYPTION_INLINE_CRYPT=y
CONFIG_F2FS_FS_ENCRYPTION=y
#For FS Compress Feature
CONFIG_F2FS_FS_COMPRESSION=y
#ifdef OPLUS_FEATURE_STORAGE_TOOL
CONFIG_CHR_DEV_SG=y
#endif
CONFIG_QUOTA_NETLINK_INTERFACE=y
CONFIG_INCREMENTAL_FS=y
CONFIG_ISO9660_FS=y
CONFIG_JOLIET=y
CONFIG_ZISOFS=y
CONFIG_MSDOS_FS=y
CONFIG_VFAT_FS=y
CONFIG_SDCARD_FS=y
CONFIG_OVERLAY_FS=y
CONFIG_EXFAT_FS=y
CONFIG_EROFS_FS=y
CONFIG_PSTORE=y
CONFIG_PSTORE_CONSOLE=y
CONFIG_PSTORE_PMSG=y
CONFIG_PSTORE_RAM=y
# CONFIG_NETWORK_FILESYSTEMS is not set
CONFIG_NLS_CODEPAGE_437=y
CONFIG_NLS_CODEPAGE_950=y
CONFIG_NLS_ASCII=y
CONFIG_NLS_ISO8859_1=y
CONFIG_NLS_UTF8=y
CONFIG_STATIC_USERMODEHELPER=y
CONFIG_STATIC_USERMODEHELPER_PATH="/system_ext/bin/aee_core_forwarder"
CONFIG_CRYPTO_TWOFISH=y
# CONFIG_CRYPTO_HW is not set
CONFIG_CRC8=y
CONFIG_PRINTK_TIME=y
CONFIG_DYNAMIC_DEBUG=y
CONFIG_DEBUG_INFO=y
CONFIG_FRAME_WARN=3600
CONFIG_PANIC_ON_OOPS=y
CONFIG_PANIC_TIMEOUT=1
CONFIG_SCHEDSTATS=y
# CONFIG_DEBUG_PREEMPT is not set
# CONFIG_DEBUG_BUGVERBOSE is not set
CONFIG_RCU_CPU_STALL_TIMEOUT=60
CONFIG_FAULT_INJECTION=y
CONFIG_ENABLE_DEFAULT_TRACERS=y

#ifdef OPLUS_FEATURE_PROCESS_RECLAIM
CONFIG_PROCESS_RECLAIM=y
#endif

#ifdef OPLUS_FEATURE_CHG_BASIC
CONFIG_INPUT_JOYSTICK=y
CONFIG_JOYSTICK_XPAD=y
CONFIG_JOYSTICK_XPAD_FF=y
CONFIG_JOYSTICK_XPAD_LEDS=y
CONFIG_HID_SONY=y
CONFIG_HID_BETOP_FF=y
CONFIG_HID_PLANTRONICS=y
CONFIG_OPLUS_SMART_CHARGER_SUPPORT=y
#endif
CONFIG_MTK_ADDITIONAL_BATTERY_TABLE=y
CONFIG_OPLUS_CHARGER=y
CONFIG_OPLUS_CHARGER_MTK=y
CONFIG_OPLUS_CHARGER_MTK_CHGIC=y
CONFIG_OPLUS_CHARGER_MTK6833=y
CONFIG_OPLUS_CHECK_CHARGERID_VOLT=y
CONFIG_OPLUS_CHARGER_MTKAGING=y
#ifdef OPLUS_FEATURE_CHG_BASIC
CONFIG_OPLUS_4450MV_BATTERY_SUPPORT=y
CONFIG_OPLUS_CALL_MODE_SUPPORT=y
CONFIG_OPLUS_SHIP_MODE_SUPPORT=y
CONFIG_OPLUS_SHORT_C_BATT_CHECK=y
CONFIG_OPLUS_SHORT_HW_CHECK=y
CONFIG_OPLUS_SHORT_USERSPACE=y
CONFIG_OPLUS_CHIP_SOC_NODE=y
CONFIG_OPLUS_RTC_DET_SUPPORT=y
CONFIG_OPLUS_ARCH_FILE=y
CONFIG_OPLUS_COMMON_SOFT=y
CONFIG_OPLUS_HVDCP_SUPPORT=y
CONFIG_OPLUS_SHORT_IC_CHECK=y
CONFIG_MTK_TYPEC_WATER_DETECT=y
#endif
CONFIG_CRC8=y
CONFIG_USB_USBNET=y

#ifdef OPLUS_BUG_STABILITY
CONFIG_OPLUS_SYSTEM_KERNEL=y
CONFIG_OPLUS_FEATURE_OPROJECT=y
#CONFIG_SECTION_MISMATCH_WARN_ONLY=y
CONFIG_OPLUS_FEATURE_FEEDBACK=y
CONFIG_OPLUS_DEVICE_IFNO=y
CONFIG_OPLUS_FEATURE_THEIA=y
CONFIG_OPLUS_FEATURE_SHUTDOWN_DETECT=y
CONFIG_OPLUS_FEATURE_PHOENIX=y
CONFIG_OPLUS_FEATURE_OLC=y
CONFIG_OPLUS_FEATURE_FDLEAK_CHECK=y
CONFIG_OPLUS_FEATURE_LAST_BOOT_REASON=y
CONFIG_OPLUS_FEATURE_MTK_FORCE_SHUTDOWN=y
CONFIG_OPLUS_FEATURE_KMSG_WB=y
CONFIG_OPLUS_FEATURE_PANIC_FLUSH=y
#endif /* OPLUS_BUG_STABILITY */

#ifndef OPLUS_FEATURE_SECURITY_COMMON
CONFIG_TEE=y
CONFIG_TRUSTONIC_TEE_SUPPORT=y
CONFIG_MTK_TEE_GP_SUPPORT=y
CONFIG_TRUSTONIC_TEE_VERSION=500
#endif /*OPLUS_FEATURE_SECURITY_COMMON*/

#ifdef OPLUS_FEATURE_SECURITY_COMMON
CONFIG_MTK_SECURITY_SW_SUPPORT=y
#endif /*OPLUS_FEATURE_SECURITY_COMMON*/

#ifdef OPLUS_FEATURE_SECURITY_COMMON
CONFIG_OPLUS_SECURE=y
CONFIG_OPLUS_SECURE_QCOM=n
CONFIG_OPLUS_SECURE_MTK=y
CONFIG_OPLUS_SECURE_COMMON=y
#endif /* OPLUS_FEATURE_SECURITY_COMMON */

#ifdef CONFIG_OPLUS_SECURE_GUARD
CONFIG_OPLUS_ROOT_CHECK=y
CONFIG_OPLUS_EXECVE_BLOCK=y
CONFIG_OPLUS_MOUNT_BLOCK=y
CONFIG_OPLUS_SECURE_GUARD=y
#endif /*CONFIG_OPLUS_SECURE_GUARD*/

#ifdef OPLUS_FEATURE_KEY_SECURITY
CONFIG_MTK_DRM_KEY_MNG_SUPPORT=y
CONFIG_MTK_SEC_VIDEO_PATH_SUPPORT=y
CONFIG_MTK_SVP_ON_MTEE_SUPPORT=y
#endif /* OPLUS_FEATURE_KEY_SECURITY */

#ifdef OPLUS_FEATURE_ESIM
CONFIG_OPLUS_GPIO=y
#endif

#ifdef OPLUS_FEATURE_SECURITY_COMMON
#ModuleSig, Fix the MTK issue, resulting in the signed .ko not being correctly placed in the vendor.img. 2020-11-21
CONFIG_MODULE_SIG=y
CONFIG_MODULE_SIG_FORCE=y
CONFIG_MODULE_SIG_ALL=y
CONFIG_MODULE_SIG_SHA512=y
#endif /* OPLUS_FEATURE_SECURITY_COMMON */

#ifdef OPLUS_FEATURE_ZRAM_OPT
CONFIG_OPLUS_ZRAM_OPT=y
CONFIG_CRYPTO_LZ4=y
CONFIG_PGTABLE_MAPPING=y
#endif /* OPLUS_FEATURE_ZRAM_OPT */

CONFIG_OPLUS_FINGERPRINT=y
CONFIG_OPLUS_FINGERPRINT_MTK=y
CONFIG_OPLUS_FINGERPRINT_COMMON=y
CONFIG_OPLUS_FINGERPRINT_GKI_DISABLE=y
CONFIG_OPLUS_FINGERPRINT_GOODIX=y
CONFIG_OPLUS_FINGERPRINT_FPC=y
CONFIG_OPLUS_FINGERPRINT_SILEAD=y
CONFIG_OPLUS_FINGERPRINT_CHIPONE=y
CONFIG_OPLUS_FINGERPRINT_JIIOV_CAPACITIVE=y
CONFIG_OPLUS_FINGERPRINT_FOCALTECH=y
#endif /* OPLUS_FEATURE_FINGERPRINT */

#ifdef OPLUS_FEATURE_UFF_FINGERPRINT
CONFIG_UFF_FINGERPRINT=y
CONFIG_UFF_FINGERPRINT_MTK=y
#endif /* OPLUS_FEATURE_UFF_FINGERPRINT */

#ifdef OPLUS_FEATURE_ACM
CONFIG_OPLUS_FEATURE_ACM=y
CONFIG_OPLUS_FEATURE_ACM_LOGGING=y
#endif /* OPLUS_FEATURE_ACM */

CONFIG_OPLUS_FEATURE_PMIC_MONITOR_MTK=y

CONFIG_OPLUS_HEALTHINFO=y
CONFIG_SCHED_WALT=y
#ifdef OPLUS_FEATURE_GAME_OPT
CONFIG_OPLUS_FEATURE_GAME_OPT=y
#endif
#ifdef OPLUS_FEATURE_SCHED_ASSIST
CONFIG_OPLUS_FG_BOOST=y
CONFIG_SCHED_WALT=y
CONFIG_KERNEL_LOCK_OPT=y
CONFIG_OPLUS_UX_IM_FLAG=y
CONFIG_OPLUS_FEATURE_AUDIO_OPT=y
CONFIG_OPLUS_CPU_AUDIO_PERF=y
#endif /* OPLUS_FEATURE_SCHED_ASSIST */
#ifdef OPLUS_BUG_COMPATIBILITY
CONFIG_SND_SOC_CODEC_MICBIAS_2P8V=y
CONFIG_SIA_PA_ALGO_MT6833=y
CONFIG_HSKEY_BLOCK=y
#endif /*OPLUS_BUG_COMPATIBILITY*/
CONFIG_OPLUS_HANS=y

#ifdef OPLUS_FEATURE_NANDSWAP
#Add for NandSwap
# CONFIG_NANDSWAP is not set
#CONFIG_NANDSWAP_DEBUG=y
#endif /*OPLUS_FEATURE_NANDSWAP*/

#ifdef OPLUS_FEATURE_HYBRIDSWAP
CONFIG_HYBRIDSWAP=y
CONFIG_HYBRIDSWAP_SWAPD=y
CONFIG_HYBRIDSWAP_CORE=y
#endif

#ifdef OPLUS_FEATURE_MM
#CONFIG_BALANCE_ANON_FILE_RECLAIM=y
#endif

#ifdef OPLUS_FEATURE_WIFI_SLA
#todo: need to change to m when GKI
CONFIG_OPLUS_FEATURE_WIFI_SLA=y
#endif /* OPLUS_FEATURE_WIFI_SLA */

#ifdef OPLUS_FEATURE_MIDAS
CONFIG_OPLUS_FEATURE_BINDER_STATS_ENABLE=y
CONFIG_OPLUS_FEATURE_MIDAS=y
#endif

#ifdef OPLUS_FEATURE_DATA_LIMIT
CONFIG_IFB=y
CONFIG_NET_SCH_MULTIQ=y
CONFIG_NET_SCH_NETEM=y
CONFIG_CLS_U32_MARK=y
CONFIG_NET_CLS_FLOW=y
CONFIG_NET_EMATCH_CMP=y
CONFIG_NET_EMATCH_NBYTE=y
CONFIG_NET_EMATCH_META=y
CONFIG_NET_EMATCH_TEXT=y
CONFIG_NET_ACT_GACT=y
CONFIG_NET_ACT_MIRRED=y
CONFIG_NET_ACT_SKBEDIT=y
#endif /* OPLUS_FEATURE_DATA_LIMIT */

#ifdef OPLUS_FEATURE_DATA_EVAL
CONFIG_OPLUS_FEATURE_DATA_EVAL=y
#endif /*OPLUS_FEATURE_DATA_EVAL*/

#ifdef OPLUS_FEATURE_WIFI_CAPCENTER
CONFIG_OPLUS_FEATURE_WIFI_CAPCENTER=y
#endif /* OPLUS_FEATURE_WIFI_CAPCENTER */

# BSP.Kernel.Performance, 2022/10/25, add for memory lock optimization in kernel
CONFIG_LOOK_AROUND=y
CONFIG_MAPPED_PROTECT=n
CONFIG_SHRINK_LRU_TRYLOCK=y
CONFIG_LOCKING_PROTECT=y
CONFIG_OPLUS_LOCKING_STRATEGY=y
CONFIG_OPLUS_FEATURE_SCHED_ASSIST=y

#ifdef OPLUS_FEATURE_MEMLEAK_DETECT
CONFIG_KMALLOC_DEBUG=y
CONFIG_VMALLOC_DEBUG=y
CONFIG_DUMP_TASKS_MEM=y
CONFIG_SLABINFO=y
CONFIG_SVELTE=y
#endif /*OPLUS_FEATURE_MEMLEAK_DETECT*/

CONFIG_NETFILTER_XT_TARGET_DSCP=y
CONFIG_NETFILTER_XT_MATCH_DSCP=y

#ifdef OPLUS_FEATURE_NFC_BRINGUP
CONFIG_OPLUS_NFC=y
CONFIG_NFC_PN553_DEVICES=y
CONFIG_NXP_NFC_I2C=y
CONFIG_NXP_ESE_P73=y
#endif /*OPLUS_FEATURE_NFC_BRINGUP*/

#ifdef OPLUS_FEATURE_QR_SCAN
CONFIG_OPLUS_FEATURE_QR_SCAN=y
#endif /* OPLUS_FEATURE_QR_SCAN */


CONFIG_SIM_DETECT=y

CONFIG_OPLUS_FEATURE_EAS_IGNORE_CACHEMISS=n
#ifdef OPLUS_FEATURE_TASK_CPUSTATS
CONFIG_OPLUS_CTP=y
CONFIG_OPLUS_SCHED=y
#endif /* OPLUS_FEATURE_TASK_CPUSTATS */

#ifdef OPLUS_FEATURE_DNS_HOOK
CONFIG_OPLUS_FEATURE_DNS_HOOK=y
#endif /* OPLUS_FEATURE_DNS_HOOK */

#ifdef OPLUS_FEATURE_STATS_CALC
CONFIG_OPLUS_FEATURE_STATS_CALC=y
#endif /* OPLUS_FEATURE_STATS_CALC */

CONFIG_GC_GC6133_YUV=y

CONFIG_OPLUS_ION_BOOSTPOOL=y
CONFIG_OPLUS_ION_BOOSTPOOL_SUPPORT_PRJ=y

CONFIG_CRYPTO_ZSTD=y
CONFIG_OPLUS_FEATURE_CPU_JANKINFO=y
CONFIG_IRQ_TIME_ACCOUNTING=y

CONFIG_OPLUS_CHG_TEST_KIT=y

CONFIG_OPLUS_FEATURE_HUNG_TASK_ENHANCE=y
CONFIG_OPLUS_FEATURE_DEATH_HEALER=y
CONFIG_DETECT_HUNG_TASK=y

CONFIG_SECURITY_SELINUX_DEVELOP=y

CONFIG_NET_SCH_PRIO=y
CONFIG_NET_CLS_MATCHALL=y
CONFIG_NET_ACT_BPF=y
CONFIG_OPLUS_FEATURE_DATA_MODULE=y
#end

# BSW.Kernel.Performance, 2023/05/08, add for lock optimization in kernel
CONFIG_LOOK_AROUND=y
CONFIG_MAPPED_PROTECT=n
CONFIG_SHRINK_LRU_TRYLOCK=y
CONFIG_LOCKING_PROTECT=y

CONFIG_OPLUS_MEM_MONITOR=y
CONFIG_OPLUS_BLK_MONITOR=y

CONFIG_OPLUS_POWERINFO_STANDBY_DEBUG=y

CONFIG_OPLUS_FEATURE_SIGKILL_DIAGNOSIS=y

CONFIG_OPLUS_FEATURE_ROTATION_DETECT=y
CONFIG_OPLUS_FEATURE_BACK_TAP_DETECT=y
CONFIG_OPLUS_UXMEM_OPT=y
CONFIG_OPLUS_DYNAMIC_READAHEAD=y
CONFIG_PROACTIVE_COMPACT=y
```
