## arch/arm64/configs/k79v1_64_defconfig
```kconfig
CONFIG_POSIX_MQUEUE=y
CONFIG_PREEMPT=y
# CONFIG_LOCALVERSION_AUTO is not set
CONFIG_IRQ_TIME_ACCOUNTING=y
CONFIG_TASK_DELAY_ACCT=y
CONFIG_IKHEADERS=m
#ifndef FEATURE_BUG_STABILITY
#modify dmesg log size to 1MB
#CONFIG_LOG_BUF_SHIFT=19
#else
CONFIG_LOG_BUF_SHIFT=20
#endif
CONFIG_UCLAMP_TASK=y
CONFIG_BLK_CGROUP=y
CONFIG_UCLAMP_TASK_GROUP=y
CONFIG_CGROUP_PIDS=y
CONFIG_CPUSETS=y
CONFIG_SCHED_AUTOGROUP=y
CONFIG_SCHED_TUNE=y
# CONFIG_FHANDLE is not set
CONFIG_KALLSYMS_ALL=y
# CONFIG_KALLSYMS_BASE_RELATIVE is not set
CONFIG_MTK_SCHED_EXTENSION=y
CONFIG_MTK_IDLE_BALANCE_ENHANCEMENT=y
CONFIG_MTK_SCHED_INTEROP=y
CONFIG_MTK_SCHED_LB_ENHANCEMENT=y
CONFIG_MTK_SCHED_TRACERS=y
CONFIG_MTK_SCHED_CPU_PREFER=y
CONFIG_MTK_SCHED_BIG_TASK_MIGRATE=y
# CONFIG_SLUB_DEBUG is not set
# CONFIG_COMPAT_BRK is not set
CONFIG_ARCH_MEDIATEK=y
CONFIG_MACH_MT6779=y
CONFIG_SCHED_MC=y
# CONFIG_ARM64_VHE is not set
CONFIG_RANDOMIZE_BASE=y
# CONFIG_EFI is not set
CONFIG_HIBERNATION=y
#ifdef OPLUS_BUG_STABILITY
CONFIG_BUILD_ARM64_APPENDED_DTB_IMAGE=y
CONFIG_BUILD_ARM64_DTB_OVERLAY_IMAGE=y
CONFIG_BUILD_ARM64_APPENDED_DTB_IMAGE_NAMES="mediatek/mt6779"
CONFIG_BUILD_ARM64_DTB_OVERLAY_IMAGE_NAMES="mediatek/oplus6779_19537 mediatek/oplus6779_19538 mediatek/oplus6779_19551 mediatek/k79v1_64_dummy1 mediatek/k79v1_64_dummy2 mediatek/k79v1_64_dummy3 mediatek/k79v1_64_dummy4 mediatek/oplus6779_19358 mediatek/k79v1_64_dummy5 mediatek/oplus6779_20291"
#endif
CONFIG_WQ_POWER_EFFICIENT_DEFAULT=y
CONFIG_ENERGY_MODEL=y
CONFIG_CPU_IDLE=y
CONFIG_CPU_FREQ=y
CONFIG_CPU_FREQ_STAT=y
CONFIG_CPU_FREQ_DEFAULT_GOV_SCHEDUTIL=y
CONFIG_CPU_FREQ_GOV_POWERSAVE=y
CONFIG_CPU_FREQ_GOV_USERSPACE=y
CONFIG_CPU_FREQ_GOV_ONDEMAND=y
CONFIG_CPU_FREQ_GOV_CONSERVATIVE=y
CONFIG_CPUFREQ_DT=y
CONFIG_ARM_BIG_LITTLE_CPUFREQ=y
CONFIG_ARM_SCPI_CPUFREQ=y
CONFIG_ARM_SCPI_PROTOCOL=y
CONFIG_ARM64_CRYPTO=y
CONFIG_CRYPTO_SHA1_ARM64_CE=y
CONFIG_CRYPTO_SHA2_ARM64_CE=y
CONFIG_CRYPTO_SHA512_ARM64_CE=m
CONFIG_CRYPTO_SHA3_ARM64=m
CONFIG_CRYPTO_SM3_ARM64_CE=m
CONFIG_CRYPTO_GHASH_ARM64_CE=y
CONFIG_CRYPTO_CRC32_ARM64_CE=m
CONFIG_CRYPTO_AES_ARM64_CE_CCM=y
CONFIG_CRYPTO_AES_ARM64_CE_BLK=y
CONFIG_CRYPTO_CHACHA20_NEON=m
CONFIG_CRYPTO_AES_ARM64_BS=m
CONFIG_KPROBES=y
CONFIG_BLK_INLINE_ENCRYPTION=y
CONFIG_BLK_INLINE_ENCRYPTION_FALLBACK=y
# CONFIG_CORE_DUMP_DEFAULT_ELF_HEADERS is not set
CONFIG_MEMORY_FAILURE=y
CONFIG_ZSMALLOC=y
CONFIG_DEFAULT_BIC=y
CONFIG_NETFILTER_XT_TARGET_CHECKSUM=m
CONFIG_NETFILTER_XT_TARGET_LOG=m
CONFIG_NETFILTER_XT_MATCH_ADDRTYPE=m
CONFIG_BRIDGE_VLAN_FILTERING=y
CONFIG_VLAN_8021Q=m
CONFIG_VLAN_8021Q_GVRP=y
CONFIG_VLAN_8021Q_MVRP=y
CONFIG_BT=m
CONFIG_BT_HIDP=m
# CONFIG_BT_HS is not set
# CONFIG_BT_LE is not set
CONFIG_BT_LEDS=y
CONFIG_BT_HCIBTUSB=m
CONFIG_BT_HCIUART=m
CONFIG_BT_HCIUART_LL=y
CONFIG_BT_HCIUART_BCM=y
CONFIG_CFG80211=y
CONFIG_NL80211_TESTMODE=y
CONFIG_MAC80211=m
CONFIG_MAC80211_LEDS=y
CONFIG_RFKILL=y
# CONFIG_UEVENT_HELPER is not set
CONFIG_DEVTMPFS=y
CONFIG_DEVTMPFS_MOUNT=y
# CONFIG_FW_CACHE is not set
CONFIG_SIMPLE_PM_BUS=y
CONFIG_ZRAM=y
CONFIG_BLK_DEV_LOOP_MIN_COUNT=16
CONFIG_VIRTIO_BLK=y
CONFIG_SRAM=y
CONFIG_ANDROID_DEFAULT_SETTING=y
CONFIG_MTK_ANDROID_DEFAULT_SETTING=y
CONFIG_MTK_PLATFORM="mt6779"
CONFIG_ARCH_MTK_PROJECT="k79v1_64"
CONFIG_MTK_CLK_BUFFER=y
CONFIG_MTK_CLKBUF_BBLPM=y
CONFIG_MTK_DCM_MT6779=y
CONFIG_MTK_QOS_FRAMEWORK=y
CONFIG_MTK_BATTERY_OC_POWER_THROTTLING=y
CONFIG_MTK_BATTERY_PERCENTAGE_POWER_THROTTLING=y
CONFIG_MTK_LOW_BATTERY_POWER_THROTTLING=y
CONFIG_MTK_DYNAMIC_LOADING_POWER_THROTTLING=y
CONFIG_MTK_PTPOD=y
CONFIG_MTK_STATIC_POWER=y
CONFIG_MTK_UNIFY_POWER=y
CONFIG_MTK_PPM=y
CONFIG_MTK_CPU_FREQ=y
CONFIG_MTK_PBM=y
CONFIG_MTK_EXTERNAL_CHARGER_TYPE_DETECT=y
CONFIG_MFD_MT6360_PMU=y
CONFIG_MT6360_PMU_CHARGER=y
CONFIG_MT6360_PMU_FLED=y
CONFIG_MT6360_PMIC=y
CONFIG_MT6360_LDO=y
CONFIG_MTK_IMGSENSOR=y
CONFIG_OPLUS_PMIC_COMMON=y
CONFIG_CUSTOM_KERNEL_IMGSENSOR="gm1st_mipi_raw imx471_mipi_raw ov32a_mipi_raw hi846_mipi_raw gc02m0b_mipi_mono0 gc02m0b_mipi_mono1 gc02m0b_mipi_mono2 gc02m1b_mipi_mono0 gc02m1b_mipi_mono1 gc02m1b_mipi_mono2 s5kgw1_mipi_raw s5kgh1_mipi_raw s5k3m5_mipi_raw gc8054_mipi_raw gc02m0_mipi_mono gc02m0f_mipi_mono imx586_mipi_raw gc5035_mipi_raw ov02b10_mipi_raw"
CONFIG_IMGSENSOR_MAIN="gm1st_mipi_raw s5kgw1_mipi_raw imx586_mipi_raw"
CONFIG_IMGSENSOR_MAIN2="hi846_mipi_raw s5kgh1_mipi_raw gc5035_mipi_raw"
CONFIG_IMGSENSOR_SUB="imx471_mipi_raw ov32a_mipi_raw gc8054_mipi_raw"
#CONFIG_MTK_CAM_CAL=y
CONFIG_MTK_DISP_PLATFORM="mt6779"
CONFIG_MTK_LCM=y
CONFIG_CUSTOM_KERNEL_LCM="oplus20291_samsung_ams643xy01_1080p_dsi_vdo oplus19537_samsung_ams643xf01_1080p_dsi_cmd oplus19357_samsung_ams644va04_1080p_dsi_cmd oplus19551_samsung_ams644vk01_1080p_dsi_cmd"
CONFIG_MTK_SYNC=y
CONFIG_MTK_FB=y
CONFIG_MTK_LCM_PHYSICAL_ROTATION="0"
CONFIG_MTK_ROUND_CORNER_SUPPORT=y
CONFIG_LCM_HEIGHT="2400"
CONFIG_MTK_AAL_SUPPORT=y
CONFIG_MTK_M4U=y
CONFIG_MTK_FLASHLIGHT=y
CONFIG_MTK_FLASHLIGHT_MT6360=y
CONFIG_MTK_FLASHLIGHT_PT=y
CONFIG_MTK_FLASHLIGHT_PT_STRICT=y
CONFIG_MTK_FLASHLIGHT_DLPT=y
CONFIG_MTK_IMGSENSOR=y
CONFIG_MTK_LENS=y
CONFIG_MTK_CAM_CAL=y
CONFIG_MTK_CMDQ_V3=y
CONFIG_MTK_CMDQ=y
CONFIG_MTK_VPU_SUPPORT=y
CONFIG_MTK_MDLA_SUPPORT=y
CONFIG_MTK_SMI_EXT=y
CONFIG_MTK_JPEG=y
CONFIG_MTK_CCU=y
CONFIG_MTK_SENSOR_SUPPORT=y
CONFIG_MTK_SENSOR_ARCHITECTURE="1.0"
CONFIG_CUSTOM_KERNEL_ACCELEROMETER=y
CONFIG_MTK_ACCELHUB=y
CONFIG_CUSTOM_KERNEL_ALSPS=y
CONFIG_MTK_ALSPSHUB=y
CONFIG_CUSTOM_KERNEL_GYROSCOPE=y
CONFIG_MTK_GYROHUB=y
CONFIG_CUSTOM_KERNEL_MAGNETOMETER=y
CONFIG_MTK_MAGHUB=y
CONFIG_MTK_HWMON=y
#ifdef OPLUS_FEATURE_SENSOR
#CONFIG_CUSTOM_KERNEL_BAROMETER=y
#CONFIG_MTK_BAROHUB=y
#endif
CONFIG_CUSTOM_KERNEL_STEP_COUNTER=y
CONFIG_MTK_STEPSIGNHUB=y
CONFIG_CUSTOM_KERNEL_SITUATION=y
CONFIG_MTK_STATHUB=y
CONFIG_MTK_WAKEHUB=y
CONFIG_MTK_GLGHUB=y
CONFIG_MTK_PICKUPHUB=y
CONFIG_MTK_DEVICE_ORIENTATION_HUB=y
CONFIG_MTK_MOTION_DETECT_HUB=y
CONFIG_MTK_TILTDETECTHUB=y
CONFIG_CUSTOM_KERNEL_SENSORHUB=y
CONFIG_NANOHUB=y
CONFIG_NANOHUB_MTK_IPI=y
CONFIG_CUSTOM_KERNEL_SENSOR_FUSION=y
#ifdef OPLUS_FEATURE_SENSOR
#CONFIG_CUSTOM_KERNEL_GRV_SENSOR=y
#CONFIG_CUSTOM_KERNEL_GMRV_SENSOR=y
#CONFIG_CUSTOM_KERNEL_RV_SENSOR=y
#CONFIG_CUSTOM_KERNEL_LINEARACCEL_SENSOR=y
#CONFIG_CUSTOM_KERNEL_GRAVITY_SENSOR=y
#endif
CONFIG_CUSTOM_KERNEL_UNCALI_ACC_SENSOR=y
CONFIG_CUSTOM_KERNEL_UNCALI_GYRO_SENSOR=y
CONFIG_CUSTOM_KERNEL_UNCALI_MAG_SENSOR=y
CONFIG_MTK_UNCALI_MAGHUB=y
CONFIG_MTK_UNCALI_GYROHUB=y
CONFIG_MTK_UNCALI_ACCHUB=y
CONFIG_MTK_CCCI_DEVICES=y
CONFIG_MTK_MD1_SUPPORT=12
CONFIG_MTK_ECCCI_DRIVER=y
CONFIG_MTK_ECCCI_C2K=y
CONFIG_MTK_BTIF=y
CONFIG_MTK_COMBO=y
CONFIG_MTK_COMBO_CHIP_CONSYS_6779=y
CONFIG_MTK_COMBO_BT=y
CONFIG_MTK_COMBO_GPS=y
CONFIG_MTK_COMBO_WIFI=y
CONFIG_MTK_GPS_SUPPORT=y
CONFIG_MTK_GPS_EMI=y
CONFIG_MTK_FMRADIO=y
#ifndef OPLUS_ARCH_EXTENDS
#CONFIG_MTK_FM_CHIP="MT6635_FM"
#else
CONFIG_MTK_FM_CHIP="MT6631_FM"
#endif
#ifdef OPLUS_ARCH_EXTENDS
CONFIG_MTK_FM_50KHZ_SUPPORT=y
CONFIG_HSKEY_BLOCK=y
#endif
#ifdef OPLUS_FEATURE_MM_FEEDBACK
CONFIG_OPLUS_FEATURE_MM_FEEDBACK=y
#endif
CONFIG_MTK_CONNSYS_DEDICATED_LOG_PATH=y
CONFIG_HAVE_MTK_ENABLE_GENIEZONE=y
CONFIG_MTK_ENABLE_GENIEZONE=y
CONFIG_MTK_GZ_MAIN=y
CONFIG_MTK_GZ_LOG=y
CONFIG_MTK_GZ_VIRTIO=y
CONFIG_MTK_GZ_VIRTIO_IPC=y
CONFIG_MTK_GZ_IRQ=y
CONFIG_HAVE_MTK_GZ_LOG=y
CONFIG_EXTCON_MTK_USB=y
CONFIG_TCPC_CLASS=y
CONFIG_TCPC_MT6360=y
CONFIG_USB_POWER_DELIVERY=y
CONFIG_MTK_LEDS=y
CONFIG_MTK_AURISYS_PHONE_CALL_SUPPORT=y
CONFIG_MTK_AUDIODSP_SUPPORT=y
CONFIG_MTK_PERF_COMMON=y
CONFIG_MTK_PERF_TRACKER=y
CONFIG_MTK_LOAD_TRACKER=y
CONFIG_MTK_CPU_CTRL_CFP=y
CONFIG_MTK_FPSGO_V3=y
CONFIG_MTK_EARA_THERMAL=y
CONFIG_MTK_TINYSYS_SCP_SUPPORT=y
CONFIG_MTK_TINYSYS_SSPM_SUPPORT=y
CONFIG_MTK_SPMTWAM=y
CONFIG_MTPROF=y
CONFIG_MTK_CM_MGR=y
CONFIG_MTK_CM_MGR_MT6779=y
CONFIG_MTK_LEGACY_THERMAL=y
CONFIG_MTK_THERMAL_PA_VIA_ATCMD=y
CONFIG_MTK_LEGACY_THERMAL_PLATFORM="mt6779"
CONFIG_MTK_CAMERA_ISP_RSC_SUPPORT=y
CONFIG_MTK_CAMERA_ISP_WPE_SUPPORT=y
CONFIG_MTK_CAMERA_ISP_DPE_SUPPORT=y
CONFIG_MTK_CAMERA_ISP_MFB_SUPPORT=y
CONFIG_MTK_CAMERA_ISP_FD_SUPPORT=y
CONFIG_MTK_SELINUX_AEE_WARNING=y
CONFIG_MTK_DRAM_LOG_STORE=y
CONFIG_MTK_DRAM_LOG_STORE_ADDR=0x0011DF00
CONFIG_MTK_DRAM_LOG_STORE_SIZE=0x100
CONFIG_SCSI=y
# CONFIG_SCSI_PROC_FS is not set
CONFIG_BLK_DEV_SD=y
CONFIG_SCSI_UFSHCD=y
CONFIG_SCSI_UFSHCD_PLATFORM=y
CONFIG_SCSI_UFS_MEDIATEK=y
CONFIG_SCSI_UFS_CRYPTO=y
CONFIG_SCSI_UFS_FEATURE=y
CONFIG_SCSI_UFS_TW=y
CONFIG_SCSI_UFS_TW_IGNORE_GUARANTEE_BIT=y
CONFIG_DM_CRYPT=y
CONFIG_DM_DEFAULT_KEY=y
CONFIG_DM_UEVENT=y
CONFIG_DM_VERITY_AVB=y
CONFIG_DM_VERITY_FEC=y
CONFIG_DM_BOW=y
CONFIG_MACVLAN=m
CONFIG_MACVTAP=m
# CONFIG_VIRTIO_NET is not set
CONFIG_MACB=y
CONFIG_HIX5HD2_GMAC=y
CONFIG_HNS_DSAF=y
CONFIG_HNS_ENET=y
CONFIG_QCOM_EMAC=m
CONFIG_MDIO_BUS_MUX_MMIOREG=y
CONFIG_MICREL_PHY=y
CONFIG_REALTEK_PHY=m
CONFIG_USB_PEGASUS=m
CONFIG_USB_RTL8150=m
CONFIG_USB_RTL8152=y
CONFIG_USB_LAN78XX=y
CONFIG_USB_USBNET=y
CONFIG_USB_NET_DM9601=y
CONFIG_USB_NET_SR9700=y
CONFIG_USB_NET_SR9800=y
CONFIG_USB_NET_SMSC75XX=y
CONFIG_USB_NET_SMSC95XX=y
CONFIG_USB_NET_PLUSB=m
CONFIG_USB_NET_MCS7830=m
CONFIG_MWIFIEX=m
CONFIG_WL18XX=m
CONFIG_WLCORE_SDIO=m
CONFIG_KEYBOARD_ADC=m
CONFIG_KEYBOARD_GPIO=y
CONFIG_KEYBOARD_CROS_EC=y
CONFIG_KEYBOARD_MTK_PMIC=y
CONFIG_KEYBOARD_MTK=y
CONFIG_INPUT=y
CONFIG_INPUT_TOUCHSCREEN=y
CONFIG_TOUCHPANEL_OPLUS=y
CONFIG_TOUCHPANEL_MTK_PLATFORM=y
CONFIG_TOUCHPANEL_LATE_INIT=y
#CONFIG_TOUCHSCREEN_ATMEL_MXT=m
#CONFIG_TOUCHSCREEN_MTK_GT1151=y
CONFIG_FW_LOADER_USER_HELPER=y
CONFIG_FW_LOADER_USER_HELPER_FALLBACK=y
CONFIG_TOUCHPANEL_FOCAL=y
CONFIG_TOUCHPANEL_FOCAL_FT3518=y
CONFIG_TOUCHPANEL_GOODIX=y
CONFIG_TOUCHPANEL_GOODIX_GT9886=y

#ifdef OPLUS_FEATURE_TP_BASIC
CONFIG_OPLUS_FW_UPDATE=y
#endif /*OPLUS_FEATURE_TP_BASIC*/

CONFIG_GT1151_CONFIG="FHDP"
CONFIG_TOUCHSCREEN_ATMEL_MXT=m
CONFIG_INPUT_MISC=y
CONFIG_INPUT_UINPUT=y
# CONFIG_SERIO_SERPORT is not set
CONFIG_SERIO_AMBAKMI=y
# CONFIG_VT is not set
# CONFIG_LEGACY_PTYS is not set
# CONFIG_DEVMEM is not set
CONFIG_SERIAL_8250=y
CONFIG_SERIAL_8250_CONSOLE=y
CONFIG_SERIAL_8250_NR_UARTS=2
CONFIG_SERIAL_8250_RUNTIME_UARTS=2
CONFIG_SERIAL_8250_EXTENDED=y
CONFIG_SERIAL_8250_SHARE_IRQ=y
CONFIG_SERIAL_8250_DW=y
CONFIG_SERIAL_8250_MT6577=y
CONFIG_SERIAL_OF_PLATFORM=y
CONFIG_SERIAL_AMBA_PL011=y
CONFIG_SERIAL_AMBA_PL011_CONSOLE=y
CONFIG_SERIAL_XILINX_PS_UART=y
CONFIG_SERIAL_XILINX_PS_UART_CONSOLE=y
CONFIG_SERIAL_DEV_BUS=y
CONFIG_VIRTIO_CONSOLE=y
CONFIG_TCG_TPM=y
CONFIG_I2C_MTK=y
CONFIG_SPI=y
CONFIG_SPI_MT65XX=y
CONFIG_SPI_PL022=y
CONFIG_SPI_ROCKCHIP=y
CONFIG_SPI_SLAVE_MT27XX=y
CONFIG_SPI_SPIDEV=y
CONFIG_SPI_SLAVE=y
CONFIG_SPMI=y
CONFIG_PINCTRL_SINGLE=y
CONFIG_PINCTRL_MAX77620=y
CONFIG_PINCTRL_MT6779=y
CONFIG_GPIO_DWAPB=y
CONFIG_GPIO_MB86S7X=y
CONFIG_GPIO_PL061=y
CONFIG_GPIO_PCA953X=y
CONFIG_GPIO_PCA953X_IRQ=y
CONFIG_GPIO_MAX77620=y
CONFIG_POWER_AVS=y
CONFIG_POWER_RESET_XGENE=y
CONFIG_POWER_RESET_SYSCON=y
CONFIG_BATTERY_SBS=m
CONFIG_BATTERY_BQ27XXX=y
CONFIG_MTK_BATTERY=y
CONFIG_BATTERY_MT6359=y
CONFIG_MTK_CHARGER=y
CONFIG_MTK_KERNEL_POWER_OFF_CHARGING=y
CONFIG_SENSORS_ARM_SCPI=y
CONFIG_SENSORS_LM90=m
CONFIG_SENSORS_INA2XX=m
CONFIG_THERMAL=y
CONFIG_THERMAL_DEFAULT_GOV_BACKWARD_COMPATIBLE=y
CONFIG_CPU_THERMAL=y
CONFIG_THERMAL_EMULATION=y
CONFIG_GENERIC_ADC_THERMAL=y
CONFIG_WATCHDOG=y
CONFIG_MEDIATEK_WATCHDOG=y
CONFIG_MFD_BD9571MWV=y
CONFIG_MFD_CROS_EC=y
CONFIG_MFD_CROS_EC_CHARDEV=m
CONFIG_MFD_HI6421_PMIC=y
CONFIG_MFD_MAX77620=y
CONFIG_MFD_MT6397=y
CONFIG_MFD_RK808=y
CONFIG_MFD_SEC_CORE=y
CONFIG_REGULATOR_FIXED_VOLTAGE=y
CONFIG_REGULATOR_BD9571MWV=y
CONFIG_REGULATOR_FAN53555=y
CONFIG_REGULATOR_GPIO=y
CONFIG_REGULATOR_HI6421V530=y
CONFIG_REGULATOR_MAX77620=y
CONFIG_REGULATOR_MT6359=y
CONFIG_REGULATOR_MTK_DVFSRC=y
CONFIG_REGULATOR_PWM=y
CONFIG_REGULATOR_QCOM_SPMI=y
CONFIG_REGULATOR_RK808=y
CONFIG_REGULATOR_S2MPS11=y
CONFIG_REGULATOR_VCTRL=m
CONFIG_RC_CORE=m
CONFIG_RC_DECODERS=y
CONFIG_RC_DEVICES=y
CONFIG_MEDIA_SUPPORT=y
CONFIG_MEDIA_CAMERA_SUPPORT=y
CONFIG_MEDIA_ANALOG_TV_SUPPORT=y
CONFIG_MEDIA_DIGITAL_TV_SUPPORT=y
CONFIG_VIDEO_V4L2_SUBDEV_API=y
# CONFIG_DVB_NET is not set
CONFIG_MEDIA_USB_SUPPORT=y
CONFIG_USB_VIDEO_CLASS=m
CONFIG_V4L_MEM2MEM_DRIVERS=y
CONFIG_VIDEO_MEDIATEK_VCU_WO_FUSE=y
CONFIG_VIDEO_MEDIATEK_VCODEC=y
CONFIG_MEDIATEK_DVFS=y
CONFIG_MEDIATEK_EMI_BW=y
CONFIG_VB2_MEDIATEK_DMA=y
CONFIG_DRM=y
CONFIG_DRM_RCAR_LVDS=m
CONFIG_DRM_PANEL_SIMPLE=m
CONFIG_MTK_GPU_SUPPORT=y
CONFIG_MTK_GPU_VERSION="rgx lorne m1.10ED5150755"
CONFIG_MTK_GPU_COMMON_DVFS_SUPPORT=y
CONFIG_FB_ARMCLCD=y
CONFIG_BACKLIGHT_GENERIC=m
CONFIG_BACKLIGHT_PWM=m
CONFIG_BACKLIGHT_LP855X=m
CONFIG_LOGO=y
# CONFIG_LOGO_LINUX_MONO is not set
# CONFIG_LOGO_LINUX_VGA16 is not set
CONFIG_SND_DYNAMIC_MINORS=y
CONFIG_SND_USB_AUDIO=y
CONFIG_SND_SOC=y
CONFIG_SND_SOC_MT6779=y
CONFIG_SND_SOC_MT6779_MT6359=y
CONFIG_SND_SOC_MTK_BTCVSD=y
CONFIG_SND_SOC_MTK_AUDIO_DSP=y
CONFIG_SND_SOC_AK4613=m
CONFIG_SND_SOC_MT6660=y
CONFIG_SND_SIMPLE_CARD=m
CONFIG_SND_AUDIO_GRAPH_CARD=m
#ifdef OPLUS_ARCH_EXTENDS
# CONFIG_SND_SOC_AW87339=y
CONFIG_SIA_PA_ALGO=y
#endif /*OPLUS_ARCH_EXTENDS*/
CONFIG_HIDRAW=y
CONFIG_HID_KYE=y
CONFIG_HID_MULTITOUCH=y
CONFIG_HID_PLANTRONICS=y
CONFIG_USB_OTG=y
CONFIG_USB_XHCI_HCD=y
CONFIG_USB_EHCI_HCD=y
CONFIG_USB_EHCI_HCD_PLATFORM=y
CONFIG_USB_OHCI_HCD=y
CONFIG_USB_OHCI_HCD_PLATFORM=y
CONFIG_USB_STORAGE=y
CONFIG_USB_STORAGE_DATAFAB=y
CONFIG_USB_STORAGE_FREECOM=y
CONFIG_USB_STORAGE_ISD200=y
CONFIG_USB_STORAGE_USBAT=y
CONFIG_USB_STORAGE_SDDR09=y
CONFIG_USB_STORAGE_SDDR55=y
CONFIG_USB_STORAGE_JUMPSHOT=y
CONFIG_USB_STORAGE_ALAUDA=y
CONFIG_USB_STORAGE_ONETOUCH=y
CONFIG_USB_STORAGE_KARMA=y
CONFIG_USB_STORAGE_CYPRESS_ATACB=y
CONFIG_USB_MTU3=y
CONFIG_NOP_USB_XCEIV=y
CONFIG_USB_ULPI=y
CONFIG_USB_CONFIGFS_SERIAL=y
CONFIG_USB_CONFIGFS_ACM=y
CONFIG_USB_CONFIGFS_RNDIS=y
CONFIG_USB_CONFIGFS_MASS_STORAGE=y
CONFIG_USB_CONFIGFS_MTK_FASTMETA=y
CONFIG_USB_CONFIGFS_F_HID=y
CONFIG_USB_CONFIGFS_F_UVC=y
CONFIG_MMC=y
CONFIG_MMC_BLOCK_MINORS=32
CONFIG_MMC_MTK_PRO=y
CONFIG_MTK_EMMC_SUPPORT=y
CONFIG_MTK_EMMC_CACHE=y
CONFIG_MTK_EMMC_SUPPORT_OTP=y
CONFIG_NEW_LEDS=y
CONFIG_LEDS_CLASS=y
CONFIG_LEDS_GPIO=y
CONFIG_LEDS_SYSCON=y
CONFIG_LEDS_REGULATOR_VIBRATOR=y
CONFIG_LEDS_TRIGGER_HEARTBEAT=y
CONFIG_LEDS_TRIGGER_CPU=y
CONFIG_LEDS_TRIGGER_DEFAULT_ON=y
CONFIG_LEDS_TRIGGER_PANIC=y
CONFIG_EDAC=y
CONFIG_RTC_DRV_MT6397=y
CONFIG_DMADEVICES=y
CONFIG_MV_XOR_V2=y
CONFIG_PL330_DMA=y
CONFIG_MTK_HSDMA=y
CONFIG_MTK_UART_APDMA=y
CONFIG_QCOM_HIDMA_MGMT=y
CONFIG_QCOM_HIDMA=y
CONFIG_VIRTIO_BALLOON=y
CONFIG_VIRTIO_MMIO=y
CONFIG_ANDROID_INTF_ALARM_DEV=y
CONFIG_ION=y
CONFIG_ION_SYSTEM_HEAP=y
CONFIG_MTK_ION_DEBUG=y
CONFIG_MTK_ION_SEC_HEAP=y
CONFIG_MTK_ION=y
CONFIG_CROS_EC_SPI=y
CONFIG_COMMON_CLK_SCPI=y
CONFIG_CLK_QORIQ=y
CONFIG_COMMON_CLK_PWM=y
CONFIG_COMMON_CLK_MT6779=y
CONFIG_COMMON_CLK_MT6779_MMSYS=y
CONFIG_COMMON_CLK_MT6779_IMGSYS=y
CONFIG_COMMON_CLK_MT6779_IPESYS=y
CONFIG_COMMON_CLK_MT6779_CAMSYS=y
CONFIG_COMMON_CLK_MT6779_VDECSYS=y
CONFIG_COMMON_CLK_MT6779_VENCSYS=y
CONFIG_COMMON_CLK_MT6779_MFGCFG=y
CONFIG_COMMON_CLK_MT6779_AUDSYS=y
CONFIG_COMMON_CLK_MT6779_APUVCORESYS=y
CONFIG_COMMON_CLK_MT6779_APUCONNSYS=y
CONFIG_COMMON_CLK_MT6779_APU0SYS=y
CONFIG_COMMON_CLK_MT6779_APU1SYS=y
CONFIG_COMMON_CLK_MT6779_MDLASYS=y
CONFIG_COMMON_CLK_MTK_FREQ_HOPPING=y
CONFIG_COMMON_CLK_MTK_FREQ_HOPPING_SSPM=y
CONFIG_HWSPINLOCK=y
CONFIG_ARM_MHU=y
CONFIG_PLATFORM_MHU=y
CONFIG_RPMSG_QCOM_GLINK_RPM=y
CONFIG_MTK_PMIC_WRAP=y
CONFIG_MTK_SCPSYS_BRINGUP=y
CONFIG_MTK_PMQOS=y
CONFIG_DEVFREQ_GOV_PERFORMANCE=y
CONFIG_IIO=y
CONFIG_IIO_KFIFO_BUF=y
CONFIG_MEDIATEK_MT635X_AUXADC=y
CONFIG_MEDIATEK_MT6577_AUXADC=y
CONFIG_IIO_CROS_EC_SENSORS_CORE=m
CONFIG_IIO_CROS_EC_SENSORS=m
CONFIG_IIO_CROS_EC_LIGHT_PROX=m
CONFIG_IIO_CROS_EC_BARO=m
CONFIG_PWM=y
CONFIG_PWM_CROS_EC=m
CONFIG_PWM_MEDIATEK=y
CONFIG_PHY_MTK_TPHY=y
CONFIG_ANDROID_BINDER_USER_TRACKING=y
CONFIG_MTK_EFUSE=y
CONFIG_MTK_DEVINFO=y
CONFIG_MT6359_EFUSE=y
CONFIG_EXT3_FS=y
CONFIG_EXT4_FS_SECURITY=y
CONFIG_EXT4_ENCRYPTION=y
CONFIG_FS_ENCRYPTION_INLINE_CRYPT=y
CONFIG_FANOTIFY=y
CONFIG_FANOTIFY_ACCESS_PERMISSIONS=y
CONFIG_QUOTA_NETLINK_INTERFACE=y
CONFIG_OVERLAY_FS=y
CONFIG_INCREMENTAL_FS=y
CONFIG_VFAT_FS=y
CONFIG_NLS_UTF8=y
CONFIG_EXFAT_FS=y
CONFIG_EROFS_FS=y
CONFIG_PSTORE=y
CONFIG_PSTORE_CONSOLE=y
CONFIG_PSTORE_PMSG=y
CONFIG_PSTORE_RAM=y
CONFIG_NLS_CODEPAGE_437=y
CONFIG_NLS_ISO8859_1=y
CONFIG_STATIC_USERMODEHELPER=y
CONFIG_STATIC_USERMODEHELPER_PATH="/system_ext/bin/aee_core_forwarder"
#ifdef OPLUS_FEATURE_FORCE_SELINUX
CONFIG_SECURITY_SELINUX_DEVELOP=y
#endif OPLUS_FEATURE_FORCE_SELINUX
CONFIG_OPLUS_FEATURE_PMIC_MONITOR_MTK=y
CONFIG_CRYPTO_ZSTD=y
CONFIG_CRYPTO_ANSI_CPRNG=y
CONFIG_CRC8=y
CONFIG_PRINTK_TIME=y
CONFIG_DYNAMIC_DEBUG=y
CONFIG_DEBUG_INFO=y
CONFIG_FRAME_WARN=3600
# CONFIG_DEBUG_PREEMPT is not set
CONFIG_MTK_FTRACER=y
CONFIG_MEMTEST=y

CONFIG_USB_CONFIGFS_MTK_FASTMETA=y
CONFIG_MTK_ADDITIONAL_BATTERY_TABLE=y
CONFIG_OPLUS_CHARGER=y
CONFIG_OPLUS_CHARGER_MTK=y
CONFIG_OPLUS_CHARGER_MTK_CHGIC=y
CONFIG_OPLUS_CHARGER_MTK6779R=y
CONFIG_OPLUS_CHARGER_MATCH_MTKGAUGE=y
CONFIG_OPLUS_CHARGER_MTKAGING=y
CONFIG_OPLUS_4400MV_BATTERY_SUPPORT=y
CONFIG_OPLUS_CALL_MODE_SUPPORT=y
CONFIG_OPLUS_CHECK_CHARGERID_VOLT=y
CONFIG_OPLUS_SHIP_MODE_SUPPORT=y
CONFIG_OPLUS_SHORT_C_BATT_CHECK=y
CONFIG_OPLUS_SHORT_HW_CHECK=y
CONFIG_OPLUS_SHORT_USERSPACE=y
CONFIG_OPLUS_CHIP_SOC_NODE=y
CONFIG_OPLUS_RTC_DET_SUPPORT=y
CONFIG_OPLUS_ARCH_FILE=y
CONFIG_OPLUS_DEVICE_IFNO=y
CONFIG_OPLUS_COMMON_SOFT=y
CONFIG_OPLUS_HVDCP_SUPPORT=y
CONFIG_OPLUS_SHORT_IC_CHECK=y
CONFIG_OPLUS_DUAL_CHARGER_SUPPORT=y
CONFIG_OPLUS_SMART_CHARGER_SUPPORT=y
#ifdef OPLUS_FEATURE_SECURITY_COMMON
CONFIG_OPLUS_SECURE=y
CONFIG_OPLUS_SECURE_QCOM=n
CONFIG_OPLUS_SECURE_MTK=y
CONFIG_OPLUS_SECURE_COMMON=y
#endif /* OPLUS_FEATURE_SECURITY_COMMON */

#ifdef OPLUS_BUG_STABILITY
CONFIG_OPLUS_SYSTEM_KERNEL=y
CONFIG_OPLUS_FEATURE_SHUTDOWN_DETECT=y
CONFIG_OPLUS_FEATURE_OPROJECT=y
#CONFIG_SECTION_MISMATCH_WARN_ONLY=y
CONFIG_OPLUS_FEATURE_FEEDBACK=y
CONFIG_OPLUS_DEVICE_IFNO=y
CONFIG_OPLUS_COMMON_SOFT=y
CONFIG_OPLUS_FEATURE_MTK_FORCE_SHUTDOWN=y
#endif /* OPLUS_BUG_STABILITY */

CONFIG_OPLUS_FEATURE_AUDIO_OPT=y

#ifdef OPLUS_FEATURE_PHOENIX
CONFIG_OPLUS_FEATURE_PHOENIX=y
#endif

#ifdef OPLUS_FEATURE_ZRAM_OPT
CONFIG_OPLUS_ZRAM_OPT=y
CONFIG_CRYPTO_LZ4=y
CONFIG_PGTABLE_MAPPING=y
#endif /* OPLUS_FEATURE_ZRAM_OPT */

CONFIG_DYNAMIC_TUNNING_SWAPPINESS=y

#ifdef OPLUS_FEATURE_SENSOR_ALGORITHM
CONFIG_OPLUS_FEATURE_CAMERA_PROTECT=y
CONFIG_OPLUS_FEATURE_FREE_FALL=y
CONFIG_OPLUS_FEATURE_PICKUP_DETECT=y
CONFIG_OPLUS_FEATURE_FP_DISPLAY=y
CONFIG_OPLUS_FEATURE_LUX_AOD=y
CONFIG_OPLUS_FEATURE_PEDO_MINUTE=y
CONFIG_OPLUS_FEATURE_TP_GESTURE=y
#endif /*OPLUS_FEATURE_SENSOR_ALGORITHM*/

#ifdef OPLUS_FEATURE_TASK_CPUSTATS
CONFIG_OPLUS_CTP=y
#endif /* OPLUS_FEATURE_TASK_CPUSTATS */

#ifdef OPLUS_FEATURE_SCHED_ASSIST
CONFIG_SCHED_WALT=y
#CONFIG_OPLUS_FEATURE_SCHED_SPREAD=y
#endif /* OPLUS_FEATURE_SCHED_ASSIST */
#ifdef OPLUS_FEATURE_WIFI_CAPCENTER
CONFIG_OPLUS_FEATURE_WIFI_CAPCENTER=y
#endif /* OPLUS_FEATURE_WIFI_CAPCENTER */
#ifndef OPLUS_FEATURE_SECURITY_COMMON
CONFIG_TEE=y
CONFIG_TRUSTONIC_TEE_SUPPORT=y
CONFIG_MTK_TEE_GP_SUPPORT=y
CONFIG_TRUSTONIC_TEE_VERSION=500
#endif /*OPLUS_FEATURE_SECURITY_COMMON*/

#ifdef OPLUS_FEATURE_SECURITY_COMMON
CONFIG_MODULE_SIG=y
CONFIG_MODULE_SIG_FORCE=y
CONFIG_MODULE_SIG_ALL=y
CONFIG_MODULE_SIG_SHA512=y
#endif /* OPLUS_FEATURE_SECURITY_COMMON */

#ifdef OPLUS_FEATURE_SECURITY_COMMON
CONFIG_MTK_DRM_KEY_MNG_SUPPORT=y
CONFIG_MTK_SEC_VIDEO_PATH_SUPPORT=y
#endif /* OPLUS_FEATURE_SECURITY_COMMON */

#ifdef OPLUS_FEATURE_SECURITY_COMMON
CONFIG_SHADOW_CALL_STACK=y
#endif /* OPLUS_FEATURE_SECURITY_COMMON */

#ifdef OPLUS_FEATURE_SENSOR_ALGORITHM
CONFIG_OPLUS_SENSOR_FB_MTK=y
#CONFIG_OPLUS_FEATURE_SENSOR_MONITOR=y
CONFIG_MTK_TINYSYS_SCP_CM4_SUPPORT=y
CONFIG_OF_RESERVED_MEM=y
#endif /*OPLUS_FEATURE_SENSOR_ALGORITHM*/

#ifdef OPLUS_FEATURE_FINGERPRINT
CONFIG_OPLUS_FINGERPRINT=y
CONFIG_OPLUS_FINGERPRINT_MTK=y
CONFIG_OPLUS_FINGERPRINT_GOODIX_OPTICAL=y
CONFIG_OPLUS_FINGERPRINT_EGIS_OPTICAL=y

CONFIG_OPLUS_FINGERPRINT_GOODIX=y
CONFIG_OPLUS_FINGERPRINT_FPC=y
#endif /* OPLUS_FEATURE_FINGERPRINT */
#ifdef OPLUS_FEATURE_ACTIVITY_RECOGNITION
CONFIG_OPLUS_FEATURE_ACTIVITY_RECOGNITION=y
#endif //OPLUS_FEATURE_ACTIVITY_RECOGNITION

#ifdef OPLUS_FEATURE_ELEVATOR_DETECT
CONFIG_OPLUS_FEATURE_ELEVATOR_DETECT=y
#endif //OPLUS_FEATURE_ELEVATOR_DETECT
#ifdef OPLUS_FEATURE_SENSOR
CONFIG_OPLUS_ALS_CALI=y
#endif
#ifdef OPLUS_FEATURE_CHG_BASIC
CONFIG_MTK_TYPEC_WATER_DETECT=y
#endif
#ifdef OPLUS_FEATURE_THEIA
CONFIG_OPLUS_FEATURE_THEIA=y
#endif /* OPLUS_FEATURE_THEIA */

#ifdef OPLUS_FEATURE_NFC_BRINGUP
CONFIG_OPLUS_NFC=y
CONFIG_ST_NFC_CHIP_SUPPORT=y
CONFIG_MTK_CLKBUF_NFC=y
CONFIG_NFC_PN553_DEVICES=y
CONFIG_NXP_P73_DEVICES=y
#endif /* OPLUS_FEATURE_NFC_BRINGUP */

#ifdef OPLUS_FEATURE_STORAGE_TOOL
CONFIG_CHR_DEV_SG=y
#endif

#enable sdcardfs
CONFIG_SDCARD_FS=y
#enable sdcardfs

CONFIG_OPLUS_FEATURE_EXT4_FSYNC=y

#ifdef OPLUS_FEATURE_PROCESS_RECLAIM
CONFIG_PROCESS_RECLAIM=y
#endif

#ifdef OPLUS_FEATURE_LOWMEM_DBG
CONFIG_OPLUS_FEATURE_LOWMEM_DBG=y
#endif /* OPLUS_FEATURE_LOWMEM_DBG */

#ifdef OPLUS_FEATURE_NANDSWAP
#Add for NandSwap
CONFIG_NANDSWAP=y
#CONFIG_NANDSWAP_DEBUG=y
#endif /*OPLUS_FEATURE_NANDSWAP*/

#ifdef OPLUS_FEATURE_ACM
CONFIG_OPLUS_FEATURE_ACM=y
CONFIG_OPLUS_FEATURE_ACM_LOGGING=y
#endif /* OPLUS_FEATURE_ACM */

#ifdef OPLUS_FEATURE_HANS_FREEZE
CONFIG_OPLUS_HANS=y
#endif /* OPLUS_FEATURE_HANS_FREEZE */

#ifdef OPLUS_FEATURE_UID_PERF
CONFIG_OPLUS_FEATURE_UID_PERF=y
#endif

#ifdef OPLUS_FEATURE_WIFI_SLA
#todo: need to change to m when GKI
CONFIG_OPLUS_FEATURE_WIFI_SLA=y
#endif /* OPLUS_FEATURE_WIFI_SLA */

#ifdef OPLUS_FEATURE_DATA_LIMIT
CONFIG_IFB=y
CONFIG_NET_SCH_MULTIQ=y
CONFIG_NET_SCH_NETEM=y
CONFIG_CLS_U32_MARK=y
CONFIG_NET_CLS_FLOW=y
CONFIG_NET_EMATCH_CMP=y
CONFIG_NET_EMATCH_NBYTE=y
CONFIG_NET_EMATCH_META=y
CONFIG_NET_EMATCH_TEXT=y
CONFIG_NET_ACT_GACT=y
CONFIG_NET_ACT_MIRRED=y
CONFIG_NET_ACT_SKBEDIT=y
#endif /* OPLUS_FEATURE_DATA_LIMIT */

#ifdef OPLUS_FEATURE_MEMLEAK_DETECT
CONFIG_KMALLOC_DEBUG=y
CONFIG_VMALLOC_DEBUG=y
CONFIG_DUMP_TASKS_MEM=y
CONFIG_SVELTE=y
#endif /*OPLUS_FEATURE_MEMLEAK_DETECT*/

#ifdef OPLUS_FEATURE_DATA_EVAL
CONFIG_OPLUS_FEATURE_DATA_EVAL=y
#endif /*OPLUS_FEATURE_DATA_EVAL*/

CONFIG_SCHEDSTATS=y
#ifdef OPLUS_FEATURE_IOMONITOR
#CONFIG_IOMONITOR=y
CONFIG_IOMONITOR_WITH_F2FS=n
#endif /*OPLUS_FEATURE_IOMONITOR*/

#ifdef OPLUS_FEATURE_DNS_HOOK
CONFIG_OPLUS_FEATURE_DNS_HOOK=y
#endif /* OPLUS_FEATURE_DNS_HOOK */

CONFIG_F2FS_FS_ENCRYPTION=y

#ifdef OPLUS_FEATURE_HEALTHINFO
CONFIG_OPLUS_MEM_MONITOR=y
CONFIG_FG_TASK_UID=y
CONFIG_OPLUS_HEALTHINFO=y
CONFIG_SLAB_STAT_DEBUG=y
CONFIG_SLUB_DEBUG=n
#endif /*OPLUS_FEATURE_HEALTHINFO*/

#ifdef OPLUS_FEATURE_HEALTHINFO
CONFIG_OPLUS_JANK_INFO=y
#endif /* OPLUS_FEATURE_HEALTHINFO */

CONFIG_EXT4_ASYNC_DISCARD_SUPPORT=y

#ifdef OPLUS_FEATURE_SCHED_ASSIST
CONFIG_BLK_WBT_SQ=y
CONFIG_BLK_WBT=y
CONFIG_OPLUS_FEATURE_UXIO_FIRST=y
#endif /*OPLUS_FEATURE_SCHED_ASSIST*/
#CONFIG_OPLUS_BINDER_STRATEGY=y

#ifdef OPLUS_FEATURE_STATS_CALC
CONFIG_OPLUS_FEATURE_STATS_CALC=y
#endif /* OPLUS_FEATURE_STATS_CALC */

CONFIG_MTK_HDR_COLOR_GAIN_RGB=03DD40037A

CONFIG_OPLUS_FEATURE_OLC=y
```
