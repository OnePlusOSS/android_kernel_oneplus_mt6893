## drivers/soc/oplus/oplus_als_cali_value/Kconfig
```kconfig
config OPLUS_ALS_CALI
	bool "config oplus als cali"
	help
		define this config to compile oplus_als_cali_value.c for device register
```

## drivers/soc/oplus/oplus_criticallog/Kconfig
```kconfig
config OPLUS_CRITICALLOG
	bool "config oplus critical log"
	help
		define this config to init oplus critical log driver.
```

## drivers/soc/oplus/oplus_overload/Kconfig
```kconfig
config OPLUS_FEATURE_ABNORMAL_FLAG
	tristate "task_overload"
	default n
	help
	  abnormal thread detection
```
