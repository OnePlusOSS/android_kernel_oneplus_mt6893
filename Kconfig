## arch/arm64/configs/k65v1_64_bsp_non_ab_debug_defconfig
```kconfig
CONFIG_PREEMPT=y
CONFIG_IKHEADERS=m
# CONFIG_LOCALVERSION_AUTO is not set
#ifndef FEATURE_BUG_STABILITY
#modify dmesg log size to 1MB
#CONFIG_LOG_BUF_SHIFT=19
#else
CONFIG_LOG_BUF_SHIFT=20
#endif
CONFIG_UCLAMP_TASK=y
CONFIG_BLK_CGROUP=y
CONFIG_UCLAMP_TASK_GROUP=y
CONFIG_CPUSETS=y
CONFIG_SCHED_AUTOGROUP=y
CONFIG_SCHED_TUNE=y
# CONFIG_RD_BZIP2 is not set
# CONFIG_RD_LZMA is not set
# CONFIG_RD_XZ is not set
# CONFIG_RD_LZO is not set
# CONFIG_RD_LZ4 is not set
CONFIG_CC_OPTIMIZE_FOR_SIZE=y
# CONFIG_SYSFS_SYSCALL is not set
# CONFIG_FHANDLE is not set
# CONFIG_KALLSYMS_BASE_RELATIVE is not set
# CONFIG_RSEQ is not set
CONFIG_MTK_SCHED_EXTENSION=y
CONFIG_MTK_IDLE_BALANCE_ENHANCEMENT=y
CONFIG_MTK_SCHED_INTEROP=y
CONFIG_MTK_SCHED_LB_ENHANCEMENT=y
CONFIG_MTK_SCHED_TRACERS=y
CONFIG_MTK_SCHED_CPU_PREFER=y
CONFIG_MTK_SCHED_BIG_TASK_MIGRATE=y
# CONFIG_COMPAT_BRK is not set
# CONFIG_SLAB_MERGE_DEFAULT is not set
CONFIG_SLAB_FREELIST_RANDOM=y
CONFIG_SLAB_FREELIST_HARDENED=y
CONFIG_ARCH_MEDIATEK=y
CONFIG_MACH_MT6765=y
CONFIG_PCI=y
CONFIG_PCI_HOST_GENERIC=y
CONFIG_SCHED_MC=y
CONFIG_PARAVIRT=y
CONFIG_RANDOMIZE_BASE=y
CONFIG_PM_WAKELOCKS_LIMIT=0
# CONFIG_PM_WAKELOCKS_GC is not set
CONFIG_WQ_POWER_EFFICIENT_DEFAULT=y
CONFIG_ENERGY_MODEL=y
CONFIG_CPU_FREQ=y
CONFIG_CPU_FREQ_DEFAULT_GOV_SCHEDUTIL=y
CONFIG_CPU_FREQ_GOV_POWERSAVE=y
CONFIG_CPU_FREQ_GOV_CONSERVATIVE=y
CONFIG_ARM_SCPI_CPUFREQ=y
CONFIG_ARM_SCMI_CPUFREQ=y
CONFIG_ARM_SCMI_PROTOCOL=y
# CONFIG_ARM_SCMI_POWER_DOMAIN is not set
CONFIG_ARM_SCPI_PROTOCOL=y
# CONFIG_ARM_SCPI_POWER_DOMAIN is not set
CONFIG_ARM64_CRYPTO=y
CONFIG_CRYPTO_SHA2_ARM64_CE=y
CONFIG_CRYPTO_AES_ARM64_CE_BLK=y
CONFIG_KPROBES=y
CONFIG_BLK_INLINE_ENCRYPTION=y
CONFIG_BLK_INLINE_ENCRYPTION_FALLBACK=y
CONFIG_GKI_HACKS_TO_FIX=y
# CONFIG_CORE_DUMP_DEFAULT_ELF_HEADERS is not set
CONFIG_CMA_AREAS=16
CONFIG_ZSMALLOC=y
CONFIG_DEFAULT_BIC=y
CONFIG_TIPC=y
CONFIG_VSOCKETS=y
CONFIG_VIRTIO_VSOCKETS=y
CONFIG_BT=y
CONFIG_CFG80211=y
CONFIG_NL80211_TESTMODE=y
# CONFIG_CFG80211_DEFAULT_PS is not set
# CONFIG_CFG80211_CRDA_SUPPORT is not set
CONFIG_MAC80211=y
# CONFIG_MAC80211_RC_MINSTREL is not set
CONFIG_RFKILL=y
# CONFIG_UEVENT_HELPER is not set
# CONFIG_FW_CACHE is not set
# CONFIG_ALLOW_DEV_COREDUMP is not set
CONFIG_DEBUG_DEVRES=y
CONFIG_ZRAM=y
CONFIG_BLK_DEV_LOOP_MIN_COUNT=16
CONFIG_BLK_DEV_RAM_SIZE=8192
CONFIG_VIRTIO_BLK=y
CONFIG_ANDROID_DEFAULT_SETTING=y
CONFIG_MTK_ANDROID_DEFAULT_SETTING=y
CONFIG_USB_MTK_HDRC=y
CONFIG_MTK_MUSB_QMU_SUPPORT=y
CONFIG_MTK_MUSB_QMU_PURE_ZLP_SUPPORT=y
CONFIG_MTK_MUSB_DRV_36BIT=y
CONFIG_USB_MTK_OTG=y
CONFIG_MTK_MUSB_DUAL_ROLE=y
CONFIG_MTK_PLATFORM="mt6765"
CONFIG_ARCH_MTK_PROJECT="k65v1_64_bsp"
CONFIG_MTK_ENG_BUILD=y
CONFIG_MTK_CLK_BUFFER=y
CONFIG_MTK_CLKBUF_BBLPM=y
CONFIG_MTK_DCM_MT6765=y
CONFIG_MTK_QOS_FRAMEWORK=y
CONFIG_MTK_BATTERY_OC_POWER_THROTTLING=y
CONFIG_MTK_BATTERY_PERCENTAGE_POWER_THROTTLING=y
CONFIG_MTK_LOW_BATTERY_POWER_THROTTLING=y
CONFIG_MTK_DYNAMIC_LOADING_POWER_THROTTLING=y
CONFIG_MTK_PTPOD=y
CONFIG_MTK_STATIC_POWER=y
CONFIG_MTK_UNIFY_POWER=y
CONFIG_MTK_CPU_FREQ=y
CONFIG_MTK_PBM=y
CONFIG_MFD_MT6370_PMU=y
CONFIG_MT6370_PMU_CHARGER=y
CONFIG_MT6370_PMU_FLED=y
CONFIG_MT6370_PMU_BLED=y
CONFIG_MT6370_PMU_LDO=y
CONFIG_MT6370_PMU_DSV=y
CONFIG_CUSTOM_KERNEL_IMGSENSOR="parkera_qtech_main_ov13b10 parkera_shinetech_mono_gc02m1b parkera_shinetech_mono_ov02b1b parkera_holitech_macro_gc02m1 parkera_shinetech_macro_ov02b10 parkera_holitech_front_s5k4h7 parkera_shinetech_front_ov08d10 parkera_shinetech_main_s5kjn103 parkera_qtech_main_ov13b2a parkera_shinetech_mono_gc02m1b_50m parkera_shinetech_mono_ov02b1b_50m parkerb_shinetech_main_s5kjn103 parkerb_sunny_front_s5k3p9sp parkerb_shinetech_mono_gc02m1b parkerb_hlt_micro_gc02m1 parkerb_shinetech_macro_ov02b10"
CONFIG_MTK_VIDEOCODEC_DRIVER=y
CONFIG_MTK_LCM=y
CONFIG_CUSTOM_KERNEL_LCM="oplus21251_csot_ili7807s_hdp_dsi_vdo_lcm oplus21251_boe_ili9882n_hdp_dsi_vdo_lcm ilt7807s_hlt_jelly_hdp_dsi_vdo_lcm hx83102d_txd_jelly_hdp_dsi_vdo_lcm ilt9882q_innolux_jelly_hdp_dsi_vdo_lcm oplus21331_td4160_inx_hdp_dsi_vdo_lcm oplus21331_ili9883c_hlt_hdp_dsi_vdo_lcm oplus21331_ili9883c_boe_hdp_dsi_vdo_lcm virtual_dsi_jelly_vdo_default"
CONFIG_MTK_LCM_DEVICE_TREE_SUPPORT_PASCAL_E=y
CONFIG_MTK_CUSTOM_LCM_DIFFERENT=y
CONFIG_MTK_SYNC=y
CONFIG_MTK_FB=y
CONFIG_MTK_LCM_PHYSICAL_ROTATION="0"
CONFIG_MTK_ROUND_CORNER_SUPPORT=y
CONFIG_MTK_AAL_SUPPORT=y
CONFIG_MTK_M4U=y
CONFIG_MTK_FLASHLIGHT=y
#CONFIG_MTK_FLASHLIGHT_PASCAL=y
CONFIG_MTK_FLASHLIGHT_PARKERA=y
CONFIG_MTK_FLASHLIGHT_PARKERB=y
CONFIG_MTK_FLASHLIGHT_PT=y
CONFIG_MTK_FLASHLIGHT_PT_STRICT=y
CONFIG_MTK_FLASHLIGHT_DLPT=y
CONFIG_RT_FLASHLIGHT=y
CONFIG_MTK_IMGSENSOR=y
CONFIG_MTK_LENS=y
CONFIG_MTK_CAM_CAL=y
CONFIG_MTK_CMDQ_V3=y
CONFIG_MTK_CMDQ=y
CONFIG_MTK_SMI_EXT=y
CONFIG_MTK_JPEG=y
CONFIG_MTK_CCU=y
CONFIG_MTK_CAM_SECURITY_SUPPORT=y
CONFIG_MTK_CAM_GENIEZONE_SUPPORT=y
CONFIG_MTK_SENSOR_SUPPORT=y
CONFIG_MTK_SENSOR_ARCHITECTURE="1.0"
CONFIG_CUSTOM_KERNEL_ACCELEROMETER=y
CONFIG_MTK_ACCELHUB=y
CONFIG_CUSTOM_KERNEL_ALSPS=y
CONFIG_MTK_ALSPSHUB=y
CONFIG_CUSTOM_KERNEL_MAGNETOMETER=y
CONFIG_MTK_MAGHUB=y
CONFIG_MTK_HWMON=y
CONFIG_CUSTOM_KERNEL_BAROMETER=y
CONFIG_MTK_SAR_HUB=y
CONFIG_MTK_BAROHUB=y
CONFIG_CUSTOM_KERNEL_STEP_COUNTER=y
CONFIG_MTK_STEPSIGNHUB=y
CONFIG_CUSTOM_KERNEL_SITUATION=y
CONFIG_MTK_STATHUB=y
CONFIG_MTK_WAKEHUB=y
CONFIG_MTK_GLGHUB=y
CONFIG_MTK_PICKUPHUB=y
CONFIG_MTK_DEVICE_ORIENTATION_HUB=y
CONFIG_MTK_TILTDETECTHUB=y
CONFIG_CUSTOM_KERNEL_SENSORHUB=y
CONFIG_NANOHUB=y
CONFIG_NANOHUB_MTK_IPI=y
CONFIG_CUSTOM_KERNEL_GRV_SENSOR=y
CONFIG_CUSTOM_KERNEL_GMRV_SENSOR=y
CONFIG_CUSTOM_KERNEL_RV_SENSOR=y
CONFIG_CUSTOM_KERNEL_LINEARACCEL_SENSOR=y
CONFIG_CUSTOM_KERNEL_GRAVITY_SENSOR=y
CONFIG_CUSTOM_KERNEL_UNCALI_MAG_SENSOR=y
CONFIG_OPLUS_FEATURE_PICKUP_DETECT=y
CONFIG_OPLUS_FEATURE_FP_DISPLAY=y
CONFIG_OPLUS_FEATURE_LUX_AOD=y
CONFIG_OPLUS_FEATURE_PEDO_MINUTE=y
CONFIG_MTK_CCCI_DEVICES=y
CONFIG_MTK_MD1_SUPPORT=12
CONFIG_MTK_ECCCI_DRIVER=y
CONFIG_MTK_ECCCI_C2K=y
CONFIG_MTK_BTIF=y
CONFIG_MTK_COMBO=y
CONFIG_MTK_COMBO_CHIP_CONSYS_6765=y
CONFIG_MTK_COMBO_GPS=y
CONFIG_MTK_COMBO_WIFI=y
CONFIG_MTK_DHCPV6C_WIFI=y
CONFIG_MTK_GPS_SUPPORT=y
CONFIG_MTK_GPS_EMI=y
CONFIG_MTK_FMRADIO=y
CONFIG_MTK_FM_CHIP="MT6631_FM"
CONFIG_MTK_CONNSYS_DEDICATED_LOG_PATH=y
CONFIG_HAVE_MTK_ENABLE_GENIEZONE=y
CONFIG_MTK_ENABLE_GENIEZONE=y
CONFIG_MTK_GZ_MAIN=y
CONFIG_MTK_GZ_LOG=y
CONFIG_MTK_GZ_VIRTIO=y
CONFIG_MTK_GZ_VIRTIO_IPC=y
CONFIG_MTK_GZ_IRQ=y
CONFIG_HAVE_MTK_GZ_LOG=y
CONFIG_EXTCON_MTK_USB=y
CONFIG_TCPC_CLASS=y
# CONFIG_TCPC_MT6370=y
CONFIG_USB_POWER_DELIVERY=y
CONFIG_MTK_LEDS=y
CONFIG_MTK_LOAD_TRACKER=y
CONFIG_MTK_CPU_CTRL_CFP=y
CONFIG_MTK_FPSGO_V3=y
CONFIG_MTK_TINYSYS_SCP_SUPPORT=y
CONFIG_MTK_TINYSYS_SSPM_SUPPORT=y

CONFIG_MTK_MET_PLF=m
CONFIG_MTPROF=y
CONFIG_MTK_SCHED_MONITOR=y
CONFIG_MTK_IRQ_COUNT_TRACER=y
CONFIG_MTK_IRQ_OFF_TRACER=y
CONFIG_MTK_PREEMPT_TRACER=y
CONFIG_MTK_AEE_UT=y
CONFIG_MTK_CM_MGR=y
CONFIG_MTK_LEGACY_THERMAL=y
CONFIG_MTK_THERMAL_PA_VIA_ATCMD=y
CONFIG_MTK_LEGACY_THERMAL_PLATFORM="mt6765"
CONFIG_MTK_CAMERA_ISP_DPE_SUPPORT=y
CONFIG_MTK_CAMERA_ISP_FD_SUPPORT=y
CONFIG_MTK_CAMERA_ISP_CAMERA_SUPPORT=y
CONFIG_MTK_DRAM_LOG_STORE=y
CONFIG_MTK_DRAM_LOG_STORE_ADDR=0x0010E700
CONFIG_MTK_DRAM_LOG_STORE_SIZE=0x100
CONFIG_SCSI=y
# CONFIG_SCSI_PROC_FS is not set
CONFIG_BLK_DEV_SD=y
CONFIG_DM_CRYPT=y
CONFIG_DM_DEFAULT_KEY=y
CONFIG_DM_UEVENT=y
CONFIG_DM_VERITY_AVB=y
CONFIG_DM_VERITY_FEC=y
CONFIG_DM_BOW=y
CONFIG_VIRTIO_NET=y
# CONFIG_ETHERNET is not set
CONFIG_USB_RTL8152=y
CONFIG_USB_USBNET=y
# CONFIG_USB_NET_CDCETHER is not set
# CONFIG_USB_NET_CDC_NCM is not set
# CONFIG_USB_NET_NET1080 is not set
# CONFIG_USB_NET_CDC_SUBSET is not set
# CONFIG_USB_NET_ZAURUS is not set
# CONFIG_WLAN_VENDOR_ADMTEK is not set
# CONFIG_WLAN_VENDOR_ATH is not set
# CONFIG_WLAN_VENDOR_ATMEL is not set
# CONFIG_WLAN_VENDOR_BROADCOM is not set
# CONFIG_WLAN_VENDOR_CISCO is not set
# CONFIG_WLAN_VENDOR_INTEL is not set
# CONFIG_WLAN_VENDOR_INTERSIL is not set
# CONFIG_WLAN_VENDOR_MARVELL is not set
# CONFIG_WLAN_VENDOR_MEDIATEK is not set
# CONFIG_WLAN_VENDOR_RALINK is not set
# CONFIG_WLAN_VENDOR_REALTEK is not set
# CONFIG_WLAN_VENDOR_RSI is not set
# CONFIG_WLAN_VENDOR_ST is not set
# CONFIG_WLAN_VENDOR_TI is not set
# CONFIG_WLAN_VENDOR_ZYDAS is not set
# CONFIG_WLAN_VENDOR_QUANTENNA is not set
CONFIG_VIRT_WIFI=y
CONFIG_INPUT_FF_MEMLESS=y
CONFIG_KEYBOARD_MTK_PMIC=y
CONFIG_KEYBOARD_MTK=y
# CONFIG_INPUT_MOUSE is not set
CONFIG_INPUT_TOUCHSCREEN=y
CONFIG_TOUCHSCREEN_MTK_GT1151=y
CONFIG_GT1151_CONFIG="K61_TOUCH_CFG"
CONFIG_INPUT_MISC=y
CONFIG_INPUT_UINPUT=y
CONFIG_FW_LOADER_USER_HELPER=y
CONFIG_FW_LOADER_USER_HELPER_FALLBACK=y
CONFIG_TOUCHPANEL_OPLUS=y
CONFIG_TOUCHPANEL_MTK_PLATFORM=y
CONFIG_TOUCHPANEL_MULTI_NOFLASH=y
CONFIG_TOUCHPANEL_SYNAPTICS=y
CONFIG_TOUCHPANEL_SYNAPTICS_TD4160=y
CONFIG_TOUCHPANEL_ILITEK=y
CONFIG_TOUCHPANEL_ILITEK_ILITEK7807S=y
CONFIG_OPLUS_DEVICE_IFNO=y
CONFIG_OPLUS_FW_UPDATE=y
# CONFIG_VT is not set
# CONFIG_LEGACY_PTYS is not set
# CONFIG_DEVMEM is not set
CONFIG_SERIAL_8250=y
CONFIG_SERIAL_8250_CONSOLE=y
CONFIG_SERIAL_8250_NR_UARTS=2
CONFIG_SERIAL_8250_RUNTIME_UARTS=2
CONFIG_SERIAL_8250_MT6577=y
CONFIG_SERIAL_OF_PLATFORM=m
CONFIG_SERIAL_AMBA_PL011=y
CONFIG_SERIAL_AMBA_PL011_CONSOLE=y
CONFIG_SERIAL_DEV_BUS=y
CONFIG_VIRTIO_CONSOLE=y
CONFIG_HW_RANDOM_VIRTIO=y
# CONFIG_DEVPORT is not set
# CONFIG_I2C_COMPAT is not set
# CONFIG_I2C_HELPER_AUTO is not set
CONFIG_I2C_MTK=y
CONFIG_SPI=y
CONFIG_SPI_MT65XX=y
CONFIG_SPMI=y
CONFIG_PINCTRL_AMD=y
CONFIG_PINCTRL_MT6765=y
CONFIG_POWER_AVS=y
CONFIG_BATTERY_MT6357=y
CONFIG_CHARGER_TYPE_MT6357=y
CONFIG_MTK_CHARGER=y
CONFIG_MTK_KERNEL_POWER_OFF_CHARGING=y
CONFIG_MTK_PUMP_EXPRESS_PLUS_SUPPORT=y
CONFIG_MTK_PUMP_EXPRESS_PLUS_20_SUPPORT=y
# CONFIG_HWMON is not set
CONFIG_THERMAL=y
CONFIG_THERMAL_DEFAULT_GOV_BACKWARD_COMPATIBLE=y
CONFIG_WATCHDOG=y
CONFIG_MEDIATEK_WATCHDOG=y
CONFIG_MFD_ACT8945A=y
CONFIG_MFD_MT6397=y
CONFIG_REGULATOR_MT6357=y
CONFIG_MEDIA_SUPPORT=y
CONFIG_MEDIA_CAMERA_SUPPORT=y
CONFIG_MEDIA_CONTROLLER=y
# CONFIG_VGA_ARB is not set
CONFIG_DRM=y
# CONFIG_DRM_FBDEV_EMULATION is not set
CONFIG_DRM_VIRTIO_GPU=y
CONFIG_MTK_GPU_SUPPORT=y
CONFIG_MTK_GPU_VERSION="rgx doma m1.11ED5425693"
CONFIG_MTK_GPU_COMMON_DVFS_SUPPORT=y
CONFIG_SND_HRTIMER=y
CONFIG_SND_DYNAMIC_MINORS=y
# CONFIG_SND_SUPPORT_OLD_API is not set
# CONFIG_SND_VERBOSE_PROCFS is not set
# CONFIG_SND_DRIVERS is not set
CONFIG_SND_INTEL8X0=y
CONFIG_SND_USB_AUDIO=y
CONFIG_SND_SOC=y
CONFIG_MTK_SND_SOC_CODEC="mt6357"
CONFIG_SND_SOC_MTK_BTCVSD=y
CONFIG_MTK_SND_SOC_NEW_ARCH=y
# 2020/08/26, Add for audio bringup
CONFIG_SND_SOC_RT5509 is not set
CONFIG_SIA_PA_ALGO=y
CONFIG_SND_SOC_AW87XXX=y
CONFIG_SND_SOC_OPLUS_PA_MANAGER=y
CONFIG_MTK_FM_50KHZ_SUPPORT=y
CONFIG_SND_SOC_SIA81XX_V1_2_0=y
#ifdef OPLUS_FEATURE_MM_FEEDBACK
CONFIG_OPLUS_FEATURE_MM_FEEDBACK=y
#endif
# 2022/1/6,add for hs key blocking for 1s after insterting
CONFIG_HSKEY_BLOCK=y
CONFIG_HIDRAW=y
CONFIG_HID_APPLE=y
CONFIG_HID_ELECOM=y
CONFIG_HID_MAGICMOUSE=y
CONFIG_HID_MICROSOFT=y
CONFIG_HID_MULTITOUCH=y
CONFIG_USB_HIDDEV=y
CONFIG_USB_STORAGE=y
CONFIG_USB_STORAGE_DATAFAB=y
CONFIG_USB_STORAGE_FREECOM=y
CONFIG_USB_STORAGE_ISD200=y
CONFIG_USB_STORAGE_USBAT=y
CONFIG_USB_STORAGE_SDDR09=y
CONFIG_USB_STORAGE_SDDR55=y
CONFIG_USB_STORAGE_JUMPSHOT=y
CONFIG_USB_STORAGE_ALAUDA=y
CONFIG_USB_STORAGE_ONETOUCH=y
CONFIG_USB_STORAGE_KARMA=y
CONFIG_USB_STORAGE_CYPRESS_ATACB=y
CONFIG_NOP_USB_XCEIV=y
CONFIG_USB_DUMMY_HCD=m
CONFIG_USB_CONFIGFS_SERIAL=y
CONFIG_USB_CONFIGFS_ACM=y
CONFIG_USB_CONFIGFS_RNDIS=y
CONFIG_USB_CONFIGFS_MASS_STORAGE=y
CONFIG_USB_CONFIGFS_MTK_FASTMETA=y
CONFIG_USB_CONFIGFS_F_HID=y
CONFIG_USB_CONFIGFS_F_UVC=y
CONFIG_MMC=y
# CONFIG_PWRSEQ_EMMC is not set
# CONFIG_PWRSEQ_SIMPLE is not set
CONFIG_MMC_BLOCK_MINORS=32
CONFIG_MMC_CRYPTO=y
CONFIG_MMC_MTK_PRO=y
CONFIG_MTK_EMMC_SUPPORT=y
CONFIG_MTK_EMMC_CACHE=y
CONFIG_MTK_EMMC_SUPPORT_OTP=y
CONFIG_MTK_EMMC_CQ_SUPPORT=y
CONFIG_MMC_SDHCI=m
CONFIG_MMC_SDHCI_PLTFM=m
CONFIG_NEW_LEDS=y
CONFIG_LEDS_CLASS=y
CONFIG_LEDS_REGULATOR_VIBRATOR=y
CONFIG_LEDS_TRIGGERS=y
CONFIG_EDAC=y
# CONFIG_RTC_SYSTOHC is not set
CONFIG_RTC_DRV_PL030=y
CONFIG_RTC_DRV_PL031=y
CONFIG_RTC_DRV_MT6397=y
CONFIG_DMADEVICES=y
CONFIG_MTK_HSDMA=y
CONFIG_MTK_UART_APDMA=y
CONFIG_UIO=y
CONFIG_VIRTIO_PCI=y
CONFIG_VIRTIO_INPUT=y
CONFIG_VIRTIO_MMIO=y
CONFIG_VIRTIO_MMIO_CMDLINE_DEVICES=y
CONFIG_ANDROID_INTF_ALARM_DEV=y
CONFIG_ION=y
CONFIG_ION_SYSTEM_HEAP=y
CONFIG_MTK_ION=y
CONFIG_COMMON_CLK_SCPI=y
CONFIG_COMMON_CLK_MT6765_AUDIOSYS=y
CONFIG_COMMON_CLK_MT6765_CAMSYS=y
CONFIG_COMMON_CLK_MT6765_IMGSYS=y
CONFIG_COMMON_CLK_MT6765_MMSYS=y
CONFIG_COMMON_CLK_MT6765_VCODECSYS=y
CONFIG_COMMON_CLK_MT6765_MIPI0ASYS=y
CONFIG_COMMON_CLK_MTK_FREQ_HOPPING=y
CONFIG_COMMON_CLK_MTK_FREQ_HOPPING_SSPM=y
CONFIG_HWSPINLOCK=y
CONFIG_ARM_SMMU=y
CONFIG_MTK_PMIC_WRAP=y
CONFIG_DEVFREQ_GOV_PERFORMANCE=y
CONFIG_DEVFREQ_GOV_POWERSAVE=y
CONFIG_DEVFREQ_GOV_USERSPACE=y
CONFIG_DEVFREQ_GOV_PASSIVE=y
CONFIG_IIO=y
CONFIG_MEDIATEK_MT635X_AUXADC=y
CONFIG_MEDIATEK_MT6577_AUXADC=y
CONFIG_PWM=y
CONFIG_PHY_MTK_TPHY=y
CONFIG_RAS=y
CONFIG_ANDROID_BINDER_USER_TRACKING=y
CONFIG_MTK_DEVINFO=y
CONFIG_MT6359_EFUSE=y
CONFIG_EXT4_FS=y
CONFIG_EXT4_FS_SECURITY=y
CONFIG_EXT4_ENCRYPTION=y
CONFIG_FS_ENCRYPTION_INLINE_CRYPT=y
# CONFIG_DNOTIFY is not set
CONFIG_OVERLAY_FS=y
CONFIG_INCREMENTAL_FS=y
CONFIG_MSDOS_FS=y
CONFIG_VFAT_FS=y
CONFIG_TMPFS_POSIX_ACL=y
CONFIG_PSTORE=y
CONFIG_PSTORE_CONSOLE=y
CONFIG_PSTORE_RAM=y
CONFIG_NLS_CODEPAGE_437=y
CONFIG_NLS_CODEPAGE_737=y
CONFIG_NLS_CODEPAGE_775=y
CONFIG_NLS_CODEPAGE_850=y
CONFIG_NLS_CODEPAGE_852=y
CONFIG_NLS_CODEPAGE_855=y
CONFIG_NLS_CODEPAGE_857=y
CONFIG_NLS_CODEPAGE_860=y
CONFIG_NLS_CODEPAGE_861=y
CONFIG_NLS_CODEPAGE_862=y
CONFIG_NLS_CODEPAGE_863=y
CONFIG_NLS_CODEPAGE_864=y
CONFIG_NLS_CODEPAGE_865=y
CONFIG_NLS_CODEPAGE_866=y
CONFIG_NLS_CODEPAGE_869=y
CONFIG_NLS_CODEPAGE_936=y
CONFIG_NLS_CODEPAGE_950=y
CONFIG_NLS_CODEPAGE_932=y
CONFIG_NLS_CODEPAGE_949=y
CONFIG_NLS_CODEPAGE_874=y
CONFIG_NLS_ISO8859_8=y
CONFIG_NLS_CODEPAGE_1250=y
CONFIG_NLS_CODEPAGE_1251=y
CONFIG_NLS_ASCII=y
CONFIG_NLS_ISO8859_1=y
CONFIG_NLS_ISO8859_2=y
CONFIG_NLS_ISO8859_3=y
CONFIG_NLS_ISO8859_4=y
CONFIG_NLS_ISO8859_5=y
CONFIG_NLS_ISO8859_6=y
CONFIG_NLS_ISO8859_7=y
CONFIG_NLS_ISO8859_9=y
CONFIG_NLS_ISO8859_13=y
CONFIG_NLS_ISO8859_14=y
CONFIG_NLS_ISO8859_15=y
CONFIG_NLS_KOI8_R=y
CONFIG_NLS_KOI8_U=y
CONFIG_NLS_MAC_ROMAN=y
CONFIG_NLS_MAC_CELTIC=y
CONFIG_NLS_MAC_CENTEURO=y
CONFIG_NLS_MAC_CROATIAN=y
CONFIG_NLS_MAC_CYRILLIC=y
CONFIG_NLS_MAC_GAELIC=y
CONFIG_NLS_MAC_GREEK=y
CONFIG_NLS_MAC_ICELAND=y
CONFIG_NLS_MAC_INUIT=y
CONFIG_NLS_MAC_ROMANIAN=y
CONFIG_NLS_MAC_TURKISH=y
CONFIG_NLS_UTF8=y
CONFIG_STATIC_USERMODEHELPER=y
CONFIG_STATIC_USERMODEHELPER_PATH="/system_ext/bin/aee_core_forwarder"
CONFIG_CRYPTO_ADIANTUM=y
CONFIG_OPLUS_FEATURE_PMIC_MONITOR_MTK=y
CONFIG_CRYPTO_ZSTD=y
CONFIG_CRYPTO_ANSI_CPRNG=y
CONFIG_CRYPTO_DEV_VIRTIO=y
CONFIG_CRC_CCITT=y
CONFIG_CRC8=y
CONFIG_XZ_DEC=y
CONFIG_PRINTK_TIME=y
CONFIG_DYNAMIC_DEBUG=y
CONFIG_DEBUG_INFO=y
# CONFIG_ENABLE_MUST_CHECK is not set
CONFIG_FRAME_WARN=3600
CONFIG_PAGE_OWNER=y
CONFIG_DEBUG_KMEMLEAK=y
CONFIG_DEBUG_KMEMLEAK_EARLY_LOG_SIZE=3600
CONFIG_DEBUG_KMEMLEAK_DEFAULT_OFF=y
CONFIG_DEBUG_STACK_USAGE=y
CONFIG_DEBUG_VIRTUAL=y
CONFIG_DEBUG_MEMORY_INIT=y
CONFIG_SOFTLOCKUP_DETECTOR=y
# CONFIG_DETECT_HUNG_TASK is not set
CONFIG_PANIC_TIMEOUT=5
CONFIG_SCHEDSTATS=y
CONFIG_SCHED_STACK_END_CHECK=y
# CONFIG_DEBUG_PREEMPT is not set
CONFIG_PROVE_LOCKING=y
CONFIG_DEBUG_LOCKDEP=y
CONFIG_MTK_LOCKING_AEE=y
CONFIG_FUNCTION_TRACER=y
CONFIG_MTK_FTRACER=y
CONFIG_MTK_FTRACE_DEFAULT_ENABLE=y
# CONFIG_RUNTIME_TESTING_MENU is not set
CONFIG_CORESIGHT=y
CONFIG_CORESIGHT_STM=y

#ifdef OPLUS_FEATURE_NFC_BRINGUP
# 2021/12/07, add for : add nxp devices
CONFIG_MTK_CLKBUF_NFC=y
CONFIG_OPLUS_NFC=y
CONFIG_NFC_PN553_DEVICES=y
#endif /*OPLUS_FEATURE_NFC_BRINGUP*/

#ifndef OPLUS_FEATURE_SECURITY_COMMON
# 2021/12/11, add for open trustonic tee, config tee.
CONFIG_TEE=y
CONFIG_TRUSTONIC_TEE_SUPPORT=y
CONFIG_MTK_TEE_GP_SUPPORT=y
CONFIG_TRUSTONIC_TEE_VERSION=500
CONFIG_F2FS_ENCRYPTION=y
CONFIG_F2FS_FS_ENCRYPTION=y
CONFIG_F2FS_FS_COMPRESSION=y
CONFIG_F2FS_FS_LZ4=y
CONFIG_F2FS_FS_COMPRESSION_FIXED_OUTPUT=y
#endif /*OPLUS_FEATURE_SECURITY_COMMON*/

#ifdef OPLUS_FEATURE_HANS_FREEZE
#/* 2021-07-28, add for app freezer */
CONFIG_OPLUS_HANS=y
#endif /* OPLUS_FEATURE_HANS_FREEZE */

CONFIG_OPLUS_CHARGER=y
CONFIG_OPLUS_CHARGER_MTK=y
CONFIG_OPLUS_CHARGER_MTK_CHGIC=y
CONFIG_OPLUS_CHARGER_MTK6765S=y
CONFIG_CHARGER_BQ2560X=y
CONFIG_OPLUS_CHECK_CHARGERID_VOLT=y
CONFIG_OPLUS_CHARGER_MTKAGING=y
CONFIG_OPLUS_4450MV_BATTERY_SUPPORT=y
CONFIG_OPLUS_CALL_MODE_SUPPORT=y
CONFIG_OPLUS_SHIP_MODE_SUPPORT=y
CONFIG_OPLUS_SHORT_C_BATT_CHECK=y
CONFIG_OPLUS_SHORT_HW_CHECK=y
CONFIG_OPLUS_SHORT_USERSPACE=y
CONFIG_OPLUS_CHIP_SOC_NODE=y
CONFIG_OPLUS_RTC_DET_SUPPORT=y
CONFIG_OPLUS_ARCH_FILE=y
CONFIG_OPLUS_COMMON_SOFT=y
CONFIG_OPLUS_HVDCP_SUPPORT=y
CONFIG_OPLUS_SHORT_IC_CHECK=y
CONFIG_OPLUS_HVDCP_SUPPORT=y
CONFIG_TCPC_RT1711H=y

#ifdef OPLUS_FEATURE_SENSOR_ALGORITHM
CONFIG_OPLUS_SENSOR_FB_MTK=y
#endif /*OPLUS_FEATURE_SENSOR_ALGORITHM*/

#ifdef OPLUS_FEATURE_FINGERPRINT
#2021/12/14, Add for fingerprint driver
CONFIG_OPLUS_FINGERPRINT=y
CONFIG_OPLUS_FINGERPRINT_MTK=y
CONFIG_OPLUS_FINGERPRINT_SILEAD=y
CONFIG_OPLUS_FINGERPRINT_JIIOV_CAPACITIVE=y
CONFIG_OPLUS_FINGERPRINT_GKI_DISABLE=y
CONFIG_OPLUS_FINGERPRINT_GOODIX=y
CONFIG_OPLUS_FINGERPRINT_FPC=y
#endif /* OPLUS_FEATURE_FINGERPRINT */

#ifdef OPLUS_FEATURE_SECURITY_COMMON
CONFIG_OPLUS_SECURE=y
CONFIG_OPLUS_SECURE_QCOM=n
CONFIG_OPLUS_SECURE_MTK=y
CONFIG_OPLUS_SECURE_COMMON=y
#endif /* OPLUS_FEATURE_SECURITY_COMMON */

#ifdef OPLUS_FEATURE_SCHED_ASSIST
CONFIG_SCHED_WALT=y
CONFIG_OPLUS_FEATURE_AUDIO_OPT=y
#endif /* OPLUS_FEATURE_SCHED_ASSIST */

# 2022-01-04, to support exfat&sdcardfs fs
CONFIG_EXFAT_FS=y
CONFIG_SDCARD_FS=y

#ifdef OPLUS_FEATURE_HEALTHINFO
#/* 2018-07-07, add alloc wait monitor support*/
CONFIG_OPLUS_MEM_MONITOR=y
CONFIG_FG_TASK_UID=y
CONFIG_OPLUS_HEALTHINFO=y
CONFIG_SLAB_STAT_DEBUG=y
CONFIG_SLUB_DEBUG=n
#endif /*OPLUS_FEATURE_HEALTHINFO*/

#ifdef OPLUS_FEATURE_HEALTHINFO
CONFIG_OPLUS_JANK_INFO=y
#endif /* OPLUS_FEATURE_HEALTHINFO */

#ifdef OPLUS_FEATURE_TP_BASIC
CONFIG_SIM_DETECT=y
#endif

#ifdef OPLUS_FEATURE_SCHED_ASSIST
#CONFIG_BLK_WBT_SQ=y
#CONFIG_BLK_WBT=y
CONFIG_OPLUS_FEATURE_UXIO_FIRST=y
#endif /*OPLUS_FEATURE_SCHED_ASSIST*/
#CONFIG_OPLUS_BINDER_STRATEGY=y

#CONFIG_OPLUS_ION_BOOSTPOOL=y
#/*Enable dynamic tuning swappniess*/
CONFIG_DYNAMIC_TUNNING_SWAPPINESS=y
CONFIG_EXTREME_LOW_RAM=y

#ifdef OPLUS_FEATURE_HYBRIDSWAP
CONFIG_HYBRIDSWAP=y
CONFIG_HYBRIDSWAP_SWAPD=y
CONFIG_HYBRIDSWAP_CORE=y
#endif

#ifdef OPLUS_MTK_USERIMAGES_USE_F2FS
CONFIG_F2FS_FS=y
CONFIG_F2FS_FS_SECURITY=y
#endif /* OPLUS_MTK_USERIMAGES_USE_F2FS */

CONFIG_EROFS_FS=y

#ifdef OPLUS_BUG_STABILITY
CONFIG_OPLUS_FEATURE_THEIA=y
CONFIG_OPLUS_FEATURE_SHUTDOWN_DETECT=y
CONFIG_OPLUS_FEATURE_MTK_FORCE_SHUTDOWN=y
#endif /* OPLUS_BUG_STABILITY */

#ifdef OPLUS_FEATURE_SECURITY_COMMON
CONFIG_MODULE_SIG=y
CONFIG_MODULE_SIG_FORCE=y
CONFIG_MODULE_SIG_ALL=y
CONFIG_MODULE_SIG_SHA512=y
#endif /* OPLUS_FEATURE_SECURITY_COMMON */
CONFIG_SECURITY_SELINUX_DEVELOP=y

#ifdef OPLUS_FEATURE_WIFI_SLA
#todo: need to change to m when GKI
CONFIG_OPLUS_FEATURE_WIFI_SLA=y
#endif /* OPLUS_FEATURE_WIFI_SLA */

#ifdef OPLUS_FEATURE_DATA_EVAL
CONFIG_OPLUS_FEATURE_DATA_EVAL=y
#endif /* OPLUS_FEATURE_DATA_VAL */

#ifdef OPLUS_FEATURE_LAST_BOOT_REASON
CONFIG_OPLUS_FEATURE_LAST_BOOT_REASON=y
#endif /*OPLUS_FEATURE_LAST_BOOT_REASON*/

#ifdef OPLUS_FEATURE_ACM
CONFIG_OPLUS_FEATURE_ACM=y
CONFIG_OPLUS_FEATURE_ACM_LOGGING=y
#endif /* OPLUS_FEATURE_ACM */

CONFIG_OPLUS_FEATURE_FDLEAK_CHECK=y

#enable phoenix and kmsg wb
CONFIG_OPLUS_FEATURE_KMSG_WB=y
CONFIG_OPLUS_FEATURE_PHOENIX=y

CONFIG_OPLUS_FEATURE_OLC=y

#ifdef OPLUS_FEATURE_DNS_HOOK
CONFIG_OPLUS_FEATURE_DNS_HOOK=y
#endif /* OPLUS_FEATURE_DNS_HOOK */

#ifdef OPLUS_FEATURE_STATS_CALC
CONFIG_OPLUS_FEATURE_STATS_CALC=y
#endif /* OPLUS_FEATURE_STATS_CALC */
```
