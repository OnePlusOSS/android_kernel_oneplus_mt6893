## arch/arm64/configs/k6893v1_64_k419_ab_debug_defconfig
```kconfig
# CONFIG_LOCALVERSION_AUTO is not set
CONFIG_OPLUS_ION_BOOSTPOOL=y
CONFIG_PREEMPT=y
CONFIG_IKHEADERS=m
CONFIG_LOG_BUF_SHIFT=21
CONFIG_UCLAMP_TASK=y
CONFIG_UCLAMP_TASK_GROUP=y
CONFIG_CPUSETS=y
CONFIG_SCHED_TUNE=y
# CONFIG_RD_BZIP2 is not set
# CONFIG_RD_LZMA is not set
# CONFIG_RD_XZ is not set
# CONFIG_RD_LZO is not set
# CONFIG_RD_LZ4 is not set
CONFIG_SYSCTL_SYSCALL=y
# CONFIG_FHANDLE is not set
# CONFIG_KALLSYMS_BASE_RELATIVE is not set
CONFIG_MTK_SCHED_EXTENSION=y
CONFIG_MTK_IDLE_BALANCE_ENHANCEMENT=y
CONFIG_MTK_SCHED_INTEROP=y
CONFIG_MTK_SCHED_LB_ENHANCEMENT=y
CONFIG_MTK_SCHED_TRACERS=y
CONFIG_MTK_SCHED_CPU_PREFER=y
CONFIG_MTK_SCHED_BIG_TASK_MIGRATE=y
CONFIG_ARCH_MEDIATEK=y
CONFIG_MACH_MT6893=y
CONFIG_SCHED_MC=y
CONFIG_NR_CPUS=8
CONFIG_ARM64_DMA_USE_IOMMU=y
CONFIG_RANDOMIZE_BASE=y
CONFIG_CMDLINE="console=tty0 console=ttyMT3,921600n1 root=/dev/ram vmalloc=496M slub_max_order=0 slub_debug=O "
# CONFIG_EFI is not set
CONFIG_PM_DEBUG=y
CONFIG_WQ_POWER_EFFICIENT_DEFAULT=y
CONFIG_ENERGY_MODEL=y
CONFIG_CPU_FREQ=y
CONFIG_CPU_FREQ_STAT=y
CONFIG_CPU_FREQ_DEFAULT_GOV_SCHEDUTIL=y
CONFIG_CPU_FREQ_GOV_POWERSAVE=y
CONFIG_CPU_FREQ_GOV_USERSPACE=y
CONFIG_CPU_FREQ_GOV_ONDEMAND=y
CONFIG_KPROBES=y
CONFIG_MODULE_SRCVERSION_ALL=y
# CONFIG_BLK_DEV_BSG is not set
CONFIG_BLK_INLINE_ENCRYPTION=y
CONFIG_BLK_INLINE_ENCRYPTION_FALLBACK=y
# CONFIG_CORE_DUMP_DEFAULT_ELF_HEADERS is not set
CONFIG_ZSMALLOC=y
CONFIG_XFRM_MIGRATE=y
CONFIG_SYN_COOKIES=y
CONFIG_VLAN_8021Q=y
CONFIG_CLS_U32_PERF=y
CONFIG_CLS_U32_MARK=y
CONFIG_BT=y
CONFIG_CFG80211=y
CONFIG_NL80211_TESTMODE=y
CONFIG_CFG80211_DEVELOPER_WARNINGS=y
# CONFIG_CFG80211_DEFAULT_PS is not set
CONFIG_CFG80211_DEBUGFS=y
# CONFIG_UEVENT_HELPER is not set
# CONFIG_FW_CACHE is not set
CONFIG_ZRAM=y
CONFIG_BLK_DEV_LOOP_MIN_COUNT=16
CONFIG_ANDROID_DEFAULT_SETTING=y
CONFIG_MTK_ANDROID_DEFAULT_SETTING=y
CONFIG_MTK_PLATFORM="mt6885"
CONFIG_ARCH_MTK_PROJECT="k6893v1_64"
CONFIG_MTK_ENG_BUILD=y
CONFIG_NONLINEAR_FREQ_CTL=y
CONFIG_MTK_BATTERY_OC_POWER_THROTTLING=n
CONFIG_MTK_BATTERY_PERCENTAGE_POWER_THROTTLING=n
CONFIG_MTK_LOW_BATTERY_POWER_THROTTLING=n
CONFIG_MTK_DYNAMIC_LOADING_POWER_THROTTLING=n
CONFIG_MTK_PTPOD=y
CONFIG_MTK_STATIC_POWER=y
CONFIG_MTK_UNIFY_POWER=y
CONFIG_MTK_APUSYS_SUPPORT=y
CONFIG_MTK_APUSYS_DEBUG=y
CONFIG_MTK_APUSYS_RT_SUPPORT=y
CONFIG_MTK_APUSYS_MDLA_SUPPORT=y
CONFIG_MTK_APUSYS_EDMA_SUPPORT=y
CONFIG_MTK_CPU_FREQ=y
CONFIG_MTK_PTPOD_GPU=y
CONFIG_MTK_PBM=y
CONFIG_MTK_PMIC_NEW_ARCH=y
CONFIG_MTK_PMIC_COMMON=y
CONFIG_MTK_PMIC_CHIP_MT6359P=y
CONFIG_MTK_EXTBUCK=y
CONFIG_REGULATOR_MT6691=y
CONFIG_MTK_EXTERNAL_CHARGER_TYPE_DETECT=y
CONFIG_MFD_MT6360_PMU=y
CONFIG_MT6360_PMU_CHARGER=y
CONFIG_MT6360_PMU_FLED=y
CONFIG_MT6360_PMIC=y
CONFIG_MT6360_LDO=y
CONFIG_OPLUS_PMIC_COMMON=y
CONFIG_CUSTOM_KERNEL_IMGSENSOR="ov64b_mipi_raw imx615_mipi_raw imx355_mipi_raw gc02m1b_mipi_mono ov02b10_mipi_raw imx471_mipi_raw imx682_mipi_raw_20615 imx471_mipi_raw_20615 hi846_mipi_raw_20615 ov02b10_mipi_raw_20615 ov64b_mipi_raw_21651 imx471_mipi_raw_21651 imx355_mipi_raw_21651 gc02m1_mipi_raw_21651 imx766_mipi_raw21015 imx709_mipi_raw21015 imx355_mipi_raw21015 ov02b10_mipi_raw21015 imx766_mipi_raw21881 imx615_mipi_raw21881 imx355_mipi_raw21881 gc02m1b_mipi_mono21881 imx766_mipi_raw20817 imx615_mipi_raw20817 imx355_mipi_raw20817 gc02m1b_mipi_mono20817 ov50a_mipi_raw_21127 imx709_mipi_raw_21127 gc02m1b_mipi_mono_21127 gc02m1_mipi_raw_21127 imx766_mipi_raw_21305 imx709_mipi_raw_21305 imx355_mipi_raw_21305 gc02m1_mipi_raw_21305"
CONFIG_CUSTOM_KERNEL_CAM_CAL_DRV="BRCB032GWZ_3 GT24c32a cat24c16"
#CONFIG_CUSTOM_KERNEL_LCM="td4330_fhdp_dsi_cmd_auo_rt5081"
CONFIG_MTK_SYNC=y
CONFIG_MTK_LCM_PHYSICAL_ROTATION="0"
CONFIG_LCM_HEIGHT="2400"
CONFIG_MTK_AAL_SUPPORT=y
CONFIG_MTK_PQ_COLOR_MODE="DISP_MDP"
CONFIG_MTK_PSEUDO_M4U=y
CONFIG_MTK_FLASHLIGHT=y
CONFIG_MTK_FLASHLIGHT_MT6360=y
CONFIG_MTK_FLASHLIGHT_PT=n
CONFIG_MTK_FLASHLIGHT_PT_STRICT=y
CONFIG_MTK_FLASHLIGHT_DLPT=y
CONFIG_MTK_IMGSENSOR=y
CONFIG_MTK_LENS=y
CONFIG_MTK_CAM_CAL=y
CONFIG_MTK_CMDQ=y
CONFIG_MTK_CMDQ_MBOX_EXT=y
CONFIG_MTK_VPU_SUPPORT=y
CONFIG_MTK_VPU_SUPPORT_DEBUG=y
CONFIG_MTK_SMI_EXT=y
CONFIG_MTK_JPEG=y
CONFIG_MTK_CCU=y
CONFIG_MTK_CAM_SECURITY_SUPPORT=y
CONFIG_MTK_CAM_GENIEZONE_SUPPORT=y
CONFIG_MTK_SENSOR_SUPPORT=y
CONFIG_MTK_SENSOR_ARCHITECTURE="2.0"
CONFIG_OPLUS_FEATURE_ACTIVITY_RECOGNITION=y
CONFIG_OPLUS_FEATURE_ELEVATOR_DETECT=y
CONFIG_CUSTOM_KERNEL_ACCELEROMETER=y
CONFIG_MTK_ACCELHUB=y
CONFIG_CUSTOM_KERNEL_ALSPS=y
CONFIG_MTK_ALSPSHUB=y
CONFIG_CUSTOM_KERNEL_GYROSCOPE=y
CONFIG_MTK_GYROHUB=y
CONFIG_CUSTOM_KERNEL_MAGNETOMETER=y
CONFIG_MTK_MAGHUB=y
CONFIG_MTK_HWMON=y
CONFIG_CUSTOM_KERNEL_BAROMETER=y
CONFIG_MTK_BAROHUB=y
CONFIG_MTK_AP_REAR_SENSOR=y
CONFIG_CUSTOM_KERNEL_STEP_COUNTER=y
CONFIG_MTK_STEPSIGNHUB=y
CONFIG_CUSTOM_KERNEL_SITUATION=y
CONFIG_MTK_STATHUB=y
CONFIG_MTK_WAKEHUB=y
CONFIG_MTK_GLGHUB=y
CONFIG_MTK_PICKUPHUB=y
CONFIG_MTK_DEVICE_ORIENTATION_HUB=y
CONFIG_MTK_MOTION_DETECT_HUB=y
CONFIG_MTK_TILTDETECTHUB=y
CONFIG_CUSTOM_KERNEL_SENSORHUB=y
CONFIG_NANOHUB=y
CONFIG_NANOHUB_MTK_IPI=y
CONFIG_CUSTOM_KERNEL_SENSOR_FUSION=y
CONFIG_CUSTOM_KERNEL_GRV_SENSOR=y
CONFIG_CUSTOM_KERNEL_GMRV_SENSOR=y
CONFIG_CUSTOM_KERNEL_RV_SENSOR=y
CONFIG_CUSTOM_KERNEL_LINEARACCEL_SENSOR=y
CONFIG_CUSTOM_KERNEL_GRAVITY_SENSOR=y
CONFIG_CUSTOM_KERNEL_UNCALI_ACC_SENSOR=y
CONFIG_CUSTOM_KERNEL_UNCALI_GYRO_SENSOR=y
CONFIG_CUSTOM_KERNEL_UNCALI_MAG_SENSOR=y
CONFIG_OPLUS_FEATURE_PICKUP_DETECT=y
CONFIG_OPLUS_FEATURE_FP_DISPLAY=y
CONFIG_OPLUS_FEATURE_LUX_AOD=y
CONFIG_OPLUS_FEATURE_PEDO_MINUTE=y
CONFIG_OPLUS_SENSOR_FB_MTK=y
CONFIG_OPLUS_FEATURE_SENSOR_MONITOR=y
CONFIG_MTK_CCCI_DEVICES=y
CONFIG_MTK_MD1_SUPPORT=25
CONFIG_MTK_ECCCI_DRIVER=y
CONFIG_MTK_ECCCI_C2K=y
CONFIG_MTK_BTIF=y
CONFIG_MTK_COMBO=y
CONFIG_MTK_COMBO_CHIP_CONSYS_6893=y
CONFIG_MTK_COMBO_BT=y
CONFIG_MTK_COMBO_GPS=y
CONFIG_MTK_COMBO_WIFI=y
CONFIG_MTK_DHCPV6C_WIFI=y
CONFIG_MTK_GPS_SUPPORT=y
CONFIG_MTK_GPS_EMI=y
CONFIG_MTK_FMRADIO=y
CONFIG_MTK_FM_CHIP="MT6635_FM"
CONFIG_MTK_CONNSYS_DEDICATED_LOG_PATH=y
CONFIG_MTK_MDDP_SUPPORT=y
CONFIG_HAVE_MTK_ENABLE_GENIEZONE=y
CONFIG_MTK_ENABLE_GENIEZONE=y
CONFIG_MTK_GZ_MAIN=y
CONFIG_MTK_GZ_LOG=y
CONFIG_MTK_GZ_VIRTIO=y
CONFIG_MTK_GZ_VIRTIO_IPC=y
CONFIG_MTK_GZ_IRQ=y
CONFIG_HAVE_MTK_GZ_LOG=y
CONFIG_EXTCON_MTK_USB=y
CONFIG_MTK_USB_TYPEC_U3_MUX=y
CONFIG_TCPC_CLASS=y
CONFIG_TCPC_MT6360=y
CONFIG_USB_POWER_DELIVERY=y
CONFIG_MTK_TYPEC_WATER_DETECT=y
CONFIG_MTK_TYPEC_WATER_DETECT_BY_PCB=n
CONFIG_MT6360_PMU_CHARGER_TYPE_DETECT=y
CONFIG_MTK_LEDS=y
#CONFIG_LEDS_MTK_PWM=y
CONFIG_LEDS_MTK_DISP=y
CONFIG_MTK_PWM=y
CONFIG_MTK_AURISYS_PHONE_CALL_SUPPORT=y
CONFIG_MTK_AUDIODSP_SUPPORT=y
CONFIG_MTK_ACCDET=y
CONFIG_ACCDET_EINT_IRQ=y
CONFIG_ACCDET_SUPPORT_EINT0=y
CONFIG_MTK_RTC=y
CONFIG_MTK_PERF_COMMON=y
CONFIG_MTK_PERF_TRACKER=y
CONFIG_MTK_CORE_CTL=y
#CONFIG_MTK_LOAD_TRACKER=y
CONFIG_MTK_CPU_CTRL_CFP=y
CONFIG_MTK_PERF_OBSERVER=y
CONFIG_MTK_FPSGO_V3=y
CONFIG_MTK_GBE=y
CONFIG_MTK_TASK_TURBO=y
CONFIG_MTK_TINYSYS_SCP_SUPPORT=y
CONFIG_MTK_TINYSYS_SSPM_SUPPORT=y
CONFIG_MTK_TINYSYS_SSPM_V2=y

CONFIG_MTK_MET_PLF=m
CONFIG_MTPROF=y
CONFIG_MTK_SCHED_MONITOR=y
CONFIG_MTK_IRQ_COUNT_TRACER=y
CONFIG_MTK_IRQ_OFF_TRACER=y
CONFIG_MTK_PREEMPT_TRACER=y
CONFIG_MTK_AEE_UT=y
CONFIG_MTK_SLBC_MMSRAM=y
CONFIG_MTK_AEE_HANGDET=y
CONFIG_MTK_CM_MGR=y
CONFIG_MTK_CM_MGR_LEGACY=y
CONFIG_MTK_LEGACY_THERMAL=y
CONFIG_MTK_THERMAL_PA_VIA_ATCMD=y
CONFIG_MTK_CAMERA_ISP_RSC_SUPPORT=y
CONFIG_MTK_CAMERA_ISP_WPE_SUPPORT=y
CONFIG_MTK_CAMERA_ISP_DPE_SUPPORT=y
CONFIG_MTK_CAMERA_ISP_MFB_SUPPORT=y
CONFIG_MTK_CAMERA_ISP_FD_SUPPORT=y
CONFIG_MTK_TINYSYS_MCUPM_SUPPORT=y
CONFIG_MTK_VIBRATOR=y
CONFIG_MTK_DRAM_LOG_STORE=y
CONFIG_MTK_DRAM_LOG_STORE_ADDR=0x0011DF00
CONFIG_MTK_DRAM_LOG_STORE_SIZE=0x100
CONFIG_MTK_VOW_SUPPORT=y
CONFIG_MTK_VOW_DUAL_MIC_SUPPORT=y
CONFIG_MTK_VOW_MAX_PDK_NUMBER=2
CONFIG_MTK_VOW_DSP_VERSION="ver02"
CONFIG_MTK_FREQ_HOPPING=y
CONFIG_SCSI=y
CONFIG_BLK_DEV_SD=y
CONFIG_SCSI_SCAN_ASYNC=y
CONFIG_SCSI_UFSHCD=y
CONFIG_SCSI_UFSHCD_PLATFORM=y
CONFIG_SCSI_UFS_MEDIATEK=y
CONFIG_SCSI_UFS_FEATURE=y
# CONFIG_SCSI_UFS_HPB is not set
CONFIG_SCSI_UFS_TW=y
CONFIG_SCSI_UFS_TW_IGNORE_GUARANTEE_BIT=y
# CONFIG_SCSI_SKHPB is not set
CONFIG_SCSI_UFS_CRYPTO=y
CONFIG_DM_DEBUG=y
CONFIG_DM_CRYPT=y
CONFIG_DM_DEFAULT_KEY=y
CONFIG_DM_UEVENT=y
CONFIG_DM_VERITY_FEC=y
CONFIG_IFB=y
# CONFIG_ETHERNET is not set
CONFIG_PPP_FILTER=y
CONFIG_PPP_MULTILINK=y
CONFIG_PPPOE=y
CONFIG_PPP_ASYNC=y
CONFIG_PPP_SYNC_TTY=y
CONFIG_USB_USBNET=y
# CONFIG_KEYBOARD_ATKBD is not set
CONFIG_KEYBOARD_MTK=y
//#ifdef OPLUS_BUG_STABILITY /*disable long press shutdown*/
#CONFIG_ONEKEY_REBOOT_NORMAL_MODE=y
//#endif /*OPLUS_BUG_STABILITY*/
#ifndef OPLUS_BUG_STABILITY
#** Remove for disable long press powerkey reset */
#CONFIG_ONEKEY_REBOOT_OTHER_MODE=y
#else
CONFIG_TWOKEY_REBOOT_NORMAL_MODE=y
CONFIG_TWOKEY_REBOOT_OTHER_MODE=y
#endif /* OPLUS_BUG_STABILITY */
CONFIG_KPD_PWRKEY_USE_PMIC=y
# CONFIG_INPUT_MOUSE is not set
CONFIG_INPUT_TOUCHSCREEN=y
#ifdef OPLUS_FEATURE_TP_BASIC
#CONFIG_TOUCHSCREEN_MTK_TOUCH="GT9886 GT9896S"
CONFIG_FW_LOADER_USER_HELPER=y
CONFIG_FW_LOADER_USER_HELPER_FALLBACK=y
CONFIG_TOUCHPANEL_MTK_PLATFORM=y
CONFIG_TOUCHPANEL_OPLUS=y
CONFIG_TOUCHPANEL_SAMSUNG=y
CONFIG_TOUCHPANEL_SAMSUNG_S6SY792=y
CONFIG_TOUCHPANEL_SYNAPTICS=y
CONFIG_TOUCHPANEL_SYNAPTICS_TCM_ONCELL=y
CONFIG_OPLUS_TP_APK=y
CONFIG_TOUCHPANEL_LATE_INIT=y
CONFIG_TOUCHPANEL_FOCAL=y
CONFIG_TOUCHPANEL_FOCAL_FT3518=y
CONFIG_OPLUS_DEVICE_IFNO=y
CONFIG_OPLUS_FW_UPDATE=y
CONFIG_OPLUS_TRIKEY=y
CONFIG_OPLUS_TRIKEY_MAIN=y
CONFIG_OPLUS_TRIKEY_HALL=y
CONFIG_IST_UP=y
CONFIG_IST_DOWN=y
CONFIG_MXM_UP=y
CONFIG_MXM_DOWN=y
#endif OPLUS_FEATURE_TP_BASIC
CONFIG_AW8697_HAPTIC=y
CONFIG_HAPTIC_FEEDBACK=y
CONFIG_MTK_FINGERPRINT_SELECT="NA"
CONFIG_INPUT_MISC=y
CONFIG_INPUT_UINPUT=y
# CONFIG_SERIO is not set
# CONFIG_VT is not set
CONFIG_LEGACY_PTY_COUNT=16
# CONFIG_DEVMEM is not set
CONFIG_SERIAL_8250=y
CONFIG_SERIAL_8250_CONSOLE=y
CONFIG_SERIAL_8250_NR_UARTS=2
CONFIG_SERIAL_8250_RUNTIME_UARTS=2
CONFIG_SERIAL_8250_MT6577=y
CONFIG_I2C_MTK=y
CONFIG_SPI=y
CONFIG_SPI_MT65XX=y
CONFIG_SPMI=y
CONFIG_MTK_PMIF=y
CONFIG_MTK_CHARGER=y
CONFIG_MTK_KERNEL_POWER_OFF_CHARGING=y
CONFIG_MTK_GAUGE_VERSION=30


#ifdef OPLUS_FEATURE_MEMLEAK_DETECT
CONFIG_KMALLOC_DEBUG=y
CONFIG_VMALLOC_DEBUG=y
CONFIG_DUMP_TASKS_MEM=y
CONFIG_SLABINFO=y
CONFIG_SVELTE=y
#endif /*OPLUS_FEATURE_MEMLEAK_DETECT*/

#ifdef OPLUS_FEATURE_CHG_BASIC
CONFIG_INPUT_JOYSTICK=y
CONFIG_JOYSTICK_XPAD=y
CONFIG_JOYSTICK_XPAD_FF=y
CONFIG_JOYSTICK_XPAD_LEDS=y
CONFIG_OPLUS_SMART_CHARGER_SUPPORT=y
#CONFIG_MTK_ADDITIONAL_BATTERY_TABLE=y
CONFIG_OPLUS_CHARGER=y
#CONFIG_MTK_DISABLE_GAUGE=y
CONFIG_OPLUS_CHECK_CHARGERID_VOLT=y
CONFIG_OPLUS_CHARGER_MTK=y
CONFIG_OPLUS_CHARGER_MTK_CHGIC=y
CONFIG_OPLUS_CHARGER_MTK6893=y
CONFIG_OPLUS_CHARGER_MTKAGING=y
CONFIG_OPLUS_4400MV_BATTERY_SUPPORT=y
CONFIG_OPLUS_CALL_MODE_SUPPORT=y
CONFIG_OPLUS_SHIP_MODE_SUPPORT=y
CONFIG_OPLUS_SHORT_C_BATT_CHECK=y
CONFIG_OPLUS_SHORT_HW_CHECK=y
CONFIG_OPLUS_SHORT_USERSPACE=y
CONFIG_OPLUS_CHIP_SOC_NODE=y
CONFIG_OPLUS_RTC_DET_SUPPORT=y
CONFIG_OPLUS_ARCH_FILE=y
CONFIG_OPLUS_DEVICE_IFNO=y
CONFIG_OPLUS_COMMON_SOFT=y
CONFIG_OPLUS_HVDCP_SUPPORT=y
CONFIG_OPLUS_SHORT_IC_CHECK=y
#endif
#/*Add for Joypad */
CONFIG_HID_SONY=y
CONFIG_HID_BETOP_FF=y
#end

# CONFIG_HWMON is not set
CONFIG_THERMAL=y
CONFIG_THERMAL_DEFAULT_GOV_BACKWARD_COMPATIBLE=y
CONFIG_WATCHDOG=y
CONFIG_MEDIATEK_WATCHDOG=y
CONFIG_MFD_MT6358=y
CONFIG_MT6358_MISC=y
CONFIG_MTK_MFD_SPMI_PMIC=y
CONFIG_REGULATOR_MT6315=y
CONFIG_REGULATOR_MT6359P=y
CONFIG_MEDIA_SUPPORT=y
CONFIG_MEDIA_CAMERA_SUPPORT=y
CONFIG_V4L_PLATFORM_DRIVERS=y
CONFIG_V4L_MEM2MEM_DRIVERS=y
CONFIG_VIDEO_MEDIATEK_JPEG=y
CONFIG_VIDEO_MEDIATEK_VCU_WO_FUSE=y
CONFIG_VIDEO_MEDIATEK_VCODEC=y
CONFIG_DRM=y

#ifdef FEATURE_BUG_STABILITY
CONFIG_BUILD_ARM64_DTB_OVERLAY_IMAGE=y
CONFIG_BUILD_ARM64_DTB_OVERLAY_IMAGE_NAMES="mediatek/k6893v1_64_k419_dummy0 mediatek/k6893v1_64_k419_dummy1 mediatek/k6893v1_64_k419_dummy2 mediatek/k6893v1_64_k419_dummy3 mediatek/k6893v1_64_k419_dummy4 mediatek/k6893v1_64_k419_dummy5 mediatek/k6893v1_64_k419_dummy6 mediatek/oplus6893_21881 mediatek/oplus6893_21127 mediatek/oplus6893_21305"
#endif /* FEATURE_BUG_STABILITY */

#ifdef OPLUS_FEATURE_LOWMEM_DBG
CONFIG_OPLUS_FEATURE_LOWMEM_DBG=y
#endif /* OPLUS_FEATURE_LOWMEM_DBG */

#CONFIG_DRM_PANEL_TRULY_TD4330_VDO=y
#CONFIG_DRM_PANEL_TRULY_FT8756_VDO=y
CONFIG_DRM_PANEL_OPLUS20615_SAMSUNG_AMS643YE01_1080P_DSI_CMD=y
CONFIG_DRM_PANEL_OPLUS20615_SAMSUNG_AMS643YE05_1080P_DSI_CMD=y
CONFIG_DRM_PANEL_OPLUS21127_SAMSUNG_AMS643AG01_1080P_DSI_CMD=y
CONFIG_MTK_ROUND_CORNER_SUPPORT=y
CONFIG_OPLUS_OFP_V2=y
CONFIG_OPLUS_CRC_CHECK_SUPPORT=y
CONFIG_DRM_MEDIATEK=y
CONFIG_MTK_GPU_SUPPORT=y
CONFIG_MTK_GPU_VERSION="mali valhall r32p1"
CONFIG_MTK_GPU_COMMON_DVFS_SUPPORT=y
CONFIG_FB_MODE_HELPERS=y
CONFIG_FB_TILEBLITTING=y
CONFIG_BACKLIGHT_LCD_SUPPORT=y
CONFIG_BACKLIGHT_CLASS_DEVICE=y
CONFIG_LOGO=y
CONFIG_SND_HRTIMER=y
CONFIG_SND_DYNAMIC_MINORS=y
CONFIG_SND_VERBOSE_PRINTK=y
CONFIG_SND_DEBUG=y
CONFIG_SND_DEBUG_VERBOSE=y
CONFIG_SND_PCM_XRUN_DEBUG=y
CONFIG_SND_SEQUENCER=y
CONFIG_SND_SEQ_DUMMY=y
# CONFIG_SND_SPI is not set
CONFIG_SND_USB_AUDIO=y
CONFIG_SND_SOC=y
CONFIG_SND_SOC_MT6885_MT6359=y
CONFIG_SND_SOC_MTK_BTCVSD=y
CONFIG_MTK_VOW_BARGE_IN_SUPPORT=y
CONFIG_SND_SOC_MTK_AUDIO_DSP=y
# CONFIG_SND_SOC_TFA9874 is not set
CONFIG_HIDRAW=y
CONFIG_HID_A4TECH=y
CONFIG_HID_APPLE=y
CONFIG_HID_BELKIN=y
CONFIG_HID_CHERRY=y
CONFIG_HID_CHICONY=y
CONFIG_HID_CYPRESS=y
CONFIG_HID_DRAGONRISE=y
CONFIG_HID_EZKEY=y
CONFIG_HID_KYE=y
CONFIG_HID_GYRATION=y
CONFIG_HID_TWINHAN=y
CONFIG_HID_KENSINGTON=y
CONFIG_HID_LOGITECH=y
CONFIG_HID_MAGICMOUSE=y
CONFIG_HID_MICROSOFT=y
CONFIG_HID_MONTEREY=y
CONFIG_HID_PANTHERLORD=y
CONFIG_HID_PETALYNX=y
CONFIG_HID_SAMSUNG=y
CONFIG_SONY_FF=y
CONFIG_HID_SUNPLUS=y
CONFIG_HID_GREENASIA=y
CONFIG_HID_SMARTJOYPLUS=y
CONFIG_HID_TOPSEED=y
CONFIG_HID_THRUSTMASTER=y
CONFIG_HID_ZEROPLUS=y
CONFIG_USB_OTG=y
CONFIG_USB_XHCI_HCD=y
CONFIG_USB_STORAGE=y
CONFIG_USB_STORAGE_DATAFAB=y
CONFIG_USB_STORAGE_FREECOM=y
CONFIG_USB_STORAGE_ISD200=y
CONFIG_USB_STORAGE_USBAT=y
CONFIG_USB_STORAGE_SDDR09=y
CONFIG_USB_STORAGE_SDDR55=y
CONFIG_USB_STORAGE_JUMPSHOT=y
CONFIG_USB_STORAGE_ALAUDA=y
CONFIG_USB_STORAGE_ONETOUCH=y
CONFIG_USB_STORAGE_KARMA=y
CONFIG_USB_STORAGE_CYPRESS_ATACB=y
CONFIG_USB_MTU3=y
CONFIG_USB_TRANCEVIBRATOR=y
CONFIG_NOP_USB_XCEIV=y
CONFIG_USB_GADGET_VBUS_DRAW=500
CONFIG_USB_CONFIGFS_SERIAL=y
CONFIG_USB_CONFIGFS_ACM=y
CONFIG_USB_CONFIGFS_RNDIS=y
CONFIG_USB_CONFIGFS_MASS_STORAGE=y
CONFIG_USB_CONFIGFS_MTK_FASTMETA=y
CONFIG_USB_CONFIGFS_F_HID=y
CONFIG_MMC=y
CONFIG_MMC_BLOCK_MINORS=32
CONFIG_MMC_CRYPTO=y
CONFIG_MTK_EMMC_SUPPORT_OTP=y
CONFIG_MMC_CQHCI=y
CONFIG_MMC_MTK=y

#ifdef OPLUS_FEATURE_STORAGE_TOOL
CONFIG_CHR_DEV_SG=y
#endif

CONFIG_NEW_LEDS=y
CONFIG_LEDS_CLASS=y
CONFIG_LEDS_REGULATOR_VIBRATOR=y
CONFIG_LEDS_TRIGGERS=y
CONFIG_LEDS_TRIGGER_TIMER=y
# CONFIG_RTC_SYSTOHC is not set
CONFIG_RTC_DRV_MT6358=y
CONFIG_DMADEVICES=y
CONFIG_MTK_UART_APDMA=y
CONFIG_SW_SYNC=y
CONFIG_ANDROID_INTF_ALARM_DEV=y
CONFIG_ION=y
CONFIG_MTK_ION=y
CONFIG_COMMON_CLK_MT6893_APU=y
CONFIG_COMMON_CLK_MT6893_AUDIOSYS=y
CONFIG_COMMON_CLK_MT6893_CAM=y
CONFIG_COMMON_CLK_MT6893_IMG=y
CONFIG_COMMON_CLK_MT6893_I2C=y
CONFIG_COMMON_CLK_MT6893_IPESYS=y
CONFIG_COMMON_CLK_MT6893_MDPSYS=y
CONFIG_COMMON_CLK_MT6893_MFGCFG=y
CONFIG_COMMON_CLK_MT6893_MMSYS=y
CONFIG_COMMON_CLK_MT6893_SCP_ADSP=y
CONFIG_COMMON_CLK_MT6893_VDE=y
CONFIG_COMMON_CLK_MT6893_VEN=y
CONFIG_MTK_IOMMU_V2=y
CONFIG_MTK_IOMMU_PGTABLE_EXT=34
CONFIG_RPMSG_MTK=y
CONFIG_MTK_PMIC_WRAP=y
CONFIG_MTK_IPI=y
CONFIG_MTK_MBOX=y
CONFIG_MTK_DEVMPU_EMI=y
CONFIG_IIO=y
CONFIG_IIO_BUFFER=y
CONFIG_IIO_KFIFO_BUF=y
CONFIG_MEDIATEK_MT6577_AUXADC=y
CONFIG_MT635X_AUXADC=y
CONFIG_PWM=y
CONFIG_PWM_MTK_DISP=y
CONFIG_PHY_MTK_TPHY=y
CONFIG_MTK_DEVINFO=y
CONFIG_EXT4_DEBUG=y
CONFIG_FS_ENCRYPTION_INLINE_CRYPT=y
CONFIG_QUOTA_NETLINK_INTERFACE=y
CONFIG_INCREMENTAL_FS=y
CONFIG_ISO9660_FS=y
CONFIG_JOLIET=y
CONFIG_ZISOFS=y
CONFIG_MSDOS_FS=y
CONFIG_VFAT_FS=y
CONFIG_SDCARD_FS=y
CONFIG_OVERLAY_FS=y
CONFIG_EXFAT_FS=y
CONFIG_EROFS_FS=y
CONFIG_PSTORE=y
CONFIG_PSTORE_CONSOLE=y
CONFIG_PSTORE_PMSG=y
CONFIG_PSTORE_RAM=y
# CONFIG_NETWORK_FILESYSTEMS is not set
CONFIG_NLS_CODEPAGE_437=y
CONFIG_NLS_CODEPAGE_950=y
CONFIG_NLS_ASCII=y
CONFIG_NLS_ISO8859_1=y
CONFIG_NLS_UTF8=y
CONFIG_STATIC_USERMODEHELPER=y
CONFIG_STATIC_USERMODEHELPER_PATH="/system_ext/bin/aee_core_forwarder"
CONFIG_CRYPTO_TWOFISH=y
# CONFIG_CRYPTO_HW is not set
CONFIG_CRC8=y
CONFIG_PRINTK_TIME=y
CONFIG_DYNAMIC_DEBUG=y
CONFIG_DEBUG_INFO=y
CONFIG_FRAME_WARN=3600
CONFIG_PAGE_OWNER=y
CONFIG_DEBUG_SECTION_MISMATCH=y
CONFIG_DEBUG_PAGEALLOC=y
CONFIG_DEBUG_PAGEALLOC_ENABLE_DEFAULT=y
CONFIG_SLUB_DEBUG_ON=y
CONFIG_DEBUG_KMEMLEAK=y
CONFIG_DEBUG_KMEMLEAK_EARLY_LOG_SIZE=9600
CONFIG_DEBUG_KMEMLEAK_DEFAULT_OFF=y
CONFIG_DEBUG_VIRTUAL=y
CONFIG_PANIC_ON_OOPS=y
CONFIG_PANIC_TIMEOUT=5
CONFIG_SCHEDSTATS=y
CONFIG_SCHED_STACK_END_CHECK=y
CONFIG_PROVE_LOCKING=y
CONFIG_DEBUG_LOCKDEP=y
CONFIG_DEBUG_ATOMIC_SLEEP=y
CONFIG_MTK_LOCKING_AEE=y
CONFIG_RCU_CPU_STALL_TIMEOUT=60
CONFIG_RCU_TRACE=y
CONFIG_FAULT_INJECTION=y
CONFIG_DMA_API_DEBUG=y
CONFIG_BUG_ON_DATA_CORRUPTION=y
CONFIG_KGDB=y
CONFIG_KGDB_KDB=y
#ifdef OPLUS_FEATURE_SECURITY_COMMON
#add for open trustonic tee, config tee.
CONFIG_TEE=y
CONFIG_TRUSTONIC_TEE_SUPPORT=y
CONFIG_MTK_TEE_GP_SUPPORT=y
CONFIG_TRUSTONIC_TEE_VERSION=500
#endif /* OPLUS_FEATURE_SECURITY_COMMON */
#ifdef OPLUS_FEATURE_SECURITY_COMMON
#ModuleSig, Fix the MTK issue, resulting in the signed .ko not being correctly placed in the vendor.img. 2020-11-21
CONFIG_MODULE_SIG=y
CONFIG_MODULE_SIG_FORCE=y
CONFIG_MODULE_SIG_ALL=y
CONFIG_MODULE_SIG_SHA512=y
#endif /* OPLUS_FEATURE_SECURITY_COMMON */

#ifdef OPLUS_FEATURE_SECURITY_COMMON
#add for oplus secure common
CONFIG_OPLUS_SECURE=y
CONFIG_OPLUS_SECURE_QCOM=n
CONFIG_OPLUS_SECURE_MTK=y
CONFIG_OPLUS_SECURE_COMMON=y
#endif /* OPLUS_FEATURE_SECURITY_COMMON */
#ifdef OPLUS_FEATURE_KEY_SECURITY
#Add for widevine key
CONFIG_MTK_DRM_KEY_MNG_SUPPORT=y
CONFIG_MTK_SEC_VIDEO_PATH_SUPPORT=y
CONFIG_MTK_SVP_ON_MTEE_SUPPORT=y
#endif /* OPLUS_FEATURE_KEY_SECURITY */

#ifdef CONFIG_OPLUS_SECURE_GUARD
CONFIG_OPLUS_ROOT_CHECK=y
CONFIG_OPLUS_EXECVE_BLOCK=y
CONFIG_OPLUS_MOUNT_BLOCK=y
CONFIG_OPLUS_SECURE_GUARD=y
#endif /*CONFIG_OPLUS_SECURE_GUARD*/

#ifdef OPLUS_FEATURE_ACM
CONFIG_OPLUS_FEATURE_ACM=y
CONFIG_OPLUS_FEATURE_ACM_LOGGING=y
#endif /* OPLUS_FEATURE_ACM */

#ifdef OPLUS_FEATURE_FINGERPRINT
#/* add for fingerprint */
CONFIG_OPLUS_FINGERPRINT=y
CONFIG_OPLUS_FINGERPRINT_MTK=y
CONFIG_OPLUS_FINGERPRINT_GOODIX_OPTICAL=y
CONFIG_OPLUS_FINGERPRINT_JIIOV_OPTICAL=y
#endif /* OPLUS_FEATURE_FINGERPRINT */

#ifdef OPLUS_FEATURE_FINGERPRINT
#/* add for fingerprint */
CONFIG_UFF_FINGERPRINT=y
CONFIG_UFF_FINGERPRINT_MTK=y
#endif /* OPLUS_FEATURE_FINGERPRINT */

#ifdef OPLUS_FEATURE_MEMORY_MONITOR
CONFIG_DUMP_TASKS_MEM=y
#endif /* OPLUS_FEATURE_MEMORY_MONITOR */

CONFIG_PROACTIVE_COMPACT=y
#ifdef OPLUS_BUG_STABILITY
CONFIG_OPLUS_SYSTEM_KERNEL=y
CONFIG_OPLUS_FEATURE_OPROJECT=y
CONFIG_SECTION_MISMATCH_WARN_ONLY=y
CONFIG_OPLUS_FEATURE_FEEDBACK=y
CONFIG_OPLUS_DEVICE_IFNO=y
CONFIG_OPLUS_FEATURE_THEIA=y
CONFIG_OPLUS_FEATURE_PHOENIX=y
CONFIG_OPLUS_FEATURE_KMSG_WB=y
CONFIG_OPLUS_FEATURE_SHUTDOWN_DETECT=y
CONFIG_SND_SOC_FSA=y
CONFIG_SND_SOC_CODEC_AW882XX=y
CONFIG_HSKEY_BLOCK=y
CONFIG_OPLUS_FEATURE_MM_FEEDBACK=y

CONFIG_OPLUS_FEATURE_MTK_FORCE_SHUTDOWN=y
CONFIG_OPLUS_FEATURE_PANIC_FLUSH=y
CONFIG_OPLUS_FEATURE_FDLEAK_CHECK=y
CONFIG_OPLUS_FEATURE_LAST_BOOT_REASON=y
#endif
#ifdef OPLUS_FEATURE_HANS_FREEZE
CONFIG_OPLUS_HANS=y
#endif /* OPLUS_FEATURE_HANS_FREEZE */
#endif /* OPLUS_BUG_STABILITY */

#ifdef OPLUS_FEATURE_SWAPPINESS
CONFIG_DYNAMIC_TUNNING_SWAPPINESS=y
#endif

#ifdef OPLUS_FEATURE_WIFI_SLA
#todo: need to change to m when GKI
CONFIG_OPLUS_FEATURE_WIFI_SLA=y
#endif /* OPLUS_FEATURE_WIFI_SLA */

#ifdef OPLUS_FEATURE_MIDAS
CONFIG_OPLUS_FEATURE_BINDER_STATS_ENABLE=y
CONFIG_OPLUS_FEATURE_MIDAS=y
#endif

#ifdef OPLUS_FEATURE_DATA_LIMIT
CONFIG_IFB=y
CONFIG_NET_SCH_MULTIQ=y
CONFIG_NET_SCH_NETEM=y
CONFIG_CLS_U32_MARK=y
CONFIG_NET_CLS_FLOW=y
CONFIG_NET_EMATCH_CMP=y
CONFIG_NET_EMATCH_NBYTE=y
CONFIG_NET_EMATCH_META=y
CONFIG_NET_EMATCH_TEXT=y
CONFIG_NET_ACT_GACT=y
CONFIG_NET_ACT_MIRRED=y
CONFIG_NET_ACT_SKBEDIT=y
#endif /* OPLUS_FEATURE_DATA_LIMIT */

#ifdef OPLUS_FEATURE_DATA_EVAL
CONFIG_OPLUS_FEATURE_DATA_EVAL=y
#endif /*OPLUS_FEATURE_DATA_EVAL*/

#ifdef OPLUS_FEATURE_WIFI_CAPCENTER
CONFIG_OPLUS_FEATURE_WIFI_CAPCENTER=y
#endif /* OPLUS_FEATURE_WIFI_CAPCENTER */

CONFIG_OPLUS_FEATURE_EAS_IGNORE_CACHEMISS=n
#ifdef OPLUS_FEATURE_SCHED_ASSIST
CONFIG_SCHED_WALT=y
CONFIG_OPLUS_FG_BOOST=y
#endif /* OPLUS_FEATURE_SCHED_ASSIST */

CONFIG_OPLUS_FEATURE_FAKE_CAP=y
CONFIG_OPLUS_FEATURE_EAS_OPT=y

CONFIG_OPLUS_FEATURE_ABNORMAL_FLAG=y

#ifdef OPLUS_FEATURE_ZRAM_OPT
CONFIG_OPLUS_ZRAM_OPT=y
CONFIG_CRYPTO_LZ4=y
CONFIG_PGTABLE_MAPPING=y
#endif /* OPLUS_FEATURE_ZRAM_OPT */

CONFIG_NETFILTER_XT_TARGET_DSCP=y
CONFIG_NETFILTER_XT_MATCH_DSCP=y

#ifdef OPLUS_FEATURE_SCHEDUTIL_USE_TL
CONFIG_SCHEDUTIL_USE_TL=y
#endif
#ifdef OPLUS_FEATURE_HEALTHINFO
CONFIG_OPLUS_MEM_MONITOR=y
CONFIG_FG_TASK_UID=y
CONFIG_OPLUS_HEALTHINFO=y
CONFIG_SLAB_STAT_DEBUG=y
CONFIG_SLUB_DEBUG=n
#endif /*OPLUS_FEATURE_HEALTHINFO*/
CONFIG_OPLUS_FEATURE_AUDIO_OPT=y
#ifdef OPLUS_FEATURE_HEALTHINFO
CONFIG_OPLUS_JANK_INFO=y
#endif /* OPLUS_FEATURE_HEALTHINFO */

#ifdef OPLUS_FEATURE_TASK_CPUSTATS
CONFIG_OPLUS_SCHED=y
CONFIG_OPLUS_CTP=y
#endif

#ifdef OPLUS_FEATURE_PROCESS_RECLAIM
CONFIG_PROCESS_RECLAIM=y
#endif
#ifdef OPLUS_FEATURE_NFC_BRINGUP
#For pn557
CONFIG_NFC_PN553_DEVICES=y
#For sn100
CONFIG_NXP_NFC_I2C=y
CONFIG_NXP_ESE_P73=y
#endif /* OPLUS_FEATURE_NFC_BRINGUP */

#ifdef OPLUS_FEATURE_HYBRIDSWAP
CONFIG_HYBRIDSWAP=y
CONFIG_HYBRIDSWAP_SWAPD=y
CONFIG_HYBRIDSWAP_CORE=y
#endif

CONFIG_LOOK_AROUND=y

CONFIG_MTK_HDR_COLOR_GAIN_RGB=03DD40037A

#ifdef OPLUS_FEATURE_OLC
CONFIG_OPLUS_FEATURE_OLC=y
#endif /* OPLUS_FEATURE_OLC */

#ifdef OPLUS_FEATURE_DNS_HOOK
CONFIG_OPLUS_FEATURE_DNS_HOOK=y
#endif /* OPLUS_FEATURE_DNS_HOOK */

#ifdef OPLUS_FEATURE_STATS_CALC
CONFIG_OPLUS_FEATURE_STATS_CALC=y
#endif /* OPLUS_FEATURE_STATS_CALC */
ONFIG_OPLUS_FEATURE_GAME_OPT=y
CONFIG_OPLUS_FEATURE_PMIC_MONITOR_MTK=y
CONFIG_OPLUS_CPUFREQ_IOWAIT_PROTECT=y

CONFIG_CRYPTO_ZSTD=y
CONFIG_OPLUS_FEATURE_CPU_JANKINFO=y
CONFIG_IRQ_TIME_ACCOUNTING=y

#ifdef OPLUS_FEATURE_SIM
CONFIG_SIM_DETECT=y
#endif

CONFIG_OPLUS_LOCKING_OSQ=y
CONFIG_OPLUS_LOCKING_MONITOR=y
CONFIG_OPLUS_LOCKING_STRATEGY=y

#ifdef OPLUS_FEATURE_TMEMORY
CONFIG_TMEMORY=y
CONFIG_TMEMORY_CRYPTO=y
CONFIG_TMEMORY_DEBUG=y
CONFIG_TMEMORY_MIGRATION=y
CONFIG_TMEMORY_SWITCH_TIME_DEFAULT=5000
CONFIG_TMEMORY_FAULT_INJECTION=y
#endif /* OPLUS_FEATURE_TMEMORY */

CONFIG_NET_SCH_PRIO=y
CONFIG_NET_CLS_MATCHALL=y
CONFIG_NET_ACT_BPF=y
CONFIG_OPLUS_FEATURE_DATA_MODULE=y
#end
CONFIG_OPLUS_UXMEM_OPT=y
CONFIG_OPLUS_DYNAMIC_READAHEAD=y
CONFIG_OPLUS_FEATURE_SCHED_ASSIST=y
CONFIG_OPLUS_UX_IM_FLAG=y
CONFIG_OPLUS_BLK_MONITOR=y

CONFIG_OPLUS_FEATURE_SIGKILL_DIAGNOSIS=y
#For FS Compress Feature
CONFIG_F2FS_FS_COMPRESSION=y
```
