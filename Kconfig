## arch/arm64/configs/k68v1_64_k419_debug_defconfig
```kconfig
CONFIG_PREEMPT=y
CONFIG_IKHEADERS=m
CONFIG_LOG_BUF_SHIFT=19
CONFIG_UCLAMP_TASK=y
CONFIG_UCLAMP_TASK_GROUP=y
CONFIG_CPUSETS=y
CONFIG_SCHED_TUNE=y
# CONFIG_RD_BZIP2 is not set
# CONFIG_RD_LZMA is not set
# CONFIG_RD_XZ is not set
# CONFIG_RD_LZO is not set
# CONFIG_RD_LZ4 is not set
CONFIG_SYSCTL_SYSCALL=y
# CONFIG_LOCALVERSION_AUTO is not set
# CONFIG_FHANDLE is not set
# CONFIG_KALLSYMS_BASE_RELATIVE is not set
CONFIG_MTK_SCHED_EXTENSION=y
CONFIG_MTK_IDLE_BALANCE_ENHANCEMENT=y
CONFIG_MTK_SCHED_INTEROP=y
CONFIG_MTK_SCHED_LB_ENHANCEMENT=y
CONFIG_MTK_SCHED_TRACERS=y
CONFIG_MTK_SCHED_CPU_PREFER=y
CONFIG_MTK_SCHED_BIG_TASK_MIGRATE=y
CONFIG_MACH_MT6768=y
CONFIG_SCHED_MC=y
CONFIG_NR_CPUS=8
CONFIG_RANDOMIZE_BASE=y
CONFIG_CMDLINE="console=tty0 console=ttyMT3,921600n1 root=/dev/ram vmalloc=496M slub_max_order=0 slub_debug=O "
# CONFIG_EFI is not set
CONFIG_BUILD_ARM64_APPENDED_DTB_IMAGE=y
CONFIG_BUILD_ARM64_APPENDED_DTB_IMAGE_NAMES="mediatek/mt6768"
CONFIG_BUILD_ARM64_DTB_OVERLAY_IMAGE=y
CONFIG_BUILD_ARM64_DTB_OVERLAY_IMAGE_NAMES="mediatek/oplus6768_20761"
CONFIG_WQ_POWER_EFFICIENT_DEFAULT=y
CONFIG_ENERGY_MODEL=y
CONFIG_CPU_FREQ=y
CONFIG_CPU_FREQ_STAT=y
CONFIG_CPU_FREQ_DEFAULT_GOV_SCHEDUTIL=y
CONFIG_CPU_FREQ_GOV_POWERSAVE=y
CONFIG_CPU_FREQ_GOV_USERSPACE=y
CONFIG_CPU_FREQ_GOV_ONDEMAND=y
CONFIG_KPROBES=y
CONFIG_MODULE_SRCVERSION_ALL=y
# CONFIG_BLK_DEV_BSG is not set
CONFIG_BLK_INLINE_ENCRYPTION=y
CONFIG_BLK_INLINE_ENCRYPTION_FALLBACK=y
# CONFIG_CORE_DUMP_DEFAULT_ELF_HEADERS is not set
CONFIG_ZSMALLOC=y
CONFIG_XFRM_MIGRATE=y
CONFIG_SYN_COOKIES=y
CONFIG_VLAN_8021Q=y
CONFIG_CLS_U32_PERF=y
CONFIG_CLS_U32_MARK=y
CONFIG_CFG80211=y
CONFIG_NL80211_TESTMODE=y
CONFIG_CFG80211_DEVELOPER_WARNINGS=y
# CONFIG_CFG80211_DEFAULT_PS is not set
CONFIG_CFG80211_DEBUGFS=y
# CONFIG_UEVENT_HELPER is not set
CONFIG_FW_LOADER_USER_HELPER=y
CONFIG_FW_LOADER_USER_HELPER_FALLBACK=y
# CONFIG_FW_CACHE is not set
CONFIG_ZRAM=y
CONFIG_BLK_DEV_LOOP_MIN_COUNT=16
CONFIG_ANDROID_DEFAULT_SETTING=y
CONFIG_MTK_ANDROID_DEFAULT_SETTING=y
CONFIG_USB_MTK_HDRC=y
CONFIG_MTK_MUSB_QMU_SUPPORT=y
CONFIG_MTK_MUSB_QMU_PURE_ZLP_SUPPORT=y
CONFIG_MTK_MUSB_DRV_36BIT=y
CONFIG_USB_MTK_OTG=y
CONFIG_MTK_MUSB_DUAL_ROLE=y
CONFIG_MTK_PLATFORM="mt6768"
CONFIG_ARCH_MTK_PROJECT="k68v1_64_k419"
CONFIG_MTK_ENG_BUILD=y
CONFIG_NONLINEAR_FREQ_CTL=y
CONFIG_PMIC_LBAT_SERVICE=y
CONFIG_MTK_PTPOD=y
CONFIG_MTK_STATIC_POWER=y
CONFIG_MTK_UNIFY_POWER=y
CONFIG_MTK_CPU_FREQ=y
#CONFIG_MTK_PBM is not set
CONFIG_MTK_PMIC_NEW_ARCH=y
CONFIG_MTK_PMIC_COMMON=y
CONFIG_MTK_PMIC_CHIP_MT6358=y
CONFIG_MTK_EXTERNAL_CHARGER_TYPE_DETECT=y
CONFIG_MFD_MT6370_PMU=y
CONFIG_OPLUS_PMIC_COMMON=y
CONFIG_MT6370_PMU_CHARGER=y
CONFIG_MT6370_PMU_FLED=y
CONFIG_MT6370_PMU_BLED=y
CONFIG_MT6370_PMU_LDO=y
CONFIG_MT6370_PMU_DSV=y
CONFIG_MTK_PMIC_WRAP_HAL=y
CONFIG_CUSTOM_KERNEL_IMGSENSOR="imx519_mipi_raw s5k2t7sp_mipi_raw s5k2p7_mipi_raw ov8856_mipi_raw imx386_mipi_raw imx398_mipi_raw s5k2l7_mipi_raw even_qtech_main_s5kgm1st03 even_qtech_main_ov13b10 even_hlt_front_s5k4h7 even_hlt_depth_gc02m1b even_shengtai_macro_ov02b10 even_shengtai_front_ov8856"
CONFIG_MTK_LCM=y
CONFIG_CUSTOM_KERNEL_LCM="hx83112b_fhdp_dsi_cmd_auo_rt5081 ilt9882n_truly_even_hdp_dsi_vdo_lcm nt36525b_hlt_even_boe_hdp_dsi_vdo_lcm ilt7807s_hlt_even_hdp_dsi_vdo_lcm"
CONFIG_MTK_LCM_DEVICE_TREE_SUPPORT_PASCAL_E=y
CONFIG_MTK_SYNC=y
CONFIG_MTK_FB=y
CONFIG_MTK_LCM_PHYSICAL_ROTATION="0"
CONFIG_LCM_HEIGHT="2160"
CONFIG_MTK_AAL_SUPPORT=y
CONFIG_MTK_M4U=y
CONFIG_MTK_FLASHLIGHT=y
CONFIG_MTK_FLASHLIGHT_EVEN=y
CONFIG_MTK_FLASHLIGHT_MT6370=y
CONFIG_MTK_FLASHLIGHT_PT=y
CONFIG_MTK_FLASHLIGHT_PT_STRICT=y
CONFIG_MTK_FLASHLIGHT_DLPT=y
CONFIG_RT_FLASHLIGHT=y
CONFIG_MTK_IMGSENSOR=y
CONFIG_MTK_LENS=y
CONFIG_MTK_CAM_CAL=y
CONFIG_MTK_CMDQ_V3=y
CONFIG_MTK_CMDQ=y
CONFIG_MTK_SMI_EXT=y
CONFIG_MTK_JPEG=y
CONFIG_MTK_CCU=y
CONFIG_MTK_CAM_SECURITY_SUPPORT=y
CONFIG_MTK_CAM_GENIEZONE_SUPPORT=y
CONFIG_MTK_SENSOR_SUPPORT=y
CONFIG_MTK_SENSOR_ARCHITECTURE="1.0"
CONFIG_CUSTOM_KERNEL_ACCELEROMETER=y
CONFIG_MTK_ACCELHUB=y
CONFIG_CUSTOM_KERNEL_ALSPS=y
CONFIG_MTK_ALSPSHUB=y
CONFIG_CUSTOM_KERNEL_GYROSCOPE=y
CONFIG_MTK_GYROHUB=y
CONFIG_CUSTOM_KERNEL_MAGNETOMETER=y
CONFIG_MTK_MAGHUB=y
CONFIG_MTK_HWMON=y
CONFIG_CUSTOM_KERNEL_BAROMETER=y
CONFIG_MTK_BAROHUB=y
CONFIG_CUSTOM_KERNEL_STEP_COUNTER=y
CONFIG_MTK_STEPSIGNHUB=y
CONFIG_CUSTOM_KERNEL_SITUATION=y
CONFIG_MTK_STATHUB=y
CONFIG_MTK_WAKEHUB=y
CONFIG_MTK_GLGHUB=y
CONFIG_MTK_PICKUPHUB=y
CONFIG_MTK_DEVICE_ORIENTATION_HUB=y
CONFIG_MTK_MOTION_DETECT_HUB=y
CONFIG_MTK_TILTDETECTHUB=y
CONFIG_CUSTOM_KERNEL_SENSORHUB=y
CONFIG_NANOHUB=y
CONFIG_NANOHUB_MTK_IPI=y
CONFIG_CUSTOM_KERNEL_SENSOR_FUSION=y
CONFIG_CUSTOM_KERNEL_GRV_SENSOR=y
CONFIG_CUSTOM_KERNEL_GMRV_SENSOR=y
CONFIG_CUSTOM_KERNEL_RV_SENSOR=y
CONFIG_CUSTOM_KERNEL_LINEARACCEL_SENSOR=y
CONFIG_CUSTOM_KERNEL_GRAVITY_SENSOR=y
CONFIG_CUSTOM_KERNEL_UNCALI_ACC_SENSOR=y
CONFIG_CUSTOM_KERNEL_UNCALI_GYRO_SENSOR=y
CONFIG_CUSTOM_KERNEL_UNCALI_MAG_SENSOR=y
CONFIG_MTK_UNCALI_MAGHUB=y
CONFIG_MTK_UNCALI_GYROHUB=y
CONFIG_MTK_UNCALI_ACCHUB=y
CONFIG_MTK_CCCI_DEVICES=y
CONFIG_MTK_MD1_SUPPORT=12
CONFIG_MTK_ECCCI_DRIVER=y
CONFIG_MTK_ECCCI_C2K=y
CONFIG_MTK_BTIF=y
CONFIG_MTK_COMBO=y
CONFIG_MTK_COMBO_CHIP_CONSYS_6768=y
CONFIG_MTK_COMBO_GPS=y
CONFIG_MTK_COMBO_WIFI=y
CONFIG_MTK_DHCPV6C_WIFI=y
CONFIG_MTK_GPS_SUPPORT=y
CONFIG_MTK_FMRADIO=y
CONFIG_MTK_FM_CHIP="MT6631_FM"
CONFIG_MTK_CONNSYS_DEDICATED_LOG_PATH=y
CONFIG_HAVE_MTK_ENABLE_GENIEZONE=y
CONFIG_MTK_ENABLE_GENIEZONE=y
CONFIG_MTK_GZ_MAIN=y
CONFIG_MTK_GZ_LOG=y
CONFIG_MTK_GZ_VIRTIO=y
CONFIG_MTK_GZ_VIRTIO_IPC=y
CONFIG_MTK_GZ_IRQ=y
CONFIG_HAVE_MTK_GZ_LOG=y
CONFIG_EXTCON_MTK_USB=y
CONFIG_MTK_USB_TYPEC_U3_MUX=y
CONFIG_TCPC_CLASS=y
CONFIG_OPLUS_CHARGER_MTK_CHGIC=y
#ifdef OPLUS_FEATURE_CHG_BASIC
#CONFIG_TCPC_MT6370 is not set
#endif
CONFIG_USB_POWER_DELIVERY=y
CONFIG_MTK_LEDS=y
CONFIG_MTK_PWM=y
CONFIG_MTK_ACCDET=y
CONFIG_ACCDET_EINT_IRQ=y
CONFIG_ACCDET_SUPPORT_EINT0=y
CONFIG_MTK_RTC=y
CONFIG_MTK_PERF_COMMON=y
CONFIG_MTK_PERF_TRACKER=y
CONFIG_MTK_LOAD_TRACKER=y
CONFIG_MTK_CPU_CTRL_CFP=y
CONFIG_MTK_PERF_OBSERVER=y
CONFIG_MTK_RESYM=y
CONFIG_MTK_FPSGO_V3=y
CONFIG_MTK_TASK_TURBO=y
CONFIG_MTK_TINYSYS_SCP_SUPPORT=y
CONFIG_MTK_TINYSYS_SSPM_SUPPORT=y
CONFIG_MTK_TINYSYS_SSPM_VERSION="v1"
#ifdef OPLUS_FEATURE_OLC
CONFIG_OPLUS_FEATURE_OLC=y
#endif /* OPLUS_FEATURE_OLC */
CONFIG_MTK_MET_PLF=m
CONFIG_MTPROF=y
CONFIG_MTK_SCHED_MONITOR=y
CONFIG_MTK_IRQ_COUNT_TRACER=y
CONFIG_MTK_IRQ_OFF_TRACER=y
CONFIG_MTK_PREEMPT_TRACER=y
CONFIG_MTK_AEE_UT=y
CONFIG_MTK_AEE_HANGDET=y
CONFIG_MTK_CM_MGR_LEGACY=y
CONFIG_MTK_VIBRATOR=y
CONFIG_MTK_LEGACY_THERMAL=y
CONFIG_MTK_THERMAL_PA_VIA_ATCMD=y
CONFIG_MTK_CAMERA_ISP_RSC_SUPPORT=y
CONFIG_MTK_CAMERA_ISP_WPE_SUPPORT=y
CONFIG_MTK_CAMERA_ISP_DPE_SUPPORT=y
CONFIG_MTK_CAMERA_ISP_FD_SUPPORT=y
CONFIG_MTK_SELINUX_AEE_WARNING=y
CONFIG_MTK_DRAM_LOG_STORE=y
CONFIG_MTK_DRAM_LOG_STORE_ADDR=0x10E700
CONFIG_MTK_DRAM_LOG_STORE_SIZE=0x100
CONFIG_MTK_FREQ_HOPPING=y
CONFIG_SCSI=y
CONFIG_BLK_DEV_SD=y
#ifdef OPLUS_FEATURE_STORAGE_TOOL
CONFIG_CHR_DEV_SG=y
#endif
CONFIG_SCSI_SCAN_ASYNC=y
# CONFIG_SCSI_LOWLEVEL is not set
CONFIG_DM_DEBUG=y
CONFIG_DM_CRYPT=y
CONFIG_DM_DEFAULT_KEY=y
CONFIG_DM_UEVENT=y
CONFIG_DM_VERITY_AVB=y
CONFIG_DM_VERITY_FEC=y
CONFIG_DM_BOW=y
CONFIG_IFB=y
# CONFIG_ETHERNET is not set
CONFIG_PPP_FILTER=y
CONFIG_PPP_MULTILINK=y
CONFIG_PPPOE=y
CONFIG_PPP_ASYNC=y
CONFIG_PPP_SYNC_TTY=y
CONFIG_USB_USBNET=y
# CONFIG_KEYBOARD_ATKBD is not set
CONFIG_KEYBOARD_MTK=y
# CONFIG_ONEKEY_REBOOT_NORMAL_MODE is not set
# CONFIG_ONEKEY_REBOOT_OTHER_MODE is not set
CONFIG_TWOKEY_REBOOT_NORMAL_MODE=y
CONFIG_TWOKEY_REBOOT_OTHER_MODE=y
CONFIG_KPD_PWRKEY_USE_PMIC=y
CONFIG_MTK_MRDUMP_KEY=y
# CONFIG_INPUT_MOUSE is not set
CONFIG_INPUT_TOUCHSCREEN=y
CONFIG_TOUCHPANEL_MTK_PLATFORM=y
CONFIG_TOUCHPANEL_OPLUS=y
CONFIG_TOUCHPANEL_ILITEK=y
CONFIG_TOUCHPANEL_ILITEK_ILITEK9882N=y
# CONFIG_TOUCHPANEL_ILITEK_ILITEK7807S=y
CONFIG_OPLUS_FW_UPDATE=y
CONFIG_TOUCHSCREEN_MTK_TOUCH="GT9886 GT1151"
CONFIG_INPUT_MISC=y
CONFIG_INPUT_UINPUT=y
# CONFIG_SERIO is not set
# CONFIG_VT is not set
CONFIG_LEGACY_PTY_COUNT=16
# CONFIG_DEVMEM is not set
CONFIG_SERIAL_8250=y
CONFIG_SERIAL_8250_CONSOLE=y
CONFIG_SERIAL_8250_NR_UARTS=2
CONFIG_SERIAL_8250_RUNTIME_UARTS=2
CONFIG_SERIAL_8250_MT6577=y
CONFIG_RPMB=y
CONFIG_I2C_MTK=y
CONFIG_SPI=y
CONFIG_SPI_MT65XX=y
CONFIG_MTK_CHARGER=y
CONFIG_OPLUS_CHARGER=y
CONFIG_OPLUS_CHARGER_MTK=y
CONFIG_OPLUS_4400MV_BATTERY_SUPPORT=y
#CONFIG_CHARGER_BQ2589X is not set
CONFIG_CHARGER_SY6970=y
CONFIG_CHARGER_BQ2591X=y
CONFIG_MTK_EXTERNAL_CHARGER_TYPE_DETECT=y
CONFIG_OPLUS_CALL_MODE_SUPPORT=y
CONFIG_OPLUS_SHIP_MODE_SUPPORT=y
CONFIG_CHARGER_RT9467=y
CONFIG_TCPC_RT1711H=y
CONFIG_TCPC_SGM7220=y
CONFIG_CHARGER_SGM41512=y
CONFIG_OPLUS_CHECK_CHARGERID_VOLT=y
CONFIG_MTK_DUAL_CHARGER_SUPPORT=y
CONFIG_MTK_PUMP_EXPRESS_PLUS_20_SUPPORT=y
CONFIG_CHARGER_RT9471=y
CONFIG_CHARGER_RT9467=y
CONFIG_CHARGER_SY6974=y
CONFIG_OPLUS_DUAL_BQ_CHARGER=y
CONFIG_MTK_USB_IDDIG=y
CONFIG_OPLUS_SMART_CHARGER_SUPPORT=y
CONFIG_OPLUS_CHIP_SOC_NODE=y
#CONFIG_OPLUS_CHARGER_MTK6768=y
CONFIG_OPLUS_CHARGER_MTK6769R=y
CONFIG_OPLUS_HVDCP_SUPPORT=y
CONFIG_MTK_KERNEL_POWER_OFF_CHARGING=y
CONFIG_MTK_GAUGE_VERSION=30
# CONFIG_HWMON is not set
CONFIG_THERMAL=y
CONFIG_THERMAL_DEFAULT_GOV_BACKWARD_COMPATIBLE=y
CONFIG_WATCHDOG=y
CONFIG_MEDIATEK_WATCHDOG=y
CONFIG_MT6358_MISC=y
CONFIG_REGULATOR_MT6358=y
CONFIG_MEDIA_SUPPORT=y
CONFIG_MEDIA_CAMERA_SUPPORT=y
CONFIG_V4L_PLATFORM_DRIVERS=y
CONFIG_V4L_MEM2MEM_DRIVERS=y
CONFIG_VIDEO_MEDIATEK_VCU_WO_FUSE=y
CONFIG_VIDEO_MEDIATEK_VCODEC=y
CONFIG_MTK_GPU_SUPPORT=y
CONFIG_MTK_GPU_VERSION="mali valhall r32p1"
CONFIG_MTK_GPU_COMMON_DVFS_SUPPORT=y
CONFIG_FB_MODE_HELPERS=y
CONFIG_FB_TILEBLITTING=y
CONFIG_LOGO=y
CONFIG_SND_HRTIMER=y
CONFIG_SND_DYNAMIC_MINORS=y
CONFIG_SND_VERBOSE_PRINTK=y
CONFIG_SND_DEBUG=y
CONFIG_SND_DEBUG_VERBOSE=y
CONFIG_SND_PCM_XRUN_DEBUG=y
CONFIG_SND_SEQUENCER=y
CONFIG_SND_SEQ_DUMMY=y

CONFIG_OPLUS_FEATURE_MIDAS=y

# CONFIG_SND_SPI is not set
CONFIG_SND_USB_AUDIO=y
CONFIG_SIA_PA_ALGO=y
CONFIG_SIA_PA_ALGO_MT6833=y
CONFIG_SIA_PA_REG_MT6769=y
CONFIG_SND_SOC=y
CONFIG_SND_SOC_MT6768_MT6358=y
CONFIG_SND_SOC_MTK_BTCVSD=y
CONFIG_SND_SOC_MT6660=y
CONFIG_HIDRAW=y
CONFIG_HID_A4TECH=y
CONFIG_HID_APPLE=y
CONFIG_HID_BELKIN=y
CONFIG_HID_CHERRY=y
CONFIG_HID_CHICONY=y
CONFIG_HID_CYPRESS=y
CONFIG_HID_DRAGONRISE=y
CONFIG_HID_EZKEY=y
CONFIG_HID_KYE=y
CONFIG_HID_GYRATION=y
CONFIG_HID_TWINHAN=y
CONFIG_HID_KENSINGTON=y
CONFIG_HID_LOGITECH=y
CONFIG_HID_MAGICMOUSE=y
CONFIG_HID_MICROSOFT=y
CONFIG_HID_MONTEREY=y
CONFIG_HID_PANTHERLORD=y
CONFIG_HID_PETALYNX=y
CONFIG_HID_SAMSUNG=y
CONFIG_HID_SUNPLUS=y
CONFIG_HID_GREENASIA=y
CONFIG_HID_SMARTJOYPLUS=y
CONFIG_HID_TOPSEED=y
CONFIG_HID_THRUSTMASTER=y
CONFIG_HID_ZEROPLUS=y
CONFIG_USB_STORAGE=y
CONFIG_USB_STORAGE_DATAFAB=y
CONFIG_USB_STORAGE_FREECOM=y
CONFIG_USB_STORAGE_ISD200=y
CONFIG_USB_STORAGE_USBAT=y
CONFIG_USB_STORAGE_SDDR09=y
CONFIG_USB_STORAGE_SDDR55=y
CONFIG_USB_STORAGE_JUMPSHOT=y
CONFIG_USB_STORAGE_ALAUDA=y
CONFIG_USB_STORAGE_ONETOUCH=y
CONFIG_USB_STORAGE_KARMA=y
CONFIG_USB_STORAGE_CYPRESS_ATACB=y
CONFIG_USB_TRANCEVIBRATOR=y
CONFIG_NOP_USB_XCEIV=y
CONFIG_USB_GADGET_VBUS_DRAW=500
CONFIG_USB_CONFIGFS_SERIAL=y
CONFIG_USB_CONFIGFS_ACM=y
CONFIG_USB_CONFIGFS_RNDIS=y
CONFIG_USB_CONFIGFS_MASS_STORAGE=y
CONFIG_USB_CONFIGFS_MTK_FASTMETA=y
CONFIG_USB_CONFIGFS_F_HID=y
CONFIG_MMC=y
CONFIG_MMC_BLOCK_MINORS=32
CONFIG_MMC_CRYPTO=y
CONFIG_MTK_EMMC_SUPPORT_OTP=y
CONFIG_MMC_CQHCI=y
CONFIG_MMC_MTK=y
CONFIG_NEW_LEDS=y
CONFIG_LEDS_CLASS=y
CONFIG_LEDS_TRIGGERS=y
CONFIG_LEDS_TRIGGER_TIMER=y
# CONFIG_RTC_SYSTOHC is not set
CONFIG_RTC_DRV_MT6358=y
CONFIG_DMADEVICES=y
CONFIG_MTK_UART_APDMA=y
CONFIG_SW_SYNC=y
CONFIG_ANDROID_INTF_ALARM_DEV=y
CONFIG_ION=y
CONFIG_MTK_ION=y
CONFIG_MTK_PMIC_WRAP=y
CONFIG_PM_DEVFREQ=y
CONFIG_IIO=y
CONFIG_MEDIATEK_MT6577_AUXADC=y
CONFIG_MT635X_AUXADC=y
CONFIG_PHY_MTK_TPHY=y
CONFIG_MTK_DEVINFO=y
CONFIG_EXT4_DEBUG=y
CONFIG_FS_ENCRYPTION_INLINE_CRYPT=y
CONFIG_QUOTA_NETLINK_INTERFACE=y
CONFIG_INCREMENTAL_FS=y
CONFIG_ISO9660_FS=y
CONFIG_JOLIET=y
CONFIG_ZISOFS=y
CONFIG_MSDOS_FS=y
CONFIG_VFAT_FS=y
CONFIG_PSTORE=y
CONFIG_PSTORE_CONSOLE=y
CONFIG_PSTORE_PMSG=y
CONFIG_PSTORE_RAM=y
# CONFIG_NETWORK_FILESYSTEMS is not set
CONFIG_NLS_CODEPAGE_437=y
CONFIG_NLS_CODEPAGE_950=y
CONFIG_NLS_ASCII=y
CONFIG_NLS_ISO8859_1=y
CONFIG_NLS_UTF8=y
CONFIG_STATIC_USERMODEHELPER=y
CONFIG_STATIC_USERMODEHELPER_PATH="/system_ext/bin/aee_core_forwarder"
CONFIG_OPLUS_ION_BOOSTPOOL=y
CONFIG_CRYPTO_TWOFISH=y
#add for enable fingerprint driver.
CONFIG_OPLUS_FINGERPRINT=y
CONFIG_OPLUS_FINGERPRINT_MTK=y
CONFIG_OPLUS_FINGERPRINT_EGIS=y
CONFIG_OPLUS_FINGERPRINT_SILEAD=y
CONFIG_OPLUS_FINGERPRINT_CHIPONE=y
CONFIG_TEE=y
CONFIG_TRUSTONIC_TEE_SUPPORT=y
CONFIG_MTK_TEE_GP_SUPPORT=y
CONFIG_TRUSTONIC_TEE_VERSION=500
#ifdef OPLUS_FEATURE_UIFIRST
CONFIG_SCHED_WALT=y
CONFIG_OPLUS_HANS=y
CONFIG_OPLUS_FEATURE_OPROJECT=y
CONFIG_OPLUS_DEVICE_IFNO=y
#endif /* OPLUS_FEATURE_UIFIRST */

#ifdef OPLUS_FEATURE_PHOENIX
 CONFIG_OPLUS_FEATURE_PHOENIX=y
#endif

# CONFIG_CRYPTO_HW is not set
CONFIG_PRINTK_TIME=y
CONFIG_DYNAMIC_DEBUG=y
CONFIG_DEBUG_INFO=y
CONFIG_FRAME_WARN=3600
CONFIG_PAGE_OWNER=y
CONFIG_DEBUG_SECTION_MISMATCH=y
CONFIG_DEBUG_PAGEALLOC=y
CONFIG_DEBUG_PAGEALLOC_ENABLE_DEFAULT=y
CONFIG_SLUB_DEBUG_ON=y
CONFIG_DEBUG_KMEMLEAK=y
CONFIG_DEBUG_KMEMLEAK_EARLY_LOG_SIZE=6400
CONFIG_DEBUG_KMEMLEAK_DEFAULT_OFF=y
CONFIG_DEBUG_VIRTUAL=y
CONFIG_PANIC_ON_OOPS=y
CONFIG_PANIC_TIMEOUT=5
CONFIG_SCHEDSTATS=y
CONFIG_SCHED_STACK_END_CHECK=y
CONFIG_PROVE_LOCKING=y
CONFIG_DEBUG_LOCKDEP=y
CONFIG_DEBUG_ATOMIC_SLEEP=y
CONFIG_MTK_LOCKING_AEE=y
CONFIG_RCU_CPU_STALL_TIMEOUT=60
CONFIG_RCU_TRACE=y
CONFIG_FAULT_INJECTION=y
CONFIG_DMA_API_DEBUG=y
CONFIG_BUG_ON_DATA_CORRUPTION=y
CONFIG_KGDB=y
CONFIG_KGDB_KDB=y
#ifdef OPLUS_FEATURE_SENSOR_ALGORITHM
CONFIG_OPLUS_FEATURE_CAMERA_PROTECT=y
CONFIG_OPLUS_FEATURE_FREE_FALL=y
CONFIG_OPLUS_FEATURE_PICKUP_DETECT=y
CONFIG_OPLUS_FEATURE_FP_DISPLAY=y
CONFIG_OPLUS_FEATURE_LUX_AOD=y
CONFIG_OPLUS_FEATURE_PEDO_MINUTE=y
CONFIG_OPLUS_FEATURE_TP_GESTURE=y
#endif /*OPLUS_FEATURE_SENSOR_ALGORITHM*/
#ifdef OPLUS_FEATURE_ACTIVITY_RECOGNITION
CONFIG_OPLUS_FEATURE_ACTIVITY_RECOGNITION=y
#endif //OPLUS_FEATURE_ACTIVITY_RECOGNITION
#ifdef OPLUS_FEATURE_ELEVATOR_DETECT
CONFIG_OPLUS_FEATURE_ELEVATOR_DETECT=y
#endif //OPLUS_FEATURE_ELEVATOR_DETECT
#ifdef OPLUS_FEATURE_PROCESS_RECLAIM
CONFIG_PROCESS_RECLAIM=y
#endif
#ifdef OPLUS_FEATURE_HANS_FREEZE
CONFIG_OPLUS_HANS=y
#endif /*OPLUS_FEATURE_HANS_FREEZE*/
#ifdef OPLUS_FEATURE_PHOENIX
CONFIG_OPLUS_FEATURE_PHOENIX=y
#endif

#ifdef OPLUS_FEATURE_EXFAT_SUPPORT
CONFIG_EXFAT_FS=y
CONFIG_NTFS_FS=y
CONFIG_NTFS_RW=y
#endif /* OPLUS_FEATURE_EXFAT_SUPPORT */
#Move all oplus feature to here,TODO ...
CONFIG_DETECT_HUNG_TASK=y
CONFIG_OPLUS_FEATURE_HUNG_TASK_ENHANCE=y
CONFIG_DEFAULT_HUNG_TASK_TIMEOUT=60
#ifdef OPLUS_FEATURE_UIFIRST
CONFIG_SCHED_WALT=y
#endif /* OPLUS_FEATURE_UIFIRST */
#ifdef OPLUS_FEATURE_ZRAM_OPT
CONFIG_OPLUS_ZRAM_OPT=y
CONFIG_CRYPTO_LZ4=y
CONFIG_PGTABLE_MAPPING=y
#endif /* OPLUS_FEATURE_ZRAM_OPT */
CONFIG_CRYPTO_ZSTD=y
CONFIG_OPLUS_ALLBOOST_OPT=y
#ifdef OPLUS_FEATURE_MM
CONFIG_BALANCE_ANON_FILE_RECLAIM=y
#endif
CONFIG_OPLUS_FEATURE_KTV_V2_NONDAPM=y
CONFIG_EXT4_FSYNC=y

CONFIG_EXT4_ASYNC_DISCARD_SUPPORT=y
#endif
#ifdef OPLUS_FEATURE_IOMONITOR
CONFIG_IOMONITOR=y
CONFIG_IOMONITOR_WITH_F2FS=n
#endif /*OPLUS_FEATURE_IOMONITOR*/
#ifdef OPLUS_FEATURE_WIFI_SLA
#todo: need to change to m when GKI
CONFIG_OPLUS_FEATURE_WIFI_SLA=y
#endif /* OPLUS_FEATURE_WIFI_SLA */

#ifdef OPLUS_FEATURE_DATA_EVAL
CONFIG_OPLUS_FEATURE_DATA_EVAL=y
#endif /*OPLUS_FEATURE_DATA_EVAL*/

#ifdef OPLUS_FEATURE_HEALTHINFO
CONFIG_OPLUS_JANK_INFO=y
#endif /* OPLUS_FEATURE_HEALTHINFO */
#ifdef OPLUS_FEATURE_HEALTHINFO
CONFIG_OPLUS_MEM_MONITOR=y
CONFIG_FG_TASK_UID=y
CONFIG_OPLUS_HEALTHINFO=y
CONFIG_SCHEDSTATS=y
#endif /*OPLUS_FEATURE_HEALTHINFO*/
CONFIG_OPLUS_FEATURE_SHUTDOWN_DETECT=y

#ifdef OPLUS_FEATURE_FEEDBACK
CONFIG_OPLUS_FEATURE_FEEDBACK=y
#endif /*OPLUS_FEATURE_FEEDBACK*/

#ifdef OPLUS_FEATURE_FG_IO_OPT
CONFIG_OPLUS_FG_IO_OPT=y
#endif

CONFIG_INPUT_JOYSTICK=y
CONFIG_JOYSTICK_XPAD=y
CONFIG_JOYSTICK_XPAD_FF=y
CONFIG_JOYSTICK_XPAD_LEDS=y

#ifdef OPLUS_FEATURE_MEMLEAK_DETECT
CONFIG_KMALLOC_DEBUG=y
CONFIG_VMALLOC_DEBUG=y
CONFIG_DUMP_TASKS_MEM=y
#endif

#ifdef OPLUS_FEATURE_ACM
CONFIG_OPLUS_FEATURE_ACM=y
CONFIG_OPLUS_FEATURE_ACM_LOGGING=y
#endif /* OPLUS_FEATURE_ACM */

#ifdef OPLUS_MTK_USERIMAGES_USE_F2FS
CONFIG_F2FS_FS=y
CONFIG_F2FS_FS_SECURITY=y
#endif /* OPLUS_MTK_USERIMAGES_USE_F2FS */
CONFIG_LOG_BUF_SHIFT=20
CONFIG_OPLUS_FEATURE_EXT4_FSYNC=y

CONFIG_OPLUS_FEATURE_OF2FS=y
CONFIG_EROFS_FS=y
#ifdef OPLUS_FEATURE_SENSOR
CONFIG_OPLUS_ALS_CALI=y
#endif
#ifdef OPLUS_FEATURE_SECURITY_COMMON
#add for oplus secure
CONFIG_OPLUS_SECURE=y
CONFIG_OPLUS_SECURE_QCOM=n
CONFIG_OPLUS_SECURE_MTK=y
CONFIG_OPLUS_SECURE_COMMON=y
#endif /* OPLUS_FEATURE_SECURITY_COMMON */
#ifdef OPLUS_FEATURE_NFC_BRINGUP
CONFIG_OPLUS_NFC=y
CONFIG_NFC_PN553_DEVICES=y
#endif /*OPLUS_FEATURE_NFC_BRINGUP*/

#ifdef OPLUS_FEATURE_SECURITY_COMMON
CONFIG_MODULE_SIG=y
CONFIG_MODULE_SIG_FORCE=y
CONFIG_MODULE_SIG_ALL=y
CONFIG_MODULE_SIG_SHA512=y
#endif /* OPLUS_FEATURE_SECURITY_COMMON */

#ifdef OPLUS_FEATURE_SECURITY_COMMON
#add for oplus secure
CONFIG_MTK_SECURITY_SW_SUPPORT=y
CONFIG_SECURITY_SELINUX_DEVELOP=y
#endif /* OPLUS_FEATURE_SECURITY_COMMON */

#ifdef OPLUS_FEATURE_MULTI_KSWAPD
#/*.Kernel.MM, 2022-04-07,add multi kswapd support*/
CONFIG_OPLUS_MULTI_KSWAPD=y
#endif /*OPLUS_FEATURE_MULTI_KSWAPD*/

#ifdef OPLUS_FEATURE_STATS_CALC
CONFIG_OPLUS_FEATURE_STATS_CALC=y
#endif /* OPLUS_FEATURE_STATS_CALC */

#ifdef OPLUS_FEATURE_HYBRIDSWAP
 CONFIG_HYBRIDSWAP=y
 CONFIG_HYBRIDSWAP_SWAPD=y
 CONFIG_HYBRIDSWAP_CORE=y
#endif
```
