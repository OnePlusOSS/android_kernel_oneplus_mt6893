## drivers/input/oplus_fp_drivers/Kconfig
```kconfig
menuconfig OPLUS_FINGERPRINT
	bool "OPLUS fingerprint"
	depends on SPI_MASTER
	help
	  Say Y here to enable OPLUS fingerprint support

config OPLUS_FINGERPRINT_GKI_DISABLE
       default n
       tristate "Fingerprint enable gki"

if OPLUS_FINGERPRINT
### platform config
config OPLUS_FINGERPRINT_QCOM
       default n
       tristate "Fingerprint base on QCOM"

config OPLUS_FINGERPRINT_MTK
       default n
       tristate "Fingerprint base on MTK"

### fingerprint sensor config
config OPLUS_FINGERPRINT_JIIOV_OPTICAL
       default n
       tristate "Fingerprint base on jiiov optical chip"

### fingerprint feature config
config OPLUS_FINGERPRINT_NAVIGATION_ENABLE
       default n
       tristate "Fingerprint navigation function"

config OPLUS_FINGERPRINT_ENABLE_TEE_BINDERCORE
       default n
       tristate "Fingerprint mtk bind big core"
endif #OPLUS_FINGERPRINT
```

## drivers/input/touchscreen/mediatek/NT36525B/Kconfig
```kconfig
#*******************************************************************************
# Copyright (C), 2008-2016, OPLUS Mobile Comm Corp., Ltd.
# ODM_WT_EDIT
# FILE: - Kconfig
# Description : Novatek NT36xxx touchscreen driver configuration
# Version: 1.0
# Date : 2018/11/20
#
# -------------------------Revision History:----------------------------------
#  <author>	 <data> 	<version >			<desc>
#
#
#*******************************************************************************/
config TOUCHSCREEN_NT36xxx_HOSTDL_SPI
	bool "Novatek NT36xxx host download SPI driver"
	help
	  Say Y here if you have a Novatek NT36xxx no flash touchscreen connected
	  to your system by SPI bus.

	  If unsure, say N.
```

## drivers/input/touchscreen/mediatek/ili9881h/Kconfig
```kconfig
#
# ili9881 driver
#
config TOUCHSCREEN_ILI9881H
	bool "ili9881h Touchscreen Driver"
	help
	  Say Y here if you have a ili9881h Touchscreen.

	  If unsure, say N.
```

## drivers/input/touchscreen/oplus_touchscreen/Kconfig
```kconfig
config TOUCHPANEL_MTK_PLATFORM
	bool "OPLUS platform tp module used"
	help
	  Say Y here if you have mtk-platform.

config TOUCHPANEL_LATE_INIT
	bool "mk6360 pmic init"
	help
	  Say Y here if you have mk6360 pmic.

config TOUCHIRQ_UPDATE_QOS
	bool "OPLUS touchpanel driver update qos"
	help
	  Say Y here if you want to update qos value in irq handler.

config TOUCHPANEL_NEW_SET_IRQ_WAKE
	bool "OPLUS platform tp module used"
	help
	  Say Y here if call enable_irq_wake, can not call disable_irq_nosync

config TOUCHPANEL_OPLUS
	bool "OPLUS tp module"
	help
	  Say Y here if you have touchscreen module.

config OPLUS_TP_APK
	bool "OPLUS apk node create"
	help
	  Say Y here if you use apk for TP.

config TOUCHPANEL_MULTI_NOFLASH
	bool "Multiple noflash TPs using"
	help
	  Say Y here if you have multiple noflash touchscreen.

config TOUCHPANEL_FOCAL
#	default y
	bool "TP Synaptics_IC enable or not for OPLUS"
	---help---
	say Y to enable driver for Touchpanel using FOCALTECK_IC

source "drivers/input/touchscreen/oplus_touchscreen/util_interface/Kconfig"


if TOUCHPANEL_FOCAL
source "drivers/input/touchscreen/oplus_touchscreen/Focal/Kconfig"
endif
```

## drivers/misc/aw8697_haptic/Kconfig
```kconfig
config AW8697_HAPTIC
    tristate "Haptic driver for awinic aw8697 series"
    depends on I2C
    help
      This option enables support for aw8697 series Haptic Driver.

config HAPTIC_FEEDBACK
    tristate "Haptic feedback for awinic aw8697 series"
    depends on I2C
    help
      This option enables support for aw8697 series Haptic Driver.
```

## drivers/misc/mediatek/accdet/Kconfig
```kconfig
config MTK_ACCDET
	bool "MediaTek ACCDET driver"
	help
	  ACCDET driver is for headset detect and support for MediaTek SOC
	  If you want to use MediaTek ACCDET driver,
	  say Y.
	  If unsure, say N.

config ACCDET_EINT_IRQ
	bool "MediaTek ACCDET PMIC EINT"
	help
	  ACCDET Internal EINT(PMIC) support for MediaTek SOC
	  If you want to use MediaTek ACCDET EINT from PMIC,
	  say Y.
	  If unsure, say N.

config ACCDET_SUPPORT_EINT0
	bool "MediaTek ACCDET PMIC EINT0"
	help
	  ACCDET use Internal EINT0(PMIC) support for MediaTek SOC
	  If you just want to use MediaTek PMIC ACCDET EINT0,
	  say Y.
	  If unsure, say N.
#2019/09/27,add for SIA PA ALGO
config HSKEY_BLOCK
	bool "Block hskey for 1s"
	default n
```

## drivers/misc/mediatek/aw37004/Kconfig
```kconfig
config LDO_AW37004
	bool  "multi ldo AW37004"
	---help---
	  This option enables multi ldo AW37004.
```

## drivers/misc/mediatek/lcd_bias/Kconfig
```kconfig
#
# ODM_HQ_EDIT
# Kconfig file for lcd bias makefile.
#

config SET_LCD_BIAS_ODM_HQ
	bool CONFIG_SET_LCD_BIAS_ODM_HQ
	default n
	help
	  HQ LCD BIAS driver

config EXT_LCD_BIAS_ODM_HQ
	bool CONFIG_EXT_LCD_BIAS_ODM_HQ
	default n
	help
	  HQ EXT LCD BIAS driver
```

## drivers/misc/mediatek/pmic/fan53870/Kconfig
```kconfig
config FAN53870_LDO
	bool "FAN53870 PMIC I2C Driver"
	default y
	---help---
	  Say Y here to support the FAN53870 PMIC chip.
	  This driver controls FAN53870 PMIC chip and the voltage
	  regulators found in Qualcomm Technologies Inc. FAN53870
	  PMIC.
```

## drivers/misc/mediatek/sensor/2.0/Kconfig
```kconfig
# SPDX-License-Identifier: GPL-2.0

source "drivers/misc/mediatek/sensor/2.0/mtk_nanohub/Kconfig"
source "drivers/misc/mediatek/sensor/2.0/sensorhub/Kconfig"
source "drivers/misc/mediatek/sensor/2.0/test/Kconfig"
source "drivers/misc/mediatek/sensor/2.0/lsm6dsm_secondary/Kconfig"
source "drivers/misc/mediatek/sensor/2.0/oplus_virtual_sensor/Kconfig"
source "drivers/misc/mediatek/sensor/2.0/oplus_virtual_sensor/sensors/camera_protecthub/Kconfig"
source "drivers/misc/mediatek/sensor/2.0/oplus_virtual_sensor/sensors/free_fallhub/Kconfig"
source "drivers/misc/mediatek/sensor/2.0/oplus_virtual_sensor/sensors/pickup_detecthub/Kconfig"
source "drivers/misc/mediatek/sensor/2.0/oplus_virtual_sensor/sensors/fp_displayhub/Kconfig"
source "drivers/misc/mediatek/sensor/2.0/oplus_virtual_sensor/sensors/lux_aodhub/Kconfig"
source "drivers/misc/mediatek/sensor/2.0/oplus_virtual_sensor/sensors/pedo_minutehub/Kconfig"
source "drivers/misc/mediatek/sensor/2.0/oplus_virtual_sensor/sensors/elevator_detecthub/Kconfig"
source "drivers/misc/mediatek/sensor/2.0/oplus_virtual_sensor/sensors/oplus_activity_recognitionhub/Kconfig"
source "drivers/misc/mediatek/sensor/2.0/oplus_sensor_devinfo/Kconfig"
source "drivers/misc/mediatek/sensor/2.0/oplus_virtual_sensor/sensors/sensor_monitor/Kconfig"
source "drivers/misc/mediatek/sensor/2.0/oplus_virtual_sensor/sensors/rotation_detecthub/Kconfig"
source "drivers/misc/mediatek/sensor/2.0/oplus_virtual_sensor/sensors/back_tap_detecthub/Kconfig"
source "drivers/misc/mediatek/sensor/2.0/oplus_virtual_sensor/sensors/lay_detecthub/Kconfig"
source "drivers/misc/mediatek/sensor/2.0/mn29005/Kconfig"
source "drivers/misc/mediatek/sensor/2.0/oplus_consumer_ir/Kconfig"
```

## drivers/misc/mediatek/sensor/2.0/mn29005/Kconfig
```kconfig
config MTK_AP_REAR_SENSOR
	bool "MN29005 for MediaTek package"
	help
	  It support MN29005 light sensor.
	  If this option is set,
	  it will support
	  MN29005 light sensor.
```

## drivers/misc/mediatek/sensor/2.0/oplus_sensor_devinfo/Kconfig
```kconfig
config OPLUS_SENSOR_MTK68XX
	bool "for MediaTek 68xx"
	default n
	help
	  It support 68xx.
```

## drivers/misc/mediatek/sensors-1.0/Kconfig
```kconfig
source "drivers/misc/mediatek/sensors-1.0/accelerometer/Kconfig"
source "drivers/misc/mediatek/sensors-1.0/alsps/Kconfig"
source "drivers/misc/mediatek/sensors-1.0/gyroscope/Kconfig"
source "drivers/misc/mediatek/sensors-1.0/magnetometer/Kconfig"
source "drivers/misc/mediatek/sensors-1.0/hwmon/Kconfig"
source "drivers/misc/mediatek/sensors-1.0/barometer/Kconfig"
source "drivers/misc/mediatek/sensors-1.0/step_counter/Kconfig"
source "drivers/misc/mediatek/sensors-1.0/situation/Kconfig"
source "drivers/misc/mediatek/sensors-1.0/sensorHub/Kconfig"
source "drivers/misc/mediatek/sensors-1.0/sensorfusion/Kconfig"
source "drivers/misc/mediatek/sensors-1.0/oplus_sensor_devinfo/Kconfig"
source "drivers/misc/mediatek/sensors-1.0/oplus_virtual_sensor/Kconfig"
source "drivers/misc/mediatek/sensors-1.0/oplus_virtual_sensor/sensors/camera_protecthub/Kconfig"
source "drivers/misc/mediatek/sensors-1.0/oplus_virtual_sensor/sensors/free_fallhub/Kconfig"
source "drivers/misc/mediatek/sensors-1.0/oplus_virtual_sensor/sensors/pickup_detecthub/Kconfig"
source "drivers/misc/mediatek/sensors-1.0/oplus_virtual_sensor/sensors/fp_displayhub/Kconfig"
source "drivers/misc/mediatek/sensors-1.0/oplus_virtual_sensor/sensors/lux_aodhub/Kconfig"
source "drivers/misc/mediatek/sensors-1.0/oplus_virtual_sensor/sensors/pedo_minutehub/Kconfig"
source "drivers/misc/mediatek/sensors-1.0/oplus_virtual_sensor/sensors/oplus_activity_recognitionhub/Kconfig"
source "drivers/misc/mediatek/sensors-1.0/oplus_virtual_sensor/sensors/tp_gesturehub/Kconfig"
source "drivers/misc/mediatek/sensors-1.0/oplus_virtual_sensor/sensors/elevator_detecthub/Kconfig"
```

## drivers/misc/oplus_misc_healthinfo/Kconfig
```kconfig
config OPLUS_MISC_HEALTHONFO
      bool "oplus misc healthinfo device"
      default n
      help
        Say Y here if you oplus misc healthinfo connected
        to your system.

	  If unsure, say N.
```

## drivers/power/Kconfig
```kconfig
source "drivers/power/avs/Kconfig"
source "drivers/power/reset/Kconfig"
source "drivers/power/supply/Kconfig"

#ifdef OPLUS_FEATURE_CHG_BASIC
source "drivers/power/oplus/Kconfig"

source "drivers/power/oplus/test-kit/Kconfig"

config OPLUS_CHARGER
	bool "OPLUS_CHARGER"
	default n
	help
	  Set Yes to support OPLUS_CHARGER features
	  smart battery.
	  Set No to disable OPLUS_CHARGER features
	  smart battery.

config OPLUS_CHARGER_MTK
	bool "OPLUS charger on MTK"
	default n
	help
	  Say Yes here to declare charging system is on MTK
	  Say No here to declare charging system is not on MTK

config OPLUS_CHARGER_MTK_CHGIC
	bool "OPLUS_CHARGER_MTK_CHG_IC"
	default n
	help
	  Say Yes to use MTK platform charger ic
	  Say No to use extern charger ic

config OPLUS_CHARGER_MTK6785
	bool "OPLUS_CHARGER_MTK6785"
	default n
	help
	  Set yes to support OPLUS_CHARGER_MTK6785 features
	  smart battery.
	  Set No to disable OPLUS_CHARGER_MTK6785 features
	  smart battery.

config OPLUS_CHARGER_MTK6779R
	bool "OPLUS_CHARGER_MTK6779"
	default n
	help
	  Set yes to support OPLUS_CHARGER_MTK6779 features
	  smart battery.
	  Set No to disable OPLUS_CHARGER_MTK6779 features
	  smart battery.

config OPLUS_CHARGER_MTK6781
	bool "OPLUS_CHARGER_MTK6781"
	default n
	help
	  Set yes to support OPLUS_CHARGER_MTK6781 features
	  smart battery.
	  Set No to disable OPLUS_CHARGER_MTK6781 features
	  smart battery.

config OPLUS_CHARGER_MTK6769R
	bool "OPLUS_CHARGER_MTK6769R"
	default n
	help
	  Set yes to support OPLUS_CHARGER_MTK6769R features
	  smart battery.
	  Set No to disable OPLUS_CHARGER_MTK6769R features
	  smart battery.

config OPLUS_CHARGER_MTK6765R
	bool "OPLUS_CHARGER_MTK6765R"
	default n
	help
	  Set yes to support OPLUS_CHARGER_MTK6765 features
	  smart battery.
	  Set No to disable OPLUS_CHARGER_MTK6765 features
	  smart battery.

config OPLUS_CHARGER_MTK6889
	bool "OPLUS_CHARGER_MTK6889"
	default n
	help
	  Set yes to support OPLUS_CHARGER_MTK6889 features
	  smart battery.
	  Set No to disable OPLUS_CHARGER_MTK6889 features
	  smart battery.

config OPLUS_CHARGER_MTK6893
	bool "OPLUS_CHARGER_MTK6893"
	default n
	help
	  Set yes to support OPLUS_CHARGER_MTK6893 features
	  smart battery.
	  Set No to disable OPLUS_CHARGER_MTK6893 features

config OPLUS_CHARGER_MTK6853
	bool "OPLUS_CHARGER_MTK6853"
	default n
	help
	  Set yes to support OPLUS_CHARGER_MTK6853 features
	  smart battery.
	  Set No to disable OPLUS_CHARGER_MTK6853 features
	  smart battery.

config OPLUS_CHARGER_MTK6877
	bool "OPLUS_CHARGER_MTK6877"
	default n
	help
	  Set yes to support OPLUS_CHARGER_MTK6877 features
	  smart battery.
	  Set No to disable OPLUS_CHARGER_MTK6877 features
	  smart battery.

config OPLUS_CHARGER_MTK6765S
	bool "OPLUS_CHARGER_MTK6765S"
	default n
	help
	  Set yes to support OPLUS_CHARGER_MTK6765S features
	  smart battery.
	  Set No to disable OPLUS_CHARGER_MTK6765S features
	  smart battery.

config OPLUS_4450MV_BATTERY_SUPPORT
	bool "OPLUS_4450MV_BATTERY_SUPPORT"
	default n
	help
	  Set yes to support 4500MV BATTERY features
	  smart battery.
	  Set No to disable 4500MV BATTERY features
	  smart battery.

config OPLUS_CHARGER_MATCH_MTKGAUGE
	bool "OPLUS_CHARGER_MATCH_MTKGAUGE"
	default n
	help
	  Set yes to support use mtk gauge and not use mtk charger features
	  smart battery.
	  Set No to disable OPLUS_CHARGER_MATCH_MTKGAUGE features

config OPLUS_CHARGER_MTKAGING
	bool "OPLUS_CHARGER_MTKAGING"
	default n
	help
	  Set yes to support amend mtk aging algo features
	  Set No to disable OPLUS_CHARGER_MTKAGING features

config OPLUS_CHECK_CHARGERID_VOLT
	bool "OPLUS_CHECK_CHARGERID_VOLT"
	default n
	help
	  Set yes to support OPLUS_CHECK_CHARGERID_VOLT features
	  smart battery.
	  Set No to disable OPLUS_CHECK_CHARGERID_VOLT features
	  smart battery.

config OPLUS_4400MV_BATTERY_SUPPORT
	bool "OPLUS_4400MV_BATTERY_SUPPORT"
	default n
	help
	  Set yes to support 4400MV BATTERY features
	  smart battery.
	  Set No to disable 4400MV BATTERY features
	  smart battery.

config OPLUS_CALL_MODE_SUPPORT
	bool "OPLUS call mode support"
	default n
	help
	  Say Y to enable support for the oplus call mode.

config OPLUS_SHIP_MODE_SUPPORT
	bool "OPLUS ship mode support"
	default n
	help
	  Say Y to include support

config OPLUS_SHORT_HW_CHECK
	bool "OPLUS batt HW SHORT"
	default n
	help
	  Say Y to include support

config OPLUS_SMART_CHARGER_SUPPORT
        bool "OPLUS Smart Charger support"
        default n
        help
          Say Y to include support

config OPLUS_DUAL_CHARGER_SUPPORT
	bool "OPLUS Dual Charger support"
	default n
	help
	  Say Y to include support

config OPLUS_SHORT_IC_CHECK
	bool "OPLUS batt short "
	help
	  Say Y here to declare charging system is on MTK

config OPLUS_CHARGER_MTK6833
	bool "OPLUS_CHARGER_MTK6833"
	default n
	help
	  Set yes to support OPLUS_CHARGER_MTK6833 features
	  smart battery.
	  Set No to disable OPLUS_CHARGER_MTK6833 features
	  smart battery.
config OPLUS_HVDCP_SUPPORT
	bool "OPLUS_HVDCP_SUPPORT"
	default n
	help
	  Set yes to support hvdcp.

config OPLUS_CHECK_CHARGERID_VOLT
	bool "OPLUS_CHECK_CHARGERID_VOLT"
	default n
	help
	  Set yes to support OPLUS_CHECK_CHARGERID_VOLT features
	  smart battery.
	  Set No to disable OPLUS_CHECK_CHARGERID_VOLT features
	  smart battery.
source "drivers/power/oplus/test-kit/Kconfig"
#endif /* OPLUS_FEATURE_CHG_BASIC */
```
