## Kconfig
```kconfig
# SPDX-License-Identifier: GPL-2.0
#
# For a description of the syntax of this configuration file,
# see Documentation/kbuild/kconfig-language.txt.
#
mainmenu "Linux/$ARCH $KERNELVERSION Kernel Configuration"

config OPLUS_FEATURE_PANIC_FLUSH
	bool "fsync optimization "
	default y
	help
		define this config to fsync optimization

config SRCARCH
	string
	option env="SRCARCH"

source "arch/$SRCARCH/Kconfig"
```
