## drivers/soc/Kconfig
```kconfig
menu "SOC (System On Chip) specific Drivers"

source "drivers/soc/actions/Kconfig"
source "drivers/soc/amlogic/Kconfig"
source "drivers/soc/atmel/Kconfig"
source "drivers/soc/bcm/Kconfig"
source "drivers/soc/fsl/Kconfig"
source "drivers/soc/imx/Kconfig"
source "drivers/soc/mediatek/Kconfig"
source "drivers/soc/qcom/Kconfig"
source "drivers/soc/renesas/Kconfig"
source "drivers/soc/rockchip/Kconfig"
source "drivers/soc/samsung/Kconfig"
source "drivers/soc/sunxi/Kconfig"
source "drivers/soc/tegra/Kconfig"
source "drivers/soc/ti/Kconfig"
source "drivers/soc/ux500/Kconfig"
source "drivers/soc/versatile/Kconfig"
source "drivers/soc/xilinx/Kconfig"
source "drivers/soc/zte/Kconfig"

#ifdef OPLUS_FEATURE_LOWMEM_DBG
source "drivers/soc/oplus/lowmem_dbg/Kconfig"
##endif /* OPLUS_FEATURE_LOWMEM_DBG */

#ifdef OPLUS_FEATURE_IOMONITOR
source "drivers/soc/oplus/iomonitor/Kconfig"
#endif /*OPLUS_FEATURE_IOMONITOR*/

#ifdef OPLUS_FEATURE_MEMLEAK_DETECT
#Add for svelte
source "drivers/soc/oplus/svelte/Kconfig"
#endif /* OPLUS_FEATURE_MEMLEAK_DETECT */

#ifdef OPLUS_BUG_STABILITY
source "drivers/soc/oplus/system/Kconfig"
#endif /* OPLUS_BUG_STABILITY */

#ifdef OPLUS_FEATURE_TP_BASIC
#Qicai.gu  12:00, 2020/06/03  devi info
source "drivers/soc/oplus/device_info/Kconfig"
##endif /* OPLUS_FEATURE_TP_BASIC */

#ifdef OPLUS_FEATURE_HEALTHINFO
source "drivers/soc/oplus/healthinfo/Kconfig"
#endif /* OPLUS_FEATURE_HEALTHINFO */

#ifdef OPLUS_FEATURE_MIDAS
source "drivers/soc/oplus/midas/Kconfig"
#endif

#ifdef OPLUS_FEATURE_MIDAS
source "drivers/soc/oplus/oplus_als_cali_value/Kconfig"
#endif

#Add for NandSwap
source "drivers/soc/oplus/oplus_nandswap/Kconfig"

#ifdef OPLUS_FEATURE_GAME_OPT
source "drivers/soc/oplus/game_opt/Kconfig"
#endif /* OPLUS_FEATURE_GAME_OPT */

source "drivers/soc/oplus/oplus_overload/Kconfig"

#ifdef OPLUS_FEATURE_HEALTHINFO
source "drivers/soc/oplus/healthinfo/Kconfig"
#endif /* OPLUS_FEATURE_HEALTHINFO */

#ifdef OPLUS_FEATURE_TMEMORY
#Add for tmemory
source "drivers/soc/oplus/tmemory/Kconfig"
#endi

source "drivers/soc/oplus/storage/Kconfig"

endmenu
```

## drivers/soc/oplus/Kconfig
```kconfig
#ifdef OPLUS_FEATURE_TP_BASIC
config OPLUS_ARCH_FILE
    bool "for build directory oplus"
    default y
    ---help---
    say Y to buid in



#source "drivers/soc/oplus/oplus_hypnus/Kconfig"
#source "drivers/soc/oplus/oplus_shutdown_detect/Kconfig"

#source "drivers/soc/oplus/oplus_phoenix/Kconfig"
#endif /* OPLUS_FEATURE_TP_BASIC */

#source "drivers/soc/oplus/oplus_key_handle/Kconfig"

#ifdef OPLUS_FEATURE_SENSOR_SMEM
#endif /*OPLUS_FEATURE_SENSOR_SMEM */
```
